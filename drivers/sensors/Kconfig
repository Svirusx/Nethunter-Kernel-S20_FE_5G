## drivers/sensors/Kconfig
```kconfig
# SPDX-License-Identifier: GPL-2.0-only
config SENSORS_SSC
	bool "Enable Sensors Driver Support for SSC"
	help
	  Add support for sensors SSC driver.
	  This driver is used for exercising sensors use case,
	  time syncing with ADSP clock.

config SENSORS
	bool "Sensors Class Support"
	help
	  This option enables the sensor sysfs class in /sys/class/sensors.
	  You'll need this to do anything useful with sensorss. If unsure, say N.

config SUPPORT_SSC_SPU
	bool "Support SSC(SLPI) SPU(System Parameter update)"
	help
	  Add support for SSC SPU.

config SENSORS_SX9360
	depends on I2C
	tristate "SX9360 driver"
	default n
	help
	  Say Y here if you use sx9360.
	  This option enables grip sensors using
	  SemTech sx9360 device driver.
	  Say N here if you do not use sx9360.

config SENSORS_SX9330
	depends on I2C
	tristate "SX9330 driver"
	default n
	help
	  Say Y here if you use sx9330.
	  This option enables grip sensors using
	  SemTech sx9330 device driver.
	  Say N here if you do not use sx9330.

config SENSORS_SX9330_SUB2
	depends on I2C
	tristate "SX9330_SUB2 driver"
	default n
	help
	  Say Y here if you use sx9330_sub2.
	  This option enables grip sensors using
	  SemTech sx9330_sub2 device driver.
	  Say N here if you do not use sx9330_sub2.

config SENSORS_SX9360_SUB
	depends on I2C
	tristate "SX9360_SUB driver"
	default n
	help
	  Say Y here if you use sx9360_sub.
	  This option enables grip sensors using
	  SemTech sx9360_sub device driver.
	  Say N here if you do not use sx9360_sub.


config SENSORS_FW_VENDOR
	bool "Locate the Firmware on Vendor"
	default n
	help
	  To use the module automatic system, 
	  locate the firmware on vendor side.
config SENSORS_SX9360_SUB3
	depends on I2C
	tristate "SX9360_SUB3 driver"
	default n
	help
	  Say Y here if you use sx9360_sub3.
	  This option enables grip sensors using
	  SemTech sx9360_sub3 device driver.
	  Say N here if you do not use sx9360_sub3.

config SUPPORT_MCC_THRESHOLD_CHANGE
	depends on I2C
	tristate "Change grip sensor threshold according to the MCC value"
	default n
	help
	  Say Y here if you need to check mcc(mobile country code).
	  This option enables when it is necessary to adjust the threshold
	  according to the mcc value.
	  Say N here if you do not need to check mcc.

config SENSORS_A96T3X6
	tristate "a96t3x6 Grip sensor"
	default n
	help
	  Say Y here if you use a96t3x6.
	  This option enables grip sensors using
	  SemTech a96t3x6 device driver.
	  Say N here if you do not use a96t3x6.
config SENSORS_A96T3X6_2CH
	depends on I2C
	tristate "SENSORS_A96T3X6_2CH driver for grip"
	default n
	help
	  Say Y here if you use SENSORS_A96T3X6_2CH for grip.
	  This option enables grip sensors using
	  Above SENSORS_A96T3X6_2CH device driver for grip.

config SENSORS_A96T3X6_SUB
	depends on I2C
	tristate "A96T3X6_SUB driver for grip"
	default n
	help
	  Say Y here if you use A96T3X6_SUB for grip.
	  This option enables grip sensors using
	  Above A96T3X6_SUB device driver for grip.

config SENSORS_A96T3X6_SUB_2CH
	depends on I2C
	tristate "A96T3X6_SUB driver for grip"
	default n
	help
	  Say Y here if you use A96T3X6_SUB_2CH for grip.
	  This option enables grip sensors using
	  Above A96T3X6_SUB_2CH device driver for grip.

config SENSORS_A96T3X6_WIFI
	depends on I2C
	tristate "A96T3X6_WIFI driver for grip"
	default n
	help
	  Say Y here if you use A96T3X6_WIFI for grip.
	  This option enables grip sensors using
	  Above A96T3X6_WIFI device driver for grip.

config SENSORS_A96T3X6_WIFI_2CH
	depends on I2C
	tristate "SENSORS_A96T3X6_WIFI_2CH driver for grip"
	default n
	help
	  Say Y here if you use SENSORS_A96T3X6_WIFI_2CH for grip.
	  This option enables grip sensors using
	  Above SENSORS_A96T3X6_WIFI_2CH device driver for grip.

config SENSORS_A96T3X6_RESET
	depends on I2C
	tristate "SENSORS_A96T3X6_RESET driver for grip"
	default n
	help
	  Say Y here if you use SENSORS_A96T3X6_RESET for grip.
	  This option enables grip sensors using
	  Above SENSORS_A96T3X6_RESET device driver for grip.
	  This feature will be enabled only for project which is using a common LDO with SW RESET, not using HW RESET.

config SENSORS_FW_VENDOR
	bool "Locate the Firmware on Vendor"
	default n
	help
	  To use the module automatic system, 
	  locate the firmware on vendor side.

config SENSOR_A96T3X6_LDO_SHARE
	depends on I2C
	tristate "SENSOR_A96T3X6_LDO_SHARE driver for grip"
	default n
	help
	  Say Y here if you use SENSOR_A96T3X6_LDO_SHARE for grip.
	  This option enables grip sensors using
	  Above SENSOR_A96T3X6_LDO_SHARE device driver for grip.

config SENSORS_A96T3X6_HALL_NOTIFIER
	bool "folder detect for grip reset"
	default n
	help
	  Say Y here if you use grip reset by folder detect

config SENSORS_A96T3X6_CRC_CHECK
	bool "check crc check instead of checksum compare"
	default n
	help
	  Say Y here if you use crc check instead of checksum compare

config SENSORS_A96T3X6_BLOCK_SAR_ONLY
	tristate "Prevent entering sar only mode"
	default n
	help
	  Prevent entering sar only mode.

config SENSORS_A96T365IF
	bool "Choose A96T365IF"
	default n

config SENSORS_A96T3X6_UNSUPPORT_OTG
	depends on I2C
	tristate "SENSORS_A96T3X6_UNSUPPORT_OTG driver for grip"
	default n
	help
	  Say Y here if you use SENSORS_A96T3X6_UNSUPPORT_OTG for grip.
	  This option enables grip sensors using
	  Above SENSORS_A96T3X6_UNSUPPORT_OTG device driver for grip.

config SENSORS_A96T3X6_FORCE_FW_UPDATE
	depends on I2C
	tristate "SENSORS_A96T3X6_FORCE_FW_UPDATE temporally"
	default n
	help
	  Say Y here if you use SENSORS_A96T3X6_UNSUPPORT_OTG for grip.
	  This option enables grip sensors using
	  Above SENSORS_A96T3X6_UNSUPPORT_OTG device driver for grip.

config SENSORS_VL53L5
	depends on SPI
	tristate "VL53L5 driver"
	default n
	help
	  Say Y here if you use VL53L5.
	  This option enables range sensor using VL53L5.

config SENSORS_VL53L5_SUPPORT_UAPI
	tristate "STM vl53l5 ranging sensor UPAI interface"
	default n
	help
	  STM vl53l5 ranging sensor UPAI interface.

config SENSORS_VL53L5_SUPPORT_KERNEL_INTERFACE
	tristate "STM vl53l5 ranging sensor Kernel Interface"
	default n
	help
	  STM vl53l5 ranging sensor Kernel Interface.

config SEC_SLPI_SLEEP_DEBUG
	tristate "For debugging slpi sleep issue"
	default n
	help
	  Say Y to make a force crash when slpi can not enter low power mode
	  Say N to make silent restart when slpi can not enter low power mode
```

## drivers/spu_verify/Kconfig
```kconfig
config SPU_VERIFY
	bool "SPU Sign Verify Driver"
	default n
	help
	  This option enables SPU sign verify driver.
```

## drivers/staging/samsung/Kconfig
```kconfig
# drivers/staging/samsung/Kconfig
#
# Copyright (c) 2010-2011 Samsung Electronics Co., Ltd.
#		http://www.samsung.com/
#
# Licensed under GPLv2

comment "Samsung TN Features"
menuconfig SEC_EXT
	bool "Samsung TN extension Feature"

config SEC_HQM_DEVICE
	bool "Samsung sec hqm device"
	default n
	help
	  Samsung hqm device feature

comment "Logging Heavy Task Cpu Options"
config SEC_HEAVY_TASK_CPU
	bool "Enable heacy cpu core counting"
	default n
	help
	  This option enables heavy cpu core counting.
```

## drivers/staging/samsung/sec_notifier/Kconfig
```kconfig
#
# notifier
#

comment "NOTIFIER configs"

config VBUS_NOTIFIER
	bool "VBUS notifier support"
	default n
	help
	  If you say yes here you will get support for
	  the VBUS status change notification.

config VBUS_NOTIFIER_WORK
	bool "Work Queue VBUS notifier support"
	default n
	help
	  If you say yes here you will get support for
	  the Work Queue VBUS status change notification.
```

## drivers/uwb/uwb_logger/Kconfig
```kconfig
config SEC_UWB_LOGGER
	bool "UWB logger"
	default n
	help
	  Enable UWB logger. 
```

## fs/crypto/Kconfig
```kconfig
config FS_ENCRYPTION
	bool "FS Encryption (Per-file encryption)"
	select CRYPTO
	select CRYPTO_AES
	select CRYPTO_CBC
	select CRYPTO_ECB
	select CRYPTO_XTS
	select CRYPTO_CTS
	select CRYPTO_SHA256
	select KEYS
	help
	  Enable encryption of files and directories.  This
	  feature is similar to ecryptfs, but it is more memory
	  efficient since it avoids caching the encrypted and
	  decrypted pages in the page cache.  Currently Ext4,
	  F2FS and UBIFS make use of this feature.

config FSCRYPT_SDP
	bool "Sensitive Data Protection for Per-file-encryption"
	depends on FS_ENCRYPTION
	depends on SDP
	help
	  Enable SDP functional to fscrypto module.
	  This feature is supporting "Data-At-Rest" for file systems using
	  Per-file-encryption being controlled by SDP user status.
```

## kernel/Kconfig.intelligence
```kconfig
menu "Intelligence"

config INTELLIGENCE
	bool "Intelligent Resource Management"
	depends on FAIR_GROUP_SCHED
	default y
	---help---
	  Enable support for the Intelligence platform

endmenu
```

## kernel/ftt/Kconfig
```kconfig
config FAST_TRACK
    bool "ftt feature"
    depends on RWSEM_SPIN_ON_OWNER
    default y
    help
      if set, ftt feature is enable
```

## security/hdm/Kconfig
```kconfig
# @file Kconfig
# @brief Kconfig for HDM driver
# Copyright (c) 2019, Samsung Electronics Corporation. All rights reserved.
#
# This program is free software; you can redistribute it and/or modify
# it under the terms of the GNU General Public License version 2 and
# only version 2 as published by the Free Software Foundation.
#
# This program is distributed in the hope that it will be useful,
# but WITHOUT ANY WARRANTY; without even the implied warranty of
# MERCHANTABILITY or FITNESS FOR A PARTICULAR PURPOSE.  See the
# GNU General Public License for more details.

config HDM
	bool "HDM feature enable"
	default n
	help
	This enables hdm driver

config HDM_DEBUG
	bool "For debug only"
	default n
	help
	This enables hdm debug code
```

## security/mstdrv/Kconfig
```kconfig
# @file Kconfig
# @brief Kconfig for MST drivers
# Copyright (c) 2015-2019, Samsung Electronics Corporation. All rights reserved.
#
# This program is free software; you can redistribute it and/or modify
# it under the terms of the GNU General Public License version 2 and
# only version 2 as published by the Free Software Foundation.
#
# This program is distributed in the hope that it will be useful,
# but WITHOUT ANY WARRANTY; without even the implied warranty of
# MERCHANTABILITY or FITNESS FOR A PARTICULAR PURPOSE.  See the
# GNU General Public License for more details.

config MST_LDO
	bool "MST LDO kernel driver"
	depends on !(MACH_X1Q_CHN_OPEN && !(MACH_X1Q_CHN_HKX) && !(SEC_FACTORY)) \
			&& !(MACH_Y2Q_CHN_OPEN && !(MACH_Y2Q_CHN_HKX) && !(SEC_FACTORY)) \
			&& !(MACH_Z3Q_CHN_OPEN && !(MACH_Z3Q_CHN_HKX) && !(SEC_FACTORY)) \
			&& !(SEC_GTS7XL_PROJECT) && !(SEC_GTS7L_PROJECT) \
			&& !(MACH_C1Q_CHN_OPEN && !(MACH_C1Q_CHN_HK) && !(SEC_FACTORY)) \
			&& !(MACH_C2Q_CHN_OPEN && !(MACH_C2Q_CHN_HK) && !(SEC_FACTORY)) \
			&& !(MACH_F2Q_CHN_OPEN && !(MACH_F2Q_CHN_HKX) && !(SEC_FACTORY)) \
			&& !(MACH_BLOOMXQ_CHN_OPEN && !(MACH_BLOOMXQ_CHN_HKX) && !(SEC_FACTORY)) \
			&& !(MACH_R8Q_CAN_SINGLE) && !(MACH_R8Q_CHN_HKX) && !(MACH_R8Q_CHN_OPEN) \
			&& !(SEC_VICTORY_PROJECT)
	default n
	help
	This enables the MST LDO kernel driver

config MST_V2
	bool "MST V2"
	depends on !(MACH_X1Q_CHN_OPEN && !(MACH_X1Q_CHN_HKX) && !(SEC_FACTORY)) \
			&& !(MACH_Y2Q_CHN_OPEN && !(MACH_Y2Q_CHN_HKX) && !(SEC_FACTORY)) \
			&& !(MACH_Z3Q_CHN_OPEN && !(MACH_Z3Q_CHN_HKX) && !(SEC_FACTORY)) \
			&& !(SEC_GTS7XL_PROJECT) && !(SEC_GTS7L_PROJECT) \
			&& !(MACH_C1Q_CHN_OPEN && !(MACH_C1Q_CHN_HK) && !(SEC_FACTORY)) \
			&& !(MACH_C2Q_CHN_OPEN && !(MACH_C2Q_CHN_HK) && !(SEC_FACTORY)) \
			&& !(MACH_F2Q_CHN_OPEN && !(MACH_F2Q_CHN_HKX) && !(SEC_FACTORY)) \
			&& !(MACH_BLOOMXQ_CHN_OPEN && !(MACH_BLOOMXQ_CHN_HKX) && !(SEC_FACTORY)) \
			&& !(MACH_R8Q_CAN_SINGLE) && !(MACH_R8Q_CHN_HKX) && !(MACH_R8Q_CHN_OPEN) \
			&& !(SEC_VICTORY_PROJECT)
	default n
	help
	This enables the MST V2 codes

config MST_REGULATOR
	bool "MST uses regulator API"
	default n
	help
	This enables regulator API code

config MST_SUPPORT_GPIO
	bool "MST uses support gpio"
	default n
	help
	This enables support gpio check code

config MST_NONSECURE
	bool "MST before TrustZone bringup"
	default n
	help
	This enables the MST operation in Normal kernel

config MST_IF_PMIC
	bool "MST is used in IF PMIC"
	default n
	help
	This enables the MST IF PMIC function

config MFC_CHARGER
	bool "MFC IC using model"
	depends on !(MACH_X1Q_CHN_OPEN && !(MACH_X1Q_CHN_HKX) && !(SEC_FACTORY)) \
			&& !(MACH_Y2Q_CHN_OPEN && !(MACH_Y2Q_CHN_HKX) && !(SEC_FACTORY)) \
			&& !(MACH_Z3Q_CHN_OPEN && !(MACH_Z3Q_CHN_HKX) && !(SEC_FACTORY)) \
			&& !(SEC_GTS7XL_PROJECT) && !(SEC_GTS7L_PROJECT) \
			&& !(MACH_C1Q_CHN_OPEN && !(MACH_C1Q_CHN_HK) && !(SEC_FACTORY)) \
			&& !(MACH_C2Q_CHN_OPEN && !(MACH_C2Q_CHN_HK) && !(SEC_FACTORY)) \
			&& !(MACH_F2Q_CHN_OPEN && !(MACH_F2Q_CHN_HKX) && !(SEC_FACTORY)) \
			&& !(MACH_BLOOMXQ_CHN_OPEN && !(MACH_BLOOMXQ_CHN_HKX) && !(SEC_FACTORY)) \
			&& !(MACH_R8Q_CAN_SINGLE) && !(MACH_R8Q_CHN_HKX) && !(MACH_R8Q_CHN_OPEN) \
			&& !(SEC_VICTORY_PROJECT)
	default n
	help
	This enables the MFC IC sysfs node

config MST_TEEGRIS
	bool "MST running on TEEGRIS"
	default n
	help
	This enables the MST TEEGRIS function

config MST_LPM_DISABLE
	bool "MST LPM Disable, this works only in eng binary version"
	default n
	help
	This enables the MST LPM disable funtion in eng binary version

config MST_LPM_CONTROL
	bool "MST control LPM mode for performace"
	default n
	help
	This enables the MST LPM control code
```
