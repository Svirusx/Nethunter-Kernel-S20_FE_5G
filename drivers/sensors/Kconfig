## techpack/camera/drivers/Kconfig
```kconfig
config SAMSUNG_OIS_MCU_STM32
        tristate "External ois MCU STM32 support"
	depends on SPECTRA_CAMERA
	default n
	---help---
	Enables support for external ois module.

config SAMSUNG_OIS_TAMODE_CONTROL
	tristate "Use ois TAMODE control"
	depends on SPECTRA_CAMERA
	default n
	---help---
	Enables support for actuator softlanding

config SAMSUNG_OIS_RUMBA_S4
        tristate "External RUMBA S4 OIS support"
	depends on SPECTRA_CAMERA
	default n
	---help---
	Enables support for external ois module.

config SAMSUNG_SBI
        tristate "External SBI support"
	depends on SPECTRA_CAMERA
	default n
	---help---
	Enables support for external SBI module.

config SAMSUNG_APERTURE
        tristate "External aperture support"
	depends on SPECTRA_CAMERA
	default n
	---help---
	Enables support for external aperture module.

config SAMSUNG_APERTURE_MULTI_MODE
        tristate "External aperture support multiple mode(1.5, 1.8, 2.4, etc)"
	depends on SAMSUNG_APERTURE
	default n
	---help---
	Enables support for external aperture multiple mode.

config SAMSUNG_APERTURE_HALLTEST
        tristate "aperture hall test support"
	depends on SPECTRA_CAMERA
	default n
	---help---
	Enables support for aperture hall est

config SAMSUNG_REAR_DUAL
	tristate "Rear dual camera support"
	depends on SPECTRA_CAMERA
	default n
	---help---
	Enables support for rear dual camera.

config SAMSUNG_REAR_TRIPLE
	tristate "Rear triple camera support"
	depends on SPECTRA_CAMERA
	default n
	---help---
	Enables support for rear triple camera.

config SAMSUNG_FRONT_DUAL
	tristate "Front dual camera support"
	depends on SPECTRA_CAMERA
	default n
	---help---
	Enables support for front dual camera.

config SAMSUNG_FRONT_TOP
	tristate "Front top camera support"
	depends on SPECTRA_CAMERA
	default n
	---help---
	Enables support for front top camera.

config SAMSUNG_FRONT_TOF
	tristate "Front tof camera support"
	depends on SPECTRA_CAMERA
	default n
	---help---
	Enables support for front tof camera.

config SAMSUNG_REAR_TOF
	tristate "rear tof camera support"
	depends on SPECTRA_CAMERA
	default n
	---help---
	Enables support for rear tof camera.

config CAMERA_ADAPTIVE_MIPI
	tristate "adaptive mipi support"
	depends on SPECTRA_CAMERA
	default n
	---help---
	Enables support for adaptive mipi.

config SAMSUNG_FRONT_TOP_EEPROM
	tristate "Front top camera eeprom"
	depends on SPECTRA_CAMERA
	default n
	---help---
	Enables support for front top camera eeprom.

config CAMERA_SYSFS_V2
	bool "CAMERA SYS"
	depends on SPECTRA_CAMERA
	---help---
	Enable support CAMERA SYS.

config SAMSUNG_FRONT_EEPROM
	tristate "Front eeprom support"
	depends on SPECTRA_CAMERA
	default n
	---help---
	Enables support for front eeprom

config SAMSUNG_SECURE_CAMERA
	tristate "Secure camera support"
	depends on SPECTRA_CAMERA
	default n
	---help---
	Enables support for secure camera

config CAMERA_DYNAMIC_MIPI
	tristate "Multi camera support"
	depends on SPECTRA_CAMERA
	default n
	---help---
	Enables support for dynamic mipi clock

config SAMSUNG_REAR_TELE_BINNING
	tristate "Rearfull camera support"
	depends on SPECTRA_CAMERA
	default n
	---help---
	Enables support for rear tele binning

config CAMERA_FRS_DRAM_TEST
	tristate "Camera dram support"
	depends on SPECTRA_CAMERA
	default n
	---help---
	Enables support for DRAM test

config USE_CAMERA_HW_BIG_DATA
	bool "CAMERA HW SYS"
	depends on SPECTRA_CAMERA
	default n
	---help---
	CAMERA HW SYS.

config FLASH_CURRENT_JAPAN
	tristate "flash current for jpn"
	depends on SPECTRA_CAMERA
	default n
	---help---
	Enables support for JPN

config CAMERA_SSM_I2C_ENV
	tristate "Rear camera support"
	depends on SPECTRA_CAMERA
	default n
	---help---
	Enables support for SSM I2C test

config CAMERA_FRAME_CNT_DBG
	tristate "Camera frame cnt for debug"
	depends on SPECTRA_CAMERA
	default n
	---help---
	Enables support for debug

config CAMERA_STREAMOFF_CHECK
	tristate "Check Camera streamoff status"
	depends on SPECTRA_CAMERA
	default n
	---help---
	Enables support for check streamoff status

config EEPROM_FORCE_DOWN
	tristate "EEPROM power down forcely when EEPROM i2c error"
	depends on SPECTRA_CAMERA
	default n
	---help---
	Enables support for force EEPROM power down

config SAMSUNG_ACTUATOR_AK7377
	tristate "Actuator AK7377"
	depends on SPECTRA_CAMERA
	default n
	---help---
	Enables support for actuator ak7377

config SAMSUNG_REAR_BOKEH
	tristate "bokeh camera"
	depends on SPECTRA_CAMERA
	default n
	---help---
	Enables support for bokeh camera

config LEDS_PMIC_QPNP
	tristate "flash PMIC"
	depends on SPECTRA_CAMERA
	default n
	---help---
	Enables support for PMIC flash

config SAMSUNG_ACTUATOR_DW9808
	tristate "Actuator DW9808"
	depends on SPECTRA_CAMERA
	default n
	---help---
	Enables support for actuator DW9808

config SAMSUNG_REAR_TELE_TETRA
	tristate "RearTetra camera support"
	depends on SPECTRA_CAMERA
	default n
	---help---
	Enables support for rear tetra

config SAMSUNG_ACTUATOR_PREVENT_SHAKING
	tristate "Prevent actuator shaking"
	depends on SPECTRA_CAMERA
	default n
	---help---
	Enables support for actuator softlanding

config SENSOR_RETENTION
        tristate "2L4 sensor retention"
        depends on SPECTRA_CAMERA
        default n
        ---help---
        Enables support for 2L4 sensor retention

config SAMSUNG_ACTUATOR_SOFTLANDING
	tristate "actuator softlanding support"
	depends on SPECTRA_CAMERA
	default n
	---help---
	Enables support for actuator softlanding

config SAMSUNG_FRONT_FIXED_FOCUS
	tristate "front camera fixed focus support"
	depends on SPECTRA_CAMERA
	default n
	---help---
	Enables support for front camera fixed focus

config USE_CAMERA_HW_BIG_DATA
	bool "CAMERA HW SYS"
	depends on SPECTRA_CAMERA
	default n
	---help---
	CAMERA HW SYS.

config SAMSUNG_SUPPORT_REMOSAIC_MFNR_FEATURE
        tristate "Remosaic MFNR Support"
        depends on SPECTRA_CAMERA
        default n
        ---help---
        Enables support for Remosaic MFNR
```

## techpack/display/msm/dp/Kconfig
```kconfig
config SEC_DISPLAYPORT
	bool "SEC DISPLAYPORT feature"
	default n
	help
          Samsung specific displayport changes.

config SEC_DISPLAYPORT_MST
	bool "SEC DISPLAYPORT MST feature"
	default n
	help
          Samsung specific displayport MST changes.

config SEC_DISPLAYPORT_BIGDATA
	bool "DISPLAYPORT bigdata"
	depends on !SEC_FACTORY
	default n
	help
          Enable DISPLAYPORT bigdata.

config SEC_DISPLAYPORT_LOGGER
	bool "SEC DISPLAYPORT LOGGER feature"
	depends on SEC_DISPLAYPORT
	help
          Samsung specific displayport log changes.

config SEC_DISPLAYPORT_ENG
	bool "SEC DISPLAYPORT ENG feature"
	depends on SEC_DISPLAYPORT
	help
          Samsung specific eng test code for displayport.

config SEC_DISPLAYPORT_AUX_CONTROL
	bool "SEC DISPLAYPORT Aux Control feature"
	depends on SEC_DISPLAYPORT
	default n
	help
          Support for AUX dongle control.
```

## techpack/display/msm/samsung/Kconfig
```kconfig
config SAMSUNG_DEBUG_DISPLAY
	bool "Add Samsung Debugging code"
	default n

config DISPLAY_SAMSUNG
	bool "mdss config for samsung product"
	default n
	---help---
	Mdss config signature for samsung product

#
#	PANEL UNIQUE FEATURE
#
config DUAL_PANEL
	depends on DISPLAY_SAMSUNG
	bool "dual paneloperation"
	default n
	---help---
	dual panel operation support

config PARTIAL_UPDATE
	depends on DISPLAY_SAMSUNG
	bool "partial update operation"
	default n
	---help---
	partial update operation support

config CABC_FUNCTION
	depends on DISPLAY_SAMSUNG
	bool "DDI cabc operation"
	default n
	---help---
	DDI cabc operation support

config SUPPORT_POC_FLASH
	depends on DISPLAY_SAMSUNG
	bool "SUPPORT POC FLASH"
	default n
	---help---
	SUPPORT_POC_FLASH FOR DREAM2 ONLY

#
#	HOW TO MAKE DEF-CONFIG NAME FOR PANEL
#
#	PANEL_DDI-model_PANEL-model_RESOLUTION
#	PANEL_S6E3FA2    _AMS510CV01_FHD
#	PANEL_S6E3FA2_AMS510CV01_FHD
#

config PANEL_S6E3HA6_AMB632NF01_WQHD
	depends on DISPLAY_SAMSUNG
	bool "LSI S6E3HA6 LDI"
	default n
	---help---
	LSI S6E3HA6 LDI 1440_2560 GREAT DSC


config PANEL_S6E3HA6_AMS622MR01_WQHD
	depends on DISPLAY_SAMSUNG
	bool "LSI S6E3HA6 LDI"
	default n
	---help---
	LSI S6E3HA6 LDI 1440_2560 DREAM2 DSC

config PANEL_S6E3HA8_AMB622NP01_WQHD
	depends on DISPLAY_SAMSUNG
	bool "LSI S6E3HA8 LDI"
	default n
	---help---
	LSI S6E3HA8 LDI 1440_2560 STAR2 DSC

config PANEL_S6E3HA8_AMB638RD01_WQHD
	depends on DISPLAY_SAMSUNG
	bool "LSI S6E3HA8 LDI"
	default n
	---help---
	LSI S6E3HA8 LDI 1440_2560 BEYOND DSC

config PANEL_S6E3HA9_AMB611WE01_WQHD
	depends on DISPLAY_SAMSUNG
	bool "LSI S6E3HA9 LDI"
	default n
	---help---
	LSI S6E3HA9 LDI 1440_3040 BEYOND1 L-Cut DSC

config PANEL_S6E3HA9_AMB644WF01_WQHD
	depends on DISPLAY_SAMSUNG
	bool "LSI S6E3HA9 LDI"
	default n
	---help---
	LSI S6E3HA9 LDI 1440_3040 BEYOND2 L-Cut DSC

config PANEL_S6E3HA9_AMB666WS04_WQHD
	depends on DISPLAY_SAMSUNG
	bool "LSI S6E3HA9 LDI"
	default n
	---help---
	LSI S6E3HA9 LDI 1440_3040 BEYONDX P-Hole DSC

config PANEL_S6E3HA9_AMB597RT01_WQHD
	depends on DISPLAY_SAMSUNG
	bool "LSI S6E3HA9 LDI"
	default n
	---help---
	LSI S6E3HA9 LDI 1440_2960 CROWN DSC

config PANEL_S6E3XA0_AMB729WA01_QXGA
	depends on DISPLAY_SAMSUNG
	bool "LSI S6E3XA0 LDI"
	default n
	---help---
	LSI S6E3XA0 LDI 2152_1536 WINNER main panel

config PANEL_S6E3FA7_AMB458WJ01_HD
	depends on DISPLAY_SAMSUNG
	bool "LSI S6E3FA7 LDI"
	default n
	---help---
	LSI S6E3FA7 LDI 720_1680 WINNER SUB

config PANEL_S6E3FA7_AMS628RF01_FHD
	depends on DISPLAY_SAMSUNG
	bool "LSI S6E3FA7 LDI"
	default n
	---help---
	LSI S6E3FA7 LDI 1080_2220 ASTAR

config PANEL_S6E3FA7_AMS559NK01_FHD
	depends on DISPLAY_SAMSUNG
	bool "LSI S6E3FA7 LDI"
	default n
	---help---
	LSI S6E3FA7 LDI 1080_2220 JACKPOT

config PANEL_S6E3FA7_AMB575WD01_FHD
	depends on DISPLAY_SAMSUNG
	bool "LSI S6E3FA7 LDI"
	default n
	---help---
	LSI S6E3FA7 LDI 1080_2280 BEYOND0

config PANEL_ANA38401_AMSA05RB06_WQXGA
	depends on DISPLAY_SAMSUNG
	bool "LSI ANA38401 LDI"
	default n
	---help---
	LSI ANA38401 LDI 2560_1600 TAB S6

config PANEL_S6E3HA9_AMB675TG01_WQHD
	depends on DISPLAY_SAMSUNG
	bool "LSI S6E3HA9 LDI"
	default n
	---help---
	LSI S6E3HA9 LDI 1440_3040 DAVINCI2

config PANEL_S6E3FA7_AMB628TR01_FHD
	depends on DISPLAY_SAMSUNG
	bool "LSI S6E3FA7 LDI"
	default n
	---help---
	LSI S6E3FA7 LDI 1080_2280 DAVINCI1

config PANEL_S6E3FC2_AMS670TA01_FHD
	depends on DISPLAY_SAMSUNG
	bool "LSI S6E3FC2 LDI"
	default n
	---help---
	LSI S6E3FC2 LDI 1080_2400 R3_REV_00

config PANEL_S6E3HAB_AMB677TY01_WQHD
	depends on DISPLAY_SAMSUNG
	bool "LSI S6E3HAB LDI"
	default n
	---help---
	LSI S6E3HAB LDI 1440_3200 HUBBLE Y2 DSC

config PANEL_S6E3HAB_AMB623TS01_WQHD
	depends on DISPLAY_SAMSUNG
	bool "LSI S6E3HAB LDI"
	default n
	---help---
	LSI S6E3HAB LDI 1440_3200 HUBBLE X1 DSC

config PANEL_S6E3HAB_AMB687TZ01_WQHD
	depends on DISPLAY_SAMSUNG
	bool "LSI S6E3HAB LDI"
	default n
	---help---
	LSI S6E3HAB LDI 1440_3200 HUBBLE Z3 DSC

config PANEL_S6E3XA0_AMB729WA01_QXGA
	depends on DISPLAY_SAMSUNG
	bool "LSI S6E3XA0 LDI"
	default n
	---help---
	LSI S6E3XA0 LDI 2152_1536 WINNER MAIN

config PANEL_S6E3FA7_AMB458WJ01_HD
	depends on DISPLAY_SAMSUNG
	bool "LSI S6E3FA7 LDI"
	default n
	---help---
	LSI S6E3XA0 LDI 720_1680 WINNER SUB

config PANEL_S6E3HAC_AMB687VX01_WQHD
	depends on DISPLAY_SAMSUNG
	bool "LSI S6E3HAC LDI"
	default n
	---help---
	LSI S6E3HAC LDI 1440_3088 CANVAS2 DSC

config PANEL_S6E3FA9_AMB667UM01_FHD
	depends on DISPLAY_SAMSUNG
	bool "LSI S6E3FA9 LDI"
	default n
	help
	  LSI S6E3FA9 LDI 1080_2400 FHD non-DSC panel.
	  This is attached to A91 project.
	  Now, it will also attached to CANVAS1 board as 2nd temporary UB.
	  This doesn't support VRR.

config PANEL_S6E3FAB_AMB643VW01_FHD
	depends on DISPLAY_SAMSUNG
	bool "LSI S6E3FAB LDI"
	default n
	---help---
	LSI S6E3FAB LDI 1080_2340 CANVAS1 DSC

config PANEL_NT36523_PPA957DB1_WQXGA
	depends on DISPLAY_SAMSUNG
	bool "NOVATEK NT36523 LDI"
	default n
	---help---
	NOVATEK NT36523 LDI 1600_2560 TABS7

config PANEL_S6E3HA9_AMF670UH01_FHD
	depends on DISPLAY_SAMSUNG
	bool "LSI S6E3HA9 LDI"
	default n
	---help---
	LSI S6E3HA9 LDI 1080_2640 BLOOM rev01 DSC

config PANEL_S6E36W3_AMB114EU09
	depends on DISPLAY_SAMSUNG
	bool "LSI S6E36W3 LDI"
	default n
	---help---
	LSI S6E36W3 LDI 120_300 BLOOM SUB

config PANEL_S6TUUM0_AMSA24VU01_WQXGA
	depends on DISPLAY_SAMSUNG
	bool "LSI S6TUUM1 LDI"
	default n
	---help---
	LSI S6TUUM1 LDI 2808_1752 TABS7P

config PANEL_S6TUUM1_AMSA24VU01_WQXGA
	depends on DISPLAY_SAMSUNG
	bool "LSI S6TUUM1 LDI"
	default n
	---help---
	LSI S6TUUM1 LDI 2800_1752 TABS7P 1lane

config PANEL_S6TUUM2_AMSA24VU01_WQXGA
	depends on DISPLAY_SAMSUNG
	bool "LSI S6TUUM1 LDI"
	default n
	---help---
	LSI S6TUUM1 LDI 2800_1752 TABS7P 4lane

config PANEL_S6TUUM3_AMSA24VU01_WQXGA
	depends on DISPLAY_SAMSUNG
	bool "LSI S6TUUM1 LDI"
	default n
	---help---
	LSI S6TUUM1 LDI 2800_1752 TABS7P PV2-3

config PANEL_S6E3XA1_AMF759VG01_QXGA
	depends on DISPLAY_SAMSUNG
	bool "LSI S6E3XA1 LDI"
	default n
	help
	LSI S6E3XA1 LDI 2208_1768 TOP main panel

config PANEL_S6E3FA7_AMB623VH01_HD
	depends on DISPLAY_SAMSUNG
	bool "LSI S6E3XA1 LDI"
	default n
	help
	LSI S6E3FA7 LDI 816_2260 TOP main panel

config PANEL_EA8076A_AMS646UJ10_FHD
	depends on DISPLAY_SAMSUNG
	bool "MAGNA EA8076A LDI"
	default n
	---help---
	MAGNA EA8076A LDI 1080_2400 R8_Rev00

config PANEL_EA8079B_AMS646YB01_FHD
	depends on DISPLAY_SAMSUNG
	bool "MAGNA EA8079B LDI"
	default n
	---help---
	MAGNA EA8079B LDI 1080_2400 R8_Rev01

config PANEL_S6E3FC3_AMS646YD01_FHD
	depends on DISPLAY_SAMSUNG
	bool "SEC S6E3FC3 LDI"
	default n
	---help---
	SEC S6E3FC3 LDI 1080_2400 A52XQ and R8_Rev07
```

## tools/testing/kunit/test_data/kernel/drivers/muic/Kconfig
```kconfig
#
# MUIC devices
#

comment "MUIC configs"

config USE_MUIC
	bool "Using MUIC device driver"
	depends on I2C
	default n
	help
	  If you say yes here you will get support for
	  the MUIC device driver.

config USE_SAFEOUT
	bool "Using SAFEOUT device driver"
	depends on I2C
	default n
	help
	  If you say yes here you will get support for
	  the SAFEOUT device driver.

config MUIC_NOTIFIER
	bool "MUIC notifier support"
	depends on USE_MUIC
	default n
	help
	  If you say yes here you will get support for
	  the MUIC attached device status change notification.

config MUIC_SUPPORT_CCIC
	bool "MUIC supports CCIC chip interface"
	depends on USE_MUIC
	default n
	help
	  If you say yes here you will get support for the CCIC chip.

config HICCUP_CHARGER
	bool "Using HICCUP charger"
	depends on USE_MUIC
	default n
	help
	  If you say yes here you will get support for for the hiccup charger feature.

config MUIC_MAX77705
        bool "Using MAX77705 MUIC"
        depends on USE_MUIC
        default n
        help
          If you say yes here you will get support for
          the MAX77705 MUIC chip.
	  To enable this driver,
	  USE_MUIC should be enabled.

config HV_MUIC_MAX77705_AFC
        bool "Using MAX77705 AFC MUIC"
        depends on MUIC_MAX77705
        default n
        help
          If you say yes here you will get support for
	  the MAX77705 AFC MUIC.
	  To enable this driver,
	  MUIC_MAX77705 should be enabled.

config MUIC_MAX77705_CCIC
        bool "Using MAX77705 MUIC supports CCIC chip interface"
        depends on MUIC_MAX77705 && MUIC_SUPPORT_CCIC
        default n
        help
          If you say yes here you will get support for
	  the CCIC chip with MAX77705 MUIC.
	  To enable this driver,
	  MUIC_MAX77705 and MUIC_SUPPORT_CCIC should be enabled.
```
