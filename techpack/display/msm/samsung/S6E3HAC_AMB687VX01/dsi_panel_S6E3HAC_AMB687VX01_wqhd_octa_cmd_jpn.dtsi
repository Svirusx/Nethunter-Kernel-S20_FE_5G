/* Copyright (c) 2012, Samsung Electronics Corporation. All rights reserved.
 *
 * This program is free software; you can redistribute it and/or modify
 * it under the terms of the GNU General Public License version 2 and
 * only version 2 as published by the Free Software Foundation.
 *
 * This program is distributed in the hope that it will be useful,
 * but WITHOUT ANY WARRANTY; without even the implied warranty of
 * MERCHANTABILITY or FITNESS FOR A PARTICULAR PURPOSE.  See the
 * GNU General Public License for more details.
 */

&ss_dsi_panel_S6E3HAC_AMB687VX01_WQHD {
	/* *************************************************************
	 * candela to index mappings
	 * **************************************************************
	 */
	samsung,candela_map_table_revD = < /* THIS TABLE USED FOR DIMMING */
	/*   <idx>   <from>  <till>  <gm2_wrdisbv> <cd> */
		0	0	0	5	2
		1	1	1	9	2
		2	2	2	9	3
		3	3	3	9	3
		4	4	4	10	4
		5	5	5	10	4
		6	6	6	10	4
		7	7	7	10	5
		8	8	8	10	5
		9	9	9	14	5
		10	10	10	14	6
		11	11	11	14	6
		12	12	12	19	6
		13	13	13	19	7
		14	14	14	19	7
		15	15	15	19	8
		16	16	16	19	8
		17	17	17	20	8
		18	18	18	20	9
		19	19	19	20	9
		20	20	20	23	10
		21	21	21	23	10
		22	22	22	23	10
		23	23	23	23	11
		24	24	24	23	11
		25	25	25	24	11
		26	26	26	25	12
		27	27	27	26	12
		28	28	28	27	12
		29	29	29	28	13
		30	30	30	29	13
		31	31	31	29	14
		32	32	32	30	14
		33	33	33	31	14
		34	34	34	32	15
		35	35	35	33	15
		36	36	36	34	16
		37	37	37	35	16
		38	38	38	35	16
		39	39	39	36	17
		40	40	40	36	17
		41	41	41	37	17
		42	42	42	38	18
		43	43	43	39	18
		44	44	44	40	18
		45	45	45	40	19
		46	46	46	41	19
		47	47	47	42	20
		48	48	48	43	20
		49	49	49	44	21
		50	50	50	45	21
		51	51	51	46	21
		52	52	52	46	22
		53	53	53	47	22
		54	54	54	48	23
		55	55	55	49	23
		56	56	56	49	23
		57	57	57	50	23
		58	58	58	51	24
		59	59	59	51	24
		60	60	60	52	25
		61	61	61	53	25
		62	62	62	54	25
		63	63	63	55	26
		64	64	64	56	26
		65	65	65	57	27
		66	66	66	57	27
		67	67	67	58	27
		68	68	68	59	28
		69	69	69	60	28
		70	70	70	61	29
		71	71	71	62	29
		72	72	72	62	29
		73	73	73	62	29
		74	74	74	63	30
		75	75	75	64	30
		76	76	76	65	31
		77	77	77	66	31
		78	78	78	67	31
		79	79	79	67	32
		80	80	80	68	32
		81	81	81	69	33
		82	82	82	70	33
		83	83	83	71	33
		84	84	84	72	34
		85	85	85	73	34
		86	86	86	73	35
		87	87	87	74	35
		88	88	88	74	35
		89	89	89	75	35
		90	90	90	76	36
		91	91	91	77	36
		92	92	92	78	37
		93	93	93	78	37
		94	94	94	79	37
		95	95	95	80	38
		96	96	96	81	38
		97	97	97	82	39
		98	98	98	83	39
		99	99	99	84	39
		100	100	100	84	40
		101	101	101	85	40
		102	102	102	86	41
		103	103	103	87	41
		104	104	104	87	41
		105	105	105	88	41
		106	106	106	89	42
		107	107	107	89	42
		108	108	108	90	43
		109	109	109	91	43
		110	110	110	92	43
		111	111	111	93	44
		112	112	112	94	44
		113	113	113	95	45
		114	114	114	95	45
		115	115	115	96	45
		116	116	116	97	46
		117	117	117	98	46
		118	118	118	99	47
		119	119	119	100	47
		120	120	120	100	47
		121	121	121	100	47
		122	122	122	101	48
		123	123	123	102	48
		124	124	124	103	49
		125	125	125	104	49
		126	126	126	105	49
		127	127	127	105	50
		128	128	128	106	50
		129	129	129	114	54
		130	130	130	121	57
		131	131	131	129	61
		132	132	132	136	64
		133	133	133	144	68
		134	134	134	150	71
		135	135	135	159	75
		136	136	136	165	78
		137	137	137	174	82
		138	138	138	180	85
		139	139	139	189	89
		140	140	140	195	93
		141	141	141	204	97
		142	142	142	210	100
		143	143	143	218	104
		144	144	144	225	107
		145	145	145	233	111
		146	146	146	240	114
		147	147	147	248	118
		148	148	148	255	121
		149	149	149	263	125
		150	150	150	269	128
		151	151	151	278	132
		152	152	152	284	135
		153	153	153	293	139
		154	154	154	299	142
		155	155	155	308	146
		156	156	156	314	149
		157	157	157	323	153
		158	158	158	329	156
		159	159	159	337	160
		160	160	160	344	163
		161	161	161	354	167
		162	162	162	360	170
		163	163	163	368	175
		164	164	164	374	178
		165	165	165	382	182
		166	166	166	388	185
		167	167	167	396	189
		168	168	168	403	192
		169	169	169	411	196
		170	170	170	417	199
		171	171	171	425	203
		172	172	172	429	205
		173	173	173	437	209
		174	174	174	445	213
		175	175	175	454	217
		176	176	176	458	219
		177	177	177	466	223
		178	178	178	474	227
		179	179	179	482	231
		180	180	180	486	233
		181	181	181	494	237
		182	182	182	502	241
		183	183	183	510	245
		184	184	184	517	248
		185	185	185	524	252
		186	186	186	531	256
		187	187	187	538	259
		188	188	188	545	263
		189	189	189	552	266
		190	190	190	559	270
		191	191	191	566	273
		192	192	192	572	276
		193	193	193	582	281
		194	194	194	588	284
		195	195	195	594	287
		196	196	196	601	290
		197	197	197	610	295
		198	198	198	617	298
		199	199	199	625	302
		200	200	200	629	304
		201	201	201	638	309
		202	202	202	646	313
		203	203	203	651	315
		204	204	204	659	319
		205	205	205	668	324
		206	206	206	673	326
		207	207	207	682	330
		208	208	208	686	333
		209	209	209	695	337
		210	210	210	703	341
		211	211	211	711	345
		212	212	212	715	347
		213	213	213	723	351
		214	214	214	731	355
		215	215	215	739	359
		216	216	216	746	363
		217	217	217	750	365
		218	218	218	758	369
		219	219	219	766	372
		220	220	220	773	376
		221	221	221	781	380
		222	222	222	788	383
		223	223	223	795	387
		224	224	224	802	390
		225	225	225	809	394
		226	226	226	816	397
		227	227	227	823	401
		228	228	228	830	404
		229	229	229	838	408
		230	230	230	845	411
		231	231	231	852	415
		232	232	232	859	419
		233	233	233	866	422
		234	234	234	873	426
		235	235	235	880	429
		236	236	236	888	433
		237	237	237	895	436
		238	238	238	902	440
		239	239	239	909	443
		240	240	240	916	447
		241	241	241	923	450
		242	242	242	930	454
		243	243	243	937	457
		244	244	244	945	461
		245	245	245	952	465
		246	246	246	959	468
		247	247	247	966	472
		248	248	248	973	475
		249	249	249	980	479
		250	250	250	987	482
		251	251	251	994	486
		252	252	252	1002	489
		253	253	253	1009	493
		254	254	254	1016	496
		255	255	255	1023	500
	>;

	samsung,hbm_candela_map_table_revD = < /* THIS TABLE USED FOR DIMMING */
	/*   <idx>   <from>  <till>  <gm2_wrdisbv> <cd>  <auto>	*/
		0	256	256	0	505	0
		1	257	257	4	507	0
		2	258	258	8	509	0
		3	259	259	12	511	0
		4	260	260	16	513	0
		5	261	261	20	515	0
		6	262	262	24	517	0
		7	263	263	28	519	0
		8	264	264	32	521	0
		9	265	265	36	523	0
		10	266	266	40	525	0
		11	267	267	44	527	0
		12	268	268	48	529	0
		13	269	269	52	531	0
		14	270	270	56	533	0
		15	271	271	60	535	0
		16	272	272	64	536	0
		17	273	273	68	538	0
		18	274	274	72	540	0
		19	275	275	77	543	0
		20	276	276	81	545	0
		21	277	277	85	547	0
		22	278	278	89	549	0
		23	279	279	93	551	0
		24	280	280	97	552	0
		25	281	281	101	554	0
		26	282	282	105	556	0
		27	283	283	109	558	0
		28	284	284	113	560	0
		29	285	285	117	562	0
		30	286	286	121	564	0
		31	287	287	125	566	0
		32	288	288	129	568	0
		33	289	289	133	570	0
		34	290	290	137	572	0
		35	291	291	141	574	0
		36	292	292	145	576	0
		37	293	293	149	578	0
		38	294	294	153	580	0
		39	295	295	157	582	0
		40	296	296	161	584	0
		41	297	297	165	585	0
		42	298	298	169	587	0
		43	299	299	173	589	0
		44	300	300	177	591	0
		45	301	301	181	593	0
		46	302	302	185	595	0
		47	303	303	189	597	0
		48	304	304	193	599	0
		49	305	305	197	601	0
		50	306	306	201	603	0
		51	307	307	205	605	0
		52	308	308	209	607	0
		53	309	309	213	609	0
		54	310	310	217	611	0
		55	311	311	222	613	0
		56	312	312	226	615	0
		57	313	313	230	617	0
		58	314	314	234	619	0
		59	315	315	238	621	0
		60	316	316	242	623	0
		61	317	317	246	625	0
		62	318	318	250	627	0
		63	319	319	254	629	0
		64	320	320	258	631	0
		65	321	321	262	632	0
		66	322	322	266	634	0
		67	323	323	270	636	0
		68	324	324	274	638	0
		69	325	325	278	640	0
		70	326	326	282	642	0
		71	327	327	286	644	0
		72	328	328	290	646	0
		73	329	329	294	648	0
		74	330	330	298	650	0
		75	331	331	302	652	0
		76	332	332	306	654	0
		77	333	333	310	656	0
		78	334	334	314	658	0
		79	335	335	318	660	0
		80	336	336	322	662	0
		81	337	337	326	664	0
		82	338	338	330	665	0
		83	339	339	334	667	0
		84	340	340	338	669	0
		85	341	341	342	671	0
		86	342	342	346	673	0
		87	343	343	350	675	0
		88	344	344	354	677	0
		89	345	345	358	679	0
		90	346	346	362	681	0
		91	347	347	367	683	0
		92	348	348	371	685	0
		93	349	349	375	687	0
		94	350	350	379	689	0
		95	351	351	383	691	0
		96	352	352	387	693	0
		97	353	353	391	695	0
		98	354	354	395	697	0
		99	355	355	399	699	0
		100	356	356	403	701	0
		101	357	357	407	703	0
		102	358	358	411	705	0
		103	359	359	415	707	0
		104	360	360	419	709	0
		105	361	361	423	711	0
		106	362	362	427	712	0
		107	363	363	431	714	0
		108	364	364	435	716	0
		109	365	365	439	718	0
		110	366	366	443	720	0
		111	367	367	447	722	0
		112	368	368	451	724	0
		113	369	369	455	726	0
		114	370	370	459	728	0
		115	371	371	463	730	0
		116	372	372	467	732	0
		117	373	373	471	734	0
		118	374	374	475	736	0
		119	375	375	479	738	0
		120	376	376	483	740	0
		121	377	377	487	742	0
		122	378	378	491	743	0
		123	379	379	495	745	0
		124	380	380	499	747	0
		125	381	381	503	749	0
		126	382	382	507	751	0
		127	383	383	511	753	0
		128	384	384	516	756	0
		129	385	385	520	758	0
		130	386	386	524	759	0
		131	387	387	528	761	0
		132	388	388	532	763	0
		133	389	389	536	765	0
		134	390	390	540	767	0
		135	391	391	544	769	0
		136	392	392	548	771	0
		137	393	393	552	773	0
		138	394	394	556	775	0
		139	395	395	560	777	0
		140	396	396	564	779	0
		141	397	397	568	781	0
		142	398	398	572	783	0
		143	399	399	576	785	0
		144	400	400	580	787	0
		145	401	401	584	789	0
		146	402	402	588	791	0
		147	403	403	592	792	0
		148	404	404	596	794	0
		149	405	405	600	796	0
		150	406	406	604	798	0
		151	407	407	608	800	0
		152	408	408	612	802	0
		153	409	409	616	804	0
		154	410	410	620	806	0
		155	411	411	624	808	0
		156	412	412	628	810	0
		157	413	413	632	812	0
		158	414	414	636	814	0
		159	415	415	640	816	0
		160	416	416	644	818	0
		161	417	417	648	820	0
		162	418	418	652	822	0
		163	419	419	656	823	0
		164	420	420	661	826	0
		165	421	421	665	828	0
		166	422	422	669	830	0
		167	423	423	673	832	0
		168	424	424	677	834	0
		169	425	425	681	836	0
		170	426	426	685	838	0
		171	427	427	689	839	0
		172	428	428	693	841	0
		173	429	429	697	843	0
		174	430	430	701	845	0
		175	431	431	705	847	0
		176	432	432	709	849	0
		177	433	433	713	851	0
		178	434	434	717	853	0
		179	435	435	721	855	0
		180	436	436	725	857	0
		181	437	437	729	859	0
		182	438	438	733	861	0
		183	439	439	737	863	0
		184	440	440	741	865	0
		185	441	441	745	867	0
		186	442	442	749	869	0
		187	443	443	753	871	0
		188	444	444	757	872	0
		189	445	445	761	874	0
		190	446	446	765	876	0
		191	447	447	769	878	0
		192	448	448	773	880	0
		193	449	449	777	882	0
		194	450	450	781	884	0
		195	451	451	785	886	0
		196	452	452	789	888	0
		197	453	453	793	890	0
		198	454	454	797	892	0
		199	455	455	801	894	0
		200	456	456	806	896	0
		201	457	457	810	898	0
		202	458	458	814	900	0
		203	459	459	818	902	0
		204	460	460	822	904	0
		205	461	461	826	906	0
		206	462	462	830	908	0
		207	463	463	834	910	0
		208	464	464	838	912	0
		209	465	465	842	914	0
		210	466	466	846	916	0
		211	467	467	850	918	0
		212	468	468	854	919	0
		213	469	469	858	921	0
		214	470	470	862	923	0
		215	471	471	866	925	0
		216	472	472	870	927	0
		217	473	473	874	929	0
		218	474	474	878	931	0
		219	475	475	882	933	0
		220	476	476	886	935	0
		221	477	477	890	937	0
		222	478	478	894	939	0
		223	479	479	898	941	0
		224	480	480	902	943	0
		225	481	481	906	945	0
		226	482	482	910	947	0
		227	483	483	914	949	0
		228	484	484	918	951	0
		229	485	485	922	952	0
		230	486	486	926	954	0
		231	487	487	930	956	0
		232	488	488	934	958	0
		233	489	489	938	960	0
		234	490	490	942	962	0
		235	491	491	946	964	0
		236	492	492	951	967	0
		237	493	493	955	968	0
		238	494	494	959	970	0
		239	495	495	963	972	0
		240	496	496	967	974	0
		241	497	497	971	976	0
		242	498	498	975	978	0
		243	499	499	979	980	0
		244	500	500	983	982	0
		245	501	501	987	984	0
		246	502	502	991	986	0
		247	503	503	995	988	0
		248	504	504	999	990	0
		249	505	505	1003	992	0
		250	506	506	1007	994	0
		251	507	507	1011	996	0
		252	508	508	1015	998	0
		253	509	509	1019	999	0
		254	510	510	1023	1001	0
	>;

	samsung,aod_candela_map_table_revA = <
	/*   <idx>   <from>  <till>  <gm2_wrdisbv> <cd> */
		0	0	20	0	2
		1	21	74	0	10
		2	75	130	0	30
		3	131	255	0	60
	>;
};
