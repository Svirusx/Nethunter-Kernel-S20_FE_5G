/* Copyright (c) 2013-2014, The Linux Foundation. All rights reserved.
 *
 * This program is free software; you can redistribute it and/or modify
 * it under the terms of the GNU General Public License version 2 and
 * only version 2 as published by the Free Software Foundation.
 *
 * This program is distributed in the hope that it will be useful,
 * but WITHOUT ANY WARRANTY; without even the implied warranty of
 * MERCHANTABILITY or FITNESS FOR A PARTICULAR PURPOSE.  See the
 * GNU General Public License for more details.
 */

/*---------------------------------------------------------------------------
 * This file is autogenerated file using gcdb parser. Please do not edit it.
 * Update input XML file to add a new entry or update variable in this file
 * VERSION = "1.0"
 *---------------------------------------------------------------------------*/
&mdss_mdp {
	ss_dsi_panel_S6E3FA7_AMB623VH01_HD: ss_dsi_panel_S6E3FA7_AMB623VH01_HD {
		qcom,mdss-dsi-panel-name = "ss_dsi_panel_S6E3FA7_AMB623VH01_HD";
		label = "ss_dsi_panel_S6E3FA7_AMB623VH01_HD";
		/*qcom,mdss-dsi-panel-controller = <&mdss_dsi0>;*/
		qcom,mdss-dsi-bpp = <24>;
		qcom,mdss-dsi-underflow-color = <0xFF>;
		qcom,mdss-dsi-border-color = <0>;
		qcom,mdss-dsi-sec-bl-pmic-control-type = "bl_ctrl_dcs";

		qcom,mdss-dsi-bl-min-level = <1>;
		qcom,mdss-dsi-bl-max-level = <453>;
		qcom,mdss-brightness-max-level = <453>;
		qcom,mdss-brightness-default-level = <255>;

		qcom,mdss-dsi-interleave-mode = <0>;
		qcom,mdss-dsi-panel-type = "dsi_cmd_mode";

		qcom,mdss-dsi-te-check-enable;
		qcom,mdss-dsi-te-using-te-pin;
		qcom,mdss-dsi-te-pin-select = <1>;

		qcom,mdss-dsi-te-dcs-command = <1>;
		qcom,mdss-dsi-wr-mem-start = <0x2C>;
		qcom,mdss-dsi-wr-mem-continue = <0x3C>;

		/* CMD mode panel doesn't need below stuff */
		qcom,mdss-dsi-h-sync-pulse= <0>;
		/*qcom,mdss-dsi-hfp-power-mode=*/
		/*qcom,mdss-dsi-hbp-power-mode=*/
		/*qcom,mdss-dsi-hsa-power-mode=*/
		/*qcom,mdss-dsi-last-line-interleave=*/
		qcom,mdss-dsi-bllp-eof-power-mode;
		qcom,mdss-dsi-bllp-power-mode;
		qcom,mdss-dsi-traffic-mode= "burst_mode";

		qcom,mdss-dsi-pixel-packing = "loose";

		qcom,mdss-dsi-virtual-channel-id = <0>;
		qcom,mdss-dsi-color-order = "rgb_swap_rgb";
		qcom,mdss-dsi-lane-0-state;
		qcom,mdss-dsi-lane-1-state;
		qcom,mdss-dsi-lane-2-state;
		qcom,mdss-dsi-lane-3-state;

		qcom,mdss-dsi-stream = <0>;
		qcom,mdss-dsi-mdp-trigger = "none";
		qcom,mdss-dsi-dma-trigger = "trigger_sw";


		qcom,mdss-pan-physical-width-dimension = <53>;		/* 53.692mm, round-off */
		qcom,mdss-pan-physical-height-dimension = <148>;	/* 148.708mm, round-off */

		qcom,mdss-dsi-reset-sequence = <0 1>, <1 5>;


		qcom,mdss-dsi-rx-eot-ignore;
		qcom,mdss-dsi-tx-eot-append;

		/* HDR Setting */
		qcom,mdss-dsi-panel-hdr-enabled;
		qcom,mdss-dsi-panel-hdr-color-primaries = <15635 16450 34000 16000 13250 34500 7500 3000>;
		qcom,mdss-dsi-panel-peak-brightness = <4000000>;
		qcom,mdss-dsi-panel-average-brightness = <1200000>;
		qcom,mdss-dsi-panel-blackness-level = <5>;

		/*qcom,mdss-dsi-panel-status-command=*/
		/*qcom,mdss-dsi-panel-status-command-mode="dsi_lp_mode";*/
		qcom,esd-check-enabled;
		qcom,mdss-dsi-panel-status-check-mode ="irq_check";
		/*qcom,mdss-dsi-panel-status-value = <1>;*/
		/*qcom,mdss-dsi-panel-status-irq-trigger1="rising";*/
		qcom,mdss-dsi-panel-status-irq-trigger1 = "falling";

		/*qcom,dynamic-mode-switch-enabled;*/
		/*qcom,dynamic-mode-switch-type = "dynamic-resolution-switch-immediate";*/
		/*qcom,dynamic-mode-switch-enabled*/
		/*qcom,video-to-cmd-mode-switch-commands=*/
		/*qcom,cmd-to-video-mode-switch-commands=*/


/*
 * ************************************************************************************************************************************
 *
 *
 *			for log debug
 *
 *
 * ************************************************************************************************************************************
 */
		samsung,ldi_log_disable_tx_cmds_revA = [
			29 01 00 00 00 00 02 F2 00			/* DDI Log Disable */
		];

		samsung,ldi_log_enable_tx_cmds_revA = [
			29 01 00 00 00 00 02 F2 13			/* DDI Log Enable */
		];

		samsung,ldi_log_rx_cmds_revA		= [06 01 00 00 00 00 01 9C 80 00];

/*
 * ************************************************************************************************************************************
 *
 *
 *			Below  parameters are samsung dependent thigs
 *
 *
 * ************************************************************************************************************************************
 */
		samsung,panel-vendor = "SDC";
		samsung,disp-model = "AMB623VH01";
		samsung,panel-lpm-enable;
		samsung,support_irc;
		samsung,elvss_interpolation_temperature = <(-15)>;
		samsung,support_factory_panel_swap;
		/*samsung,support_gct;*/
		samsung,esc-clk-128M;
		samsung,support_gamma_mode2;
		samsung,support_gpara;

/* *************************************************************
 * TEST MODE
 * **************************************************************
 */
		samsung,mcd_on_tx_cmds_revA = [
			29 00 00 00 00 00 03 F0 5A 5A	/* TEST KEY2 Enable */
			29 00 00 00 00 00 02 B0 06
			29 01 00 00 64 00 02 F6 00		/* Delay 100ms */
			29 00 00 00 00 00 17 CB			/* LTPS Setting */
				08 08 01 01 01 09 67 89 00 00 0F 02 00 00 00 00
				00 00 27 68 00 00 
			29 00 00 00 00 00 02 B0 20
			29 00 00 00 00 00 0A CB
				00 00 00 00 00 00 00 0B 59 
			29 00 00 00 00 00 02 B0 29
			29 00 00 00 00 00 2B CB
				00 2A D8 D7 13 15 C4 91 05 C2 C0 00 00 00 C0 C0 F8 F7
				33 F5 E4 F1 05 02 00 00 00 00 20 80 00 00 0F 02 
				00 00 00 00 13 34 00 00
			29 00 00 00 00 00 02 B0 55
			29 00 00 00 00 00 03 CB 00 00
			29 00 00 00 00 00 02 B0 5D
			29 00 00 00 00 00 03 CB 05 79
			29 00 00 00 00 00 02 F7 03	
			29 01 00 00 00 00 03 F0 A5 A5	/* TEST KEY2 Disable */
		];

		samsung,mcd_off_tx_cmds_revA = [
			29 00 00 00 00 00 03 9F A5 A5	/* TEST KEY0 Enable */
			29 00 00 00 00 00 03 F0 5A 5A	/* TEST KEY2 Enable */
			05 01 00 00 14 00 01 11		/* Sleep out, wait 20ms */
			29 00 00 00 00 00 10 B9
				00 00 14 00 18 00 00 00 00 11 03 02 40 02 40		/* TSP SYNC Enable */			
			29 00 00 00 00 00 14 C5
				09 10 C8 1D EE 0F 26 37 24 D2 7A 77 73 00 FF 78 8B 08 00		/* FFC setting 1116Mbps*/
			29 00 00 00 00 00 02 F7 03	/* gamma update */
			29 00 00 00 00 00 03 F0 A5 A5	/* TEST KEY2 Disable */
			29 01 00 00 00 00 03 9F 5A 5A	/* TEST KEY0 Enable */
		];
		samsung,gray_spot_test_on_tx_cmds_revA = [
			29 00 00 00 00 00 03 F0 5A 5A	/* TEST KEY2 Enable */
			29 00 00 00 00 00 02 B0 06
			29 00 00 00 00 00 02 F6 00
			29 00 00 00 00 00 02 B0 08
			29 00 00 00 00 00 02 F2 00
			29 00 00 00 00 00 02 B5 19
			29 00 00 00 00 00 02 B0 16
			29 00 00 00 00 00 02 B5 1F
			29 01 00 00 64 00 02 F7 03	/* gamma update & Delay 100ms */
			29 01 00 00 00 00 03 F0 A5 A5	/* TEST KEY2 Disable */
		];

		samsung,gray_spot_test_off_tx_cmds_revA = [
			29 00 00 00 00 00 03 F0 5A 5A	/* TEST KEY2 Enable */
			29 00 00 00 00 00 02 B0 06
			29 00 00 00 00 00 02 F6 8E
			29 00 00 00 00 00 02 B0 08
			29 00 00 00 00 00 02 F2 CC
			29 00 00 00 00 00 02 B5 19
			29 00 00 00 00 00 02 B0 16
			29 00 00 00 00 00 02 B5 00
			29 01 00 00 64 00 02 F7 03	/* gamma update & Delay 100ms */
			29 01 00 00 00 00 03 F0 A5 A5	/* TEST KEY2 Disable */
		];

		samsung,gray_spot_rx_cmds_revA= [06 01 00 00 00 00 01 B5 01 16];

		/* Micro Crack Test */
		samsung,micro_short_test_on_tx_cmds_revA = [
			29 00 00 00 00 00 03 F0 5A 5A
			29 00 00 00 00 00 02 B0 04
			29 00 00 00 00 00 04 F6 22 30 58
			29 00 00 00 00 00 03 BF 33 25
			29 01 00 00 00 00 03 F0 A5 A5
		];

		samsung,micro_short_test_off_tx_cmds_revA = [
			29 00 00 00 00 00 03 F0 5A 5A
			29 00 00 00 00 00 02 B0 04
			29 00 00 00 00 00 04 F6 2A 30 8E
			29 00 00 00 00 00 03 BF 00 07
			29 01 00 00 00 00 03 F0 A5 A5
		];

		/*
		* ************************************************************************************************************************
		*  Tx
		* ************************************************************************************************************************
		*/

		samsung,level0_key_enable_tx_cmds_revA	= [29 01 00 00 00 00 03 9F A5 A5]; /* PASSWD0 */
		samsung,level0_key_disable_tx_cmds_revA	= [29 01 00 00 00 00 03 9F 5A 5A]; /* PASSWD0 */
		samsung,level1_key_enable_tx_cmds_revA	= [29 01 00 00 00 00 03 F0 5A 5A]; /* PASSWD1 */
		samsung,level1_key_disable_tx_cmds_revA	= [29 01 00 00 00 00 03 F0 A5 A5]; /* PASSWD1 */
		samsung,level2_key_enable_tx_cmds_revA	= [29 01 00 00 00 00 03 FC 5A 5A];
		samsung,level2_key_disable_tx_cmds_revA	= [29 01 00 00 00 00 03 FC A5 A5];

		/* BRIGHTNESS_MAX_PACKET = 50 */
		samsung,brightness_tx_cmds_revA = [
			39 01 00 00 00 00 01 00
			39 01 00 00 00 00 01 00
			39 01 00 00 00 00 01 00
			39 01 00 00 00 00 01 00
			39 01 00 00 00 00 01 00
			39 01 00 00 00 00 01 00
			39 01 00 00 00 00 01 00
			39 01 00 00 00 00 01 00
			39 01 00 00 00 00 01 00
			39 01 00 00 00 00 01 00
			39 01 00 00 00 00 01 00
			39 01 00 00 00 00 01 00
			39 01 00 00 00 00 01 00
			39 01 00 00 00 00 01 00
			39 01 00 00 00 00 01 00
			39 01 00 00 00 00 01 00
			39 01 00 00 00 00 01 00
			39 01 00 00 00 00 01 00
			39 01 00 00 00 00 01 00
			39 01 00 00 00 00 01 00
			39 01 00 00 00 00 01 00
			39 01 00 00 00 00 01 00
			39 01 00 00 00 00 01 00
			39 01 00 00 00 00 01 00
			39 01 00 00 00 00 01 00
			39 01 00 00 00 00 01 00
			39 01 00 00 00 00 01 00
			39 01 00 00 00 00 01 00
			39 01 00 00 00 00 01 00
			39 01 00 00 00 00 01 00
			39 01 00 00 00 00 01 00
			39 01 00 00 00 00 01 00
			39 01 00 00 00 00 01 00
			39 01 00 00 00 00 01 00
			39 01 00 00 00 00 01 00
			39 01 00 00 00 00 01 00
			39 01 00 00 00 00 01 00
			39 01 00 00 00 00 01 00
			39 01 00 00 00 00 01 00
			39 01 00 00 00 00 01 00
			39 01 00 00 00 00 01 00
			39 01 00 00 00 00 01 00
			39 01 00 00 00 00 01 00
			39 01 00 00 00 00 01 00
			39 01 00 00 00 00 01 00
			39 01 00 00 00 00 01 00
			39 01 00 00 00 00 01 00
			39 01 00 00 00 00 01 00
			39 01 00 00 00 00 01 00
			39 01 00 00 00 00 01 00
		];

		/* use poinging gpara (long write) */
		samsung,reg_read_pos_tx_cmds_revA = [
			29 00 00 00 00 00 03 B0 00 00
		];

		samsung,display_on_tx_cmds_revA = [
			29 01 00 00 00 00 03 9F A5 A5		/* LV1 (9F) unlock */
			05 01 00 00 00 00 01 29
			29 01 00 00 00 00 03 9F 5A 5A		/* LV1 (9F) lock */
		];

		samsung,display_off_tx_cmds_revA = [05 01 00 00 00 00 02 28 00];

		/* *************************************************************
		 *  Rx (Module Information READ)
		 * *************************************************************
		 */

		samsung,mdnie_read_rx_cmds_revA		= [06 01 00 00 00 00 01 A1 04 00]; /* White color position */
		samsung,manufacture_date_rx_cmds_revA	= [06 01 00 00 00 00 01 CB 04 16]; /* manufacture data 4 byte*/
		samsung,cell_id_rx_cmds_revA		= [06 01 00 00 00 00 01 CB 07 16]; /* manufacture data 7 byte*/
		samsung,octa_id_rx_cmds_revA		= [06 01 00 00 00 00 01 A1 04 04]; /* manufacture information A1h 5~8*/
		samsung,octa_id1_rx_cmds_revA		= [06 01 00 00 00 00 01 CB 03 1D]; /* manufacture information CBh 30~32*/
		samsung,octa_id2_rx_cmds_revA		= [06 01 00 00 00 00 01 CB 02 29]; /* manufacture information CBh 42~43*/
		samsung,octa_id3_rx_cmds_revA		= [06 01 00 00 00 00 01 CB 02 53]; /* manufacture information CBh 84~85*/
		samsung,octa_id4_rx_cmds_revA		= [06 01 00 00 00 00 01 CB 06 57]; /* manufacture information CBh 88~93*/
		samsung,octa_id5_rx_cmds_revA		= [06 01 00 00 00 00 01 B5 03 08]; /* manufacture information B5h 9~11*/
		samsung,ddi_id_rx_cmds_revA		= [06 01 00 00 00 00 01 D6 05 00];	/* CHIP ID */

		samsung,manufacture_id0_rx_cmds_revA = [ 06 01 00 00 00 00 01 da 01 00];
		samsung,manufacture_id1_rx_cmds_revA = [ 06 01 00 00 00 00 01 db 01 00];
		samsung,manufacture_id2_rx_cmds_revA = [ 06 01 00 00 00 00 01 dc 01 00];

		samsung,ldi_debug0_rx_cmds_revA		= [06 01 00 00 00 00 01 0A 01 00];
	/*	samsung,ldi_debug1_rx_cmds_revA		= [06 01 00 00 00 00 01 ED 01 00]; */
	/*	samsung,ldi_debug2_rx_cmds_revA		= [06 01 00 00 00 00 01 EE 01 00]; */
	/*	samsung,ldi_debug3_rx_cmds_revA		= [06 01 00 00 00 00 01 0E 01 00]; */
	/*	samsung,ldi_debug4_rx_cmds_revA		= [06 01 00 00 00 00 01 05 01 00]; */
	/*	samsung,ldi_debug5_rx_cmds_revA		= [06 01 00 00 00 00 01 0F 01 00]; */

		samsung,mtp_read_sysfs_rx_cmds_revA	= [06 01 00 00 00 00 01 00 00 00];

		samsung,mtp_write_sysfs_tx_cmds_revA	= [
			29 00 00 00 00 00 3D 00
						00 00 00 00 00 00 00 00 00 00
						00 00 00 00 00 00 00 00 00 00
						00 00 00 00 00 00 00 00 00 00
						00 00 00 00 00 00 00 00 00 00
						00 00 00 00 00 00 00 00 00 00
						00 00 00 00 00 00 00 00 00 00
		];

		/* *************************************************************
		 *  SELF DISPLAY
		 * *************************************************************
		 */
		samsung,support_self_display;
		ss,self_display = <&self_display_FA7_AMB623VH01_dtsi>;

		/*
		*************************************************************************************************************************
		* Self mask check debug (SELF MASK CHECK)
		*************************************************************************************************************************
		*/

		samsung,mask_crc_pass_data = [B5 B9 00 BF E4 A4 80 70];

		/* *************************************************************
		 *  COPR
		 * *************************************************************
		 */

		samsung,copr_enable_tx_cmds_revA = [
			29 00 00 00 00 00 03 F0 5A 5A
			29 00 00 00 00 00 10 E1 
				03 14 44 55 67 00 03 0A A5 00 39 02 C7 00 5B
			29 01 00 00 00 00 03 F0 A5 A5
		];

		samsung,copr_disable_tx_cmds_revA = [
			29 00 00 00 00 00 03 F0 5A 5A
			29 00 00 00 00 00 02 E1 00
			29 01 00 00 00 00 03 F0 A5 A5
		];

		/* *************************************************************
		 * ACL command list and mappings
		 * **************************************************************
		 */
		samsung,acl_on_tx_cmds_revA = [
			/*
			* B4 Register Setting Guide
			* 2nd (16 Frame Avg at ACL Off) : 44
			* 3rd~4th (start point 50%) : 40 FF
			* 6th (ACL 8) : 0x26 ACL 8%
			*/
			29 01 00 00 00 00 0E B4 50 40 FC 48 29 9C 55 55 55 3F B7 12 50
			29 01 00 00 00 00 02 55 02	/* ACL ON */
		];
		samsung,acl_off_tx_cmds_revA = [
			29 01 00 00 00 00 0E B4 40 40 FC 48 29 9C 55 55 55 3F B7 12 40
			29 01 00 00 00 00 02 55 00	/* ACL OFF */
		];

		/* *************************************************************
		 * Dynamic MIPI Clock
		 * **************************************************************
		 */
		samsung,support_dynamic_mipi_clk;

		samsung,ffc_tx_cmds_revA = [
			29 00 00 00 00 00 03 F0 5A 5A			/* TEST KEY3 Enable*/
			29 00 00 00 00 00 14 C5
				09 10 C8 1D EE 0F 26 37 24 D2 7A 77 73 00 FF 78 8B 08 00		/* FFC setting 1116Mbps*/
			29 00 00 00 00 00 03 F0 A5 A5			/* TEST KEY3 Disable*/
		];

		samsung,dyn_mipi_clk_ffc_cmds_revA = [
			29 00 00 00 00 00 14 C5
				09 10 C8 1D EE 0F 26 37 24 D2 7A 77 73 00 FF 78 8B 08 00		/* FFC setting 1116Mbps*/
			29 00 00 00 00 00 14 C5
				09 10 C8 1D B0 0F 26 37 24 D2 7A 77 73 00 FF 78 8B 08 00		/* FFC setting 1125Mbps*/
			29 00 00 00 00 00 14 C5
				09 10 C8 1D EE 0F 26 37 24 D2 7A 77 73 00 FF 78 8B 08 00		/* FFC setting 1116Mbps*/
			29 00 00 00 00 00 14 C5
				09 10 C8 1E 48 10 26 37 24 D2 7A 77 73 00 FF 78 8B 08 00		/* FFC setting 1103Mbps*/
		];

		samsung,dynamic_mipi_clk_timing_table = <
			/*<bitclk><>*/
			1116000000 /* clk id 0 default */
			1125000000 /* clk id 1 */
			1116000000 /* clk id 2 */
			1103000000 /* clk id 3 */
		>;

		samsung,dynamic_mipi_clk_sel_table = <
			/*<RAT><BAND><from><end><clk index>*/
			1	1	0	0	1
			1	2	0	0	2
			1	3	0	0	3
			1	4	0	0	1
			2	11	10562	10581	3
			2	11	10582	10652	1
			2	11	10653	10706	2
			2	11	10707	10720	3
			2	11	10721	10793	1
			2	11	10794	10838	2
			2	12	9662	9668	1
			2	12	9669	9729	2
			2	12	9730	9738	3
			2	12	9739	9808	1
			2	12	9809	9869	2
			2	12	9870	9878	3
			2	12	9879	9938	1
			2	13	1162	1230	1
			2	13	1231	1296	2
			2	13	1297	1300	3
			2	13	1301	1371	1
			2	13	1372	1436	2
			2	13	1437	1441	3
			2	13	1442	1513	1
			2	14	1537	1556	3
			2	14	1557	1627	1
			2	14	1628	1681	2
			2	14	1682	1695	3
			2	14	1696	1738	1
			2	15	4357	4394	2
			2	15	4395	4458	1
			2	17	2237	2308	1
			2	17	2309	2360	2
			2	17	2361	2449	1
			2	17	2450	2500	2
			2	17	2501	2563	1
			2	18	2937	2975	2
			2	18	2976	3046	1
			2	18	3047	3077	3
			2	18	3078	3088	2
			3	91	0	33	2
			3	91	34	62	3
			3	91	63	204	1
			3	91	205	312	2
			3	91	313	341	3
			3	91	342	486	1
			3	91	487	591	2
			3	91	592	599	3
			3	92	600	636	1
			3	92	637	759	2
			3	92	760	776	3
			3	92	777	917	1
			3	92	918	1038	2
			3	92	1039	1057	3
			3	92	1058	1199	1
			3	93	1200	1214	2
			3	93	1215	1219	3
			3	93	1220	1361	1
			3	93	1362	1493	2
			3	93	1494	1501	3
			3	93	1502	1642	1
			3	93	1643	1772	2
			3	93	1773	1782	3
			3	93	1783	1923	1
			3	93	1924	1949	2
			3	94	1950	1983	2
			3	94	1984	2012	3
			3	94	2013	2154	1
			3	94	2155	2262	2
			3	94	2263	2291	3
			3	94	2292	2399	1
			3	95	2400	2428	3
			3	95	2429	2498	2
			3	95	2499	2639	1
			3	95	2640	2649	3
			3	97	2750	2917	1
			3	97	2918	3021	2
			3	97	3022	3198	1
			3	97	3199	3301	2
			3	97	3302	3449	1
			3	98	3450	3476	3
			3	98	3477	3551	2
			3	98	3552	3692	1
			3	98	3693	3755	3
			3	98	3756	3799	2
			3	102	5010	5043	3
			3	102	5044	5102	2
			3	102	5103	5179	1
			3	103	5180	5243	1
			3	103	5244	5279	3
			3	104	5280	5302	3
			3	104	5303	5363	2
			3	104	5364	5379	1
			3	107	5730	5772	2
			3	107	5773	5849	1
			3	108	5850	5898	1
			3	108	5899	5968	3
			3	108	5969	5999	2
			3	109	6000	6038	2
			3	109	6039	6149	1
			3	110	6150	6184	2
			3	110	6185	6326	1
			3	110	6327	6400	3
			3	110	6401	6449	2
			3	111	6450	6467	2
			3	111	6468	6599	1
			3	115	8040	8076	1
			3	115	8077	8199	2
			3	115	8200	8216	3
			3	115	8217	8357	1
			3	115	8358	8478	2
			3	115	8479	8497	3
			3	115	8498	8638	1
			3	115	8639	8689	2
			3	116	8690	8748	1
			3	116	8749	8818	3
			3	116	8819	8888	2
			3	116	8889	9029	1
			3	116	9030	9039	3
			3	118	9210	9232	3
			3	118	9233	9293	2
			3	118	9294	9434	1
			3	118	9435	9511	3
			3	118	9512	9574	2
			3	118	9575	9659	1
			3	119	9660	9732	1
			3	119	9733	9769	3
			3	120	9770	9824	1
			3	120	9825	9869	2
			3	122	9920	9966	1
			3	122	9967	10094	2
			3	122	10095	10246	1
			3	122	10247	10359	2
			3	124	36200	36280	1
			3	124	36281	36349	2
			3	128	37750	37854	1
			3	128	37855	37960	2
			3	128	37961	38136	1
			3	128	38137	38249	2
			3	129	38250	38351	2
			3	129	38352	38363	3
			3	129	38364	38504	1
			3	129	38505	38630	2
			3	129	38631	38644	3
			3	129	38645	38649	1
			3	130	38650	38736	2
			3	130	38737	38762	3
			3	130	38763	38923	1
			3	130	38924	39015	2
			3	130	39016	39041	3
			3	130	39042	39204	1
			3	130	39205	39319	2
			3	130	39320	39486	1
			3	130	39487	39600	2
			3	130	39601	39649	1
			3	131	39650	39760	2
			3	131	39761	39932	1
			3	131	39933	40040	2
			3	131	40041	40213	1
			3	131	40214	40320	2
			3	131	40321	40494	1
			3	131	40495	40600	2
			3	131	40601	40776	1
			3	131	40777	40881	2
			3	131	40882	41057	1
			3	131	41058	41161	2
			3	131	41162	41338	1
			3	131	41339	41441	2
			3	131	41442	41589	1
			3	132	41590	41691	3
			3	132	41692	41832	1
			3	132	41833	41845	2
			3	132	41846	41972	3
			3	132	41973	42113	1
			3	132	42114	42122	2
			3	132	42123	42253	3
			3	132	42254	42400	1
			3	132	42401	42535	3
			3	132	42536	42678	1
			3	132	42679	42816	3
			3	132	42817	42957	1
			3	132	42958	43092	3
			3	132	43093	43238	1
			3	132	43239	43370	3
			3	132	43371	43520	1
			3	132	43521	43589	3
			3	138	55240	55388	1
			3	138	55389	55520	3
			3	138	55521	55670	1
			3	138	55671	55797	3
			3	138	55798	55951	1
			3	138	55952	56080	3
			3	138	56081	56232	1
			3	138	56233	56352	3
			3	138	56353	56372	2
			3	138	56373	56513	1
			3	138	56514	56629	3
			3	138	56630	56653	2
			3	138	56654	56739	1
			3	156	66436	66469	2
			3	156	66470	66498	3
			3	156	66499	66640	1
			3	156	66641	66748	2
			3	156	66749	66777	3
			3	156	66778	66922	1
			3	156	66923	67027	2
			3	156	67028	67056	3
			3	156	67057	67203	1
			3	156	67204	67306	2
			3	156	67307	67335	3
			3	161	68586	68623	3
			3	161	68624	68673	2
			3	161	68674	68821	1
			3	161	68822	68902	3
			3	161	68903	68935	2
			4	51	0	0	1
			4	52	0	0	2
			4	53	0	0	1
			4	54	0	0	1
			4	55	0	0	3
			4	56	0	0	1
			5	61	0	0	3
			5	62	0	0	1
			5	71	0	0	1
			7	260	173800	174700	3
			7	260	174701	176440	2
			7	260	176441	178220	1
			7	260	178221	178780	3
			7	263	185000	185800	3
			7	263	185801	187660	2
			7	263	187661	189360	1
			7	263	189361	190620	3
			7	263	190621	191980	2
			7	283	151600	152520	3
			7	283	152521	154040	2
			7	283	154041	155940	1
			7	283	155941	158060	3
			7	283	158061	159640	2
			7	283	159641	160580	1
			7	326	123400	124780	3
			7	326	124781	126020	2
			7	326	126021	128100	1
			7	326	128101	130380	3
		>;

		/* *************************************************************
		 *  COPR
		 * *************************************************************
		 */

		/* *************************************************************
		 * candela to index mappings
		 * **************************************************************
		 */
		samsung,candela_map_table_revA = < /* THIS TABLE USED FOR DIMMING */
		/* <idx> <from> <till> <gm2_wrdisbv> <cd> */
			0	0	0	9	2
			1	1	1	11	2
			2	2	2	13	3
			3	3	3	15	3
			4	4	4	18	4
			5	5	5	21	5
			6	6	6	25	5
			7	7	7	28	6
			8	8	8	31	7
			9	9	9	35	8
			10	10	10	39	9
			11	11	11	43	10
			12	12	12	49	10
			13	13	13	52	11
			14	14	14	56	12
			15	15	15	60	13
			16	16	16	65	14
			17	17	17	71	15
			18	18	18	74	16
			19	19	19	80	17
			20	20	20	87	18
			21	21	21	89	19
			22	22	22	90	21
			23	23	23	98	22
			24	24	24	103	23
			25	25	25	109	24
			26	26	26	114	25
			27	27	27	119	26
			28	28	28	124	27
			29	29	29	130	29
			30	30	30	135	30
			31	31	31	141	31
			32	32	32	146	32
			33	33	33	152	33
			34	34	34	157	35
			35	35	35	163	36
			36	36	36	169	37
			37	37	37	175	38
			38	38	38	181	40
			39	39	39	186	41
			40	40	40	192	42
			41	41	41	198	44
			42	42	42	204	45
			43	43	43	210	46
			44	44	44	217	48
			45	45	45	223	49
			46	46	46	229	50
			47	47	47	235	52
			48	48	48	241	53
			49	49	49	248	54
			50	50	50	254	56
			51	51	51	261	57
			52	52	52	267	59
			53	53	53	273	60
			54	54	54	280	62
			55	55	55	286	63
			56	56	56	293	64
			57	57	57	300	66
			58	58	58	306	67
			59	59	59	313	69
			60	60	60	320	70
			61	61	61	326	72
			62	62	62	333	73
			63	63	63	340	75
			64	64	64	347	76
			65	65	65	354	78
			66	66	66	361	79
			67	67	67	368	81
			68	68	68	375	82
			69	69	69	382	84
			70	70	70	389	85
			71	71	71	396	87
			72	72	72	403	89
			73	73	73	410	90
			74	74	74	417	92
			75	75	75	424	93
			76	76	76	431	95
			77	77	77	439	96
			78	78	78	446	98
			79	79	79	453	100
			80	80	80	461	101
			81	81	81	468	103
			82	82	82	475	105
			83	83	83	483	106
			84	84	84	490	108
			85	85	85	498	109
			86	86	86	505	111
			87	87	87	513	113
			88	88	88	520	114
			89	89	89	528	116
			90	90	90	535	118
			91	91	91	543	119
			92	92	92	551	121
			93	93	93	558	123
			94	94	94	566	124
			95	95	95	574	126
			96	96	96	581	128
			97	97	97	589	130
			98	98	98	597	131
			99	99	99	605	133
			100	100	100	613	135
			101	101	101	620	136
			102	102	102	628	138
			103	103	103	636	140
			104	104	104	644	142
			105	105	105	652	143
			106	106	106	660	145
			107	107	107	668	147
			108	108	108	676	149
			109	109	109	684	150
			110	110	110	692	152
			111	111	111	700	154
			112	112	112	708	156
			113	113	113	716	158
			114	114	114	725	159
			115	115	115	733	161
			116	116	116	741	163
			117	117	117	749	165
			118	118	118	757	167
			119	119	119	766	168
			120	120	120	774	170
			121	121	121	782	172
			122	122	122	791	174
			123	123	123	799	176
			124	124	124	807	177
			125	125	125	816	179
			126	126	126	824	181
			127	127	127	832	183
			128	128	128	841	185
			129	129	129	849	187
			130	130	130	858	189
			131	131	131	866	190
			132	132	132	875	192
			133	133	133	883	194
			134	134	134	892	196
			135	135	135	901	198
			136	136	136	909	200
			137	137	137	918	202
			138	138	138	926	204
			139	139	139	935	206
			140	140	140	944	207
			141	141	141	952	209
			142	142	142	961	211
			143	143	143	970	213
			144	144	144	979	215
			145	145	145	987	217
			146	146	146	996	219
			147	147	147	1005	221
			148	148	148	1014	223
			149	149	149	1023	225
			150	150	150	1031	227
			151	151	151	1040	229
			152	152	152	1049	231
			153	153	153	1058	233
			154	154	154	1067	235
			155	155	155	1076	237
			156	156	156	1085	239
			157	157	157	1094	240
			158	158	158	1103	242
			159	159	159	1112	244
			160	160	160	1121	246
			161	161	161	1130	248
			162	162	162	1139	250
			163	163	163	1148	252
			164	164	164	1157	254
			165	165	165	1166	256
			166	166	166	1175	258
			167	167	167	1185	260
			168	168	168	1194	262
			169	169	169	1203	264
			170	170	170	1212	266
			171	171	171	1221	268
			172	172	172	1230	271
			173	173	173	1240	273
			174	174	174	1249	275
			175	175	175	1258	277
			176	176	176	1268	279
			177	177	177	1277	281
			178	178	178	1286	283
			179	179	179	1296	285
			180	180	180	1305	287
			181	181	181	1314	289
			182	182	182	1324	291
			183	183	183	1333	293
			184	184	184	1342	295
			185	185	185	1352	297
			186	186	186	1361	299
			187	187	187	1371	301
			188	188	188	1380	303
			189	189	189	1390	306
			190	190	190	1399	308
			191	191	191	1409	310
			192	192	192	1418	312
			193	193	193	1428	314
			194	194	194	1437	316
			195	195	195	1447	318
			196	196	196	1457	320
			197	197	197	1466	322
			198	198	198	1476	324
			199	199	199	1485	327
			200	200	200	1495	329
			201	201	201	1505	331
			202	202	202	1514	333
			203	203	203	1524	335
			204	204	204	1534	337
			205	205	205	1544	339
			206	206	206	1553	341
			207	207	207	1563	344
			208	208	208	1573	346
			209	209	209	1583	348
			210	210	210	1592	350
			211	211	211	1602	352
			212	212	212	1612	354
			213	213	213	1622	357
			214	214	214	1632	359
			215	215	215	1642	361
			216	216	216	1651	363
			217	217	217	1661	365
			218	218	218	1671	367
			219	219	219	1681	370
			220	220	220	1691	372
			221	221	221	1701	374
			222	222	222	1711	376
			223	223	223	1721	378
			224	224	224	1731	381
			225	225	225	1741	383
			226	226	226	1751	385
			227	227	227	1761	387
			228	228	228	1771	389
			229	229	229	1781	392
			230	230	230	1791	394
			231	231	231	1801	396
			232	232	232	1811	398
			233	233	233	1821	400
			234	234	234	1832	403
			235	235	235	1842	405
			236	236	236	1852	407
			237	237	237	1862	409
			238	238	238	1872	412
			239	239	239	1882	414
			240	240	240	1893	416
			241	241	241	1903	418
			242	242	242	1913	421
			243	243	243	1923	423
			244	244	244	1933	425
			245	245	245	1944	427
			246	246	246	1954	430
			247	247	247	1964	432
			248	248	248	1975	434
			249	249	249	1985	436
			250	250	250	1995	439
			251	251	251	2006	441
			252	252	252	2016	443
			253	253	253	2026	445
			254	254	254	2037	448
			255	255	255	2047	450
		>;

		samsung,hbm_candela_map_table_revA = <
		/* <idx> <from> <till> <aor> <cd> <auto> */
			0	256	256	1288	486	0
			1	257	257	1285	487	0
			2	258	258	1282	488	0
			3	259	259	1279	489	0
			4	260	260	1276	490	0
			5	261	261	1273	491	0
			6	262	262	1270	492	0
			7	263	263	1267	493	0
			8	264	264	1264	494	0
			9	265	265	1262	495	0
			10	266	266	1259	496	0
			11	267	267	1256	497	0
			12	268	268	1253	498	0
			13	269	269	1250	499	0
			14	270	270	1247	500	0
			15	271	271	1244	501	0
			16	272	272	1241	502	0
			17	273	273	1238	503	0
			18	274	274	1235	504	0
			19	275	275	1232	505	0
			20	276	276	1230	506	0
			21	277	277	1227	507	0
			22	278	278	1224	508	0
			23	279	279	1221	509	0
			24	280	280	1218	510	0
			25	281	281	1215	511	0
			26	282	282	1212	512	0
			27	283	283	1209	513	0
			28	284	284	1206	514	0
			29	285	285	1203	515	0
			30	286	286	1200	516	0
			31	287	287	1197	517	0
			32	288	288	1195	518	0
			33	289	289	1192	519	0
			34	290	290	1189	520	0
			35	291	291	1186	521	0
			36	292	292	1183	522	0
			37	293	293	1180	523	0
			38	294	294	1177	524	0
			39	295	295	1174	525	0
			40	296	296	1171	526	0
			41	297	297	1168	527	0
			42	298	298	1165	528	0
			43	299	299	1163	529	0
			44	300	300	1160	530	0
			45	301	301	1157	531	0
			46	302	302	1154	532	0
			47	303	303	1151	533	0
			48	304	304	1148	534	0
			49	305	305	1145	535	0
			50	306	306	1139	537	0
			51	307	307	1133	539	0
			52	308	308	1130	540	0
			53	309	309	1125	542	0
			54	310	310	1119	544	0
			55	311	311	1113	546	0
			56	312	312	1110	547	0
			57	313	313	1104	549	0
			58	314	314	1098	551	0
			59	315	315	1093	553	0
			60	316	316	1090	554	0
			61	317	317	1084	556	0
			62	318	318	1078	558	0
			63	319	319	1075	559	0
			64	320	320	1069	561	0
			65	321	321	1063	563	0
			66	322	322	1058	565	0
			67	323	323	1055	566	0
			68	324	324	1049	568	0
			69	325	325	1043	570	0
			70	326	326	1037	572	0
			71	327	327	1034	573	0
			72	328	328	1029	575	0
			73	329	329	1023	577	0
			74	330	330	1017	579	0
			75	331	331	1014	580	0
			76	332	332	1008	582	0
			77	333	333	1002	584	0
			78	334	334	996	586	0
			79	335	335	994	587	0
			80	336	336	988	589	0
			81	337	337	982	591	0
			82	338	338	979	592	0
			83	339	339	973	594	0
			84	340	340	967	596	0
			85	341	341	962	598	0
			86	342	342	959	599	0
			87	343	343	953	601	0
			88	344	344	947	603	0
			89	345	345	941	605	0
			90	346	346	938	606	0
			91	347	347	932	608	0
			92	348	348	927	610	0
			93	349	349	921	612	0
			94	350	350	918	613	0
			95	351	351	912	615	0
			96	352	352	906	617	0
			97	353	353	903	618	0
			98	354	354	897	620	0
			99	355	355	892	622	0
			100	356	356	886	624	0
			101	357	357	883	625	0
			102	358	358	877	627	0
			103	359	359	871	629	0
			104	360	360	865	631	0
			105	361	361	862	632	0
			106	362	362	857	634	0
			107	363	363	851	636	0
			108	364	364	848	637	0
			109	365	365	842	639	0
			110	366	366	836	641	0
			111	367	367	830	643	0
			112	368	368	825	645	0
			113	369	369	822	646	0
			114	370	370	816	648	0
			115	371	371	810	650	0
			116	372	372	807	651	0
			117	373	373	801	653	0
			118	374	374	795	655	0
			119	375	375	790	657	0
			120	376	376	787	658	0
			121	377	377	781	660	0
			122	378	378	775	662	0
			123	379	379	769	664	0
			124	380	380	766	665	0
			125	381	381	761	667	0
			126	382	382	755	669	0
			127	383	383	752	670	0
			128	384	384	746	672	0
			129	385	385	740	674	0
			130	386	386	734	676	0
			131	387	387	728	678	0
			132	388	388	726	679	0
			133	389	389	720	681	0
			134	390	390	714	683	0
			135	391	391	711	684	0
			136	392	392	705	686	0
			137	393	393	699	688	0
			138	394	394	696	689	0
			139	395	395	691	691	0
			140	396	396	685	693	0
			141	397	397	679	695	0
			142	398	398	673	697	0
			143	399	399	670	698	0
			144	400	400	664	700	0
			145	401	401	659	702	0
			146	402	402	653	704	0
			147	403	403	647	706	0
			148	404	404	641	708	0
			149	405	405	638	709	0
			150	406	406	632	711	0
			151	407	407	627	713	0
			152	408	408	621	715	0
			153	409	409	615	717	0
			154	410	410	609	719	0
			155	411	411	603	721	0
			156	412	412	597	723	0
			157	413	413	592	725	0
			158	414	414	589	726	0
			159	415	415	583	728	0
			160	416	416	577	730	0
			161	417	417	571	732	0
			162	418	418	565	734	0
			163	419	419	560	736	0
			164	420	420	554	738	0
			165	421	421	548	740	0
			166	422	422	542	742	0
			167	423	423	539	743	0
			168	424	424	533	745	0
			169	425	425	527	747	0
			170	426	426	522	749	0
			171	427	427	516	751	0
			172	428	428	510	753	0
			173	429	429	504	755	0
			174	430	430	498	757	0
			175	431	431	495	758	0
			176	432	432	490	760	0
			177	433	433	484	762	0
			178	434	434	478	764	0
			179	435	435	472	766	0
			180	436	436	466	768	0
			181	437	437	461	770	0
			182	438	438	455	772	0
			183	439	439	449	774	0
			184	440	440	446	775	0
			185	441	441	440	777	0
			186	442	442	434	779	0
			187	443	443	428	781	0
			188	444	444	423	783	0
			189	445	445	417	785	0
			190	446	446	411	787	0
			191	447	447	405	789	0
			192	448	448	399	791	0
			193	449	449	396	792	0
			194	450	450	391	794	0
			195	451	451	385	796	0
			196	452	452	379	798	0
			197	453	453	368	800	0
		>;

		samsung,aod_candela_map_table_revA = <
		/*   <idx>   <from>  <till>  <gm2_wrdisbv> <cd> */
			0	0	11	0	2
			1	12	29	0	10
			2	30	52	0	30
			3	53	255	0	60
		>;

		samsung,gamma_mode2_normal_tx_cmds_revA=[
			29 00 00 00 00 00 04 B5 19 CD 16			/* 1. ELVSS control: TSET=0x19 for 25 degree */
			29 00 00 00 00 00 02 B0 05
			29 00 00 00 00 00 02 B1 08
			29 00 00 00 00 00 02 53 28				/* WRCTRLD  0x20=normal, 0x28=smooth transition */
			29 01 00 00 00 00 03 51 03 FF			/* WRDISBV 450 nit */
		];

		samsung,gamma_mode2_hbm_tx_cmds_revA=[
			29 00 00 00 00 00 02 53 E0				/* HBM: 0xE0=normal , 0x28=smooth transition */
			29 00 00 00 00 00 04 B1 11 70 7B			/* AOR interpolation */
			29 00 00 00 00 00 04 B5 19 CD 16				/* 1. ELVSS control: TSET=0x19 for 25 degree */
			29 01 00 00 00 00 02 F7 03				/* Gamma, AID Update */
		];

		/* *************************************************************
		 * VINT
		 * *************************************************************
		 */
		 samsung,vint_tx_cmds_revA = [
			29 00 00 00 00 00 03 F0 5A 5A	/* TEST KEY Enable */
			29 00 00 00 00 00 02 F4 CB
			29 00 00 00 00 00 02 F7 03
			29 01 00 00 00 00 03 F0 A5 A5	/* TEST KEY Disable */
		];
		/*
		 * ************************************************************************************************************************
		 *  FD Settings
		 * ************************************************************************************************************************
		 */

		samsung,fd_on_tx_cmds_revA = [
			29 00 00 00 00 00 03 F0 5A 5A	/* TEST KEY Enable */
			29 00 00 00 00 00 03 D0 D0 08
			29 00 00 00 00 00 02 B0 20
			29 00 00 00 00 00 02 B5 01
			29 01 00 00 00 00 03 F0 A5 A5	/* TEST KEY Disable */
		];

		samsung,fd_off_tx_cmds_revA = [
			29 00 00 00 00 00 03 F0 5A 5A	/* TEST KEY Enable */
			29 00 00 00 00 00 03 D0 D0 08
			29 00 00 00 00 00 02 B0 20
			29 00 00 00 00 00 02 B5 02
			29 01 00 00 00 00 03 F0 A5 A5	/* TEST KEY Disable */
		];

		/* *************************************************************
		 *  POC CONTROL
		 * *************************************************************
		 */

		samsung,support_poc_driver;

		samsung,poc_image_size = <233414>;		/* 233,414 bytes */  

		samsung,poc_enable_tx_cmds_revA = [
			29 00 00 00 00 00 03 F0 5A 5A
			29 01 00 00 00 00 03 F1 F1 A2
		];

		samsung,poc_disable_tx_cmds_revA = [
			29 00 00 00 00 00 03 F0 A5 A5
			29 01 00 00 00 00 03 F1 A5 A5
		];

		/*
		 * ERASE (SECTOR)
		 * Because whole operation of earse is excueted in driver level,
		 * do not use Exclusive Lock for frame update.
		 * Add flash lock for each cmd set.
		 */

		samsung,poc_erase_delay_us = <400000>;	/* 400ms */
		samsung,poc_erase_sector_addr_idx = <3 4 5>;

		samsung,poc_pre_erase_sector_tx_cmds_revA = [
			29 01 00 00 00 00 02 EB 4E
			29 01 00 00 00 00 02 B0 06
			29 01 00 00 00 00 02 EB 6A
			29 01 00 00 00 00 02 C0 02				/* PGM EN (START) */
			29 01 00 00 00 00 0B C1 00 06 00 00 00 00 00 00 00 04
			29 01 00 00 01 00 02 C0 03				/* EXE_INST + 1ms */
			29 01 00 00 00 00 0B C1 00 01 40 00 00 00 00 00 10 04
			29 01 00 00 0A 00 02 C0 03				/* EXE_INST + 10ms */
		];

		samsung,poc_erase_sector_tx_cmds_revA = [
			29 01 00 00 00 00 0B C1 00 06 00 00 00 00 00 00 00 04
			29 01 00 00 01 00 02 C0 03				/* EXE_INST + 1ms */
			29 01 00 00 00 00 0B C1 00 20 00 00 00 00 00 00 18 04	/* Flash Sector Address : 0xXX*/
			29 01 00 00 00 00 02 C0 03				/* EXE_INST + 400ms */
		];

		samsung,poc_post_erase_sector_tx_cmds_revA = [
			29 01 00 00 00 00 02 C0 00				/* PGM  Disable (END) */
		];

		// WRITE

		samsung,poc_write_delay_us = <20>;		/* 20us */
		samsung,poc_write_loop_cnt = <256>;
		samsung,poc_write_data_size = <1>;
		samsung,poc_write_addr_idx = <6 7 8>;

		samsung,poc_pre_write_tx_cmds_revA = [
			29 00 00 00 00 00 02 C0 02								/* PGM Enable (START) */
			29 00 00 00 00 00 0B C1 00 06 00 00 00 00 00 00 00 01
			29 01 00 00 01 00 02 C0 03								/* Exe + 1 ms */
			29 00 00 00 00 00 0A C1 00 01 40 00 00 00 00 00 10 		/* STATUS_register WEL, QE */
			29 01 00 00 1E 00 02 C0 03								/* Exe + 30 ms */
		];

		samsung,poc_write_loop_start_tx_cmds_revA = [
			29 00 00 00 00 00 0A C1 00 06 00 00 00 00 00 00 00
			29 01 00 00 00 00 02 C0 03
		];

		samsung,poc_write_loop_data_add_tx_cmds_revA = [
			29 01 00 00 00 00 0B C1 00 32 00 00 00 00 00 00 40 01	/* Quad_PGM/FLASH_CONT_WRITE/BIT_RATE */
		];

		samsung,poc_write_loop_1byte_tx_cmds_revA = [
			29 00 00 00 00 00 02 C1 77				/* INST_ADDR */
			29 01 00 00 00 00 02 C0 03				/* EXE_INST   */
		];

		samsung,poc_write_loop_end_tx_cmds_revA = [
			29 01 00 00 04 00 0B C1 00 32 00 00 00 00 00 00 80 01	/* write loop end  + 4 ms*/
		];

		samsung,poc_post_write_tx_cmds_revA = [
			29 00 00 00 00 00 02 C0 00
		];

		// READ

		samsung,poc_read_delay_us = <250>;		/* 250us */
		samsung,poc_read_addr_idx = <6 7 8>;

		samsung,poc_pre_read_tx_cmds_revA = [
			39 01 00 00 00 00 02 C0 02				/* PGM EN (START) */
			39 01 00 00 00 00 0B C1 00 06 00 00 00 00 00 00 00 01	/* Flash Control  */
			39 01 00 00 01 00 02 C0 03				/* EXE_INST + 1 ms Delay */
			39 01 00 00 00 00 0A C1 00 01 00 02 00 00 00 00 10	/* STATUS_register QE */
			39 01 00 00 1E 00 02 C0 03				/* EXE_INST + 30ms */
		];

		samsung,poc_pre_read2_tx_cmds_revA = [
			29 01 00 00 00 00 02 EB 4E
			29 01 00 00 00 00 02 B0 06
			29 01 00 00 00 00 02 EB 6A
			39 01 00 00 00 00 02 C0 02				/* PGM EN (START) */
			39 01 00 00 00 00 0B C1 00 06 00 00 00 00 00 00 00 01	/* Flash Control  */
			39 01 00 00 01 00 02 C0 03				/* EXE_INST + 1 ms Delay */
			39 01 00 00 00 00 0A C1 00 01 00 02 00 00 00 00 10	/* STATUS_register QE */
			39 01 00 00 1E 00 02 C0 03				/* EXE_INST + 30ms */
		];

		samsung,poc_read_tx_cmds_revA = [
			39 01 00 00 00 00 0C C1 00 6B 00 00 00 00 00 00 00 02 01	/* Read Address Setting */
			39 01 00 00 00 00 02 C0 03					/* Flash Pgm Execution  + 250 us */
			29 01 00 00 00 00 02 B0 21 					/* read 34th 1-byte data */
		];

		samsung,poc_read_rx_cmds_revA = [06 01 00 00 00 00 01 FB 01 00];	/* read 1 byte */

		samsung,poc_post_read_tx_cmds_revA = [
			39 01 00 00 00 00 02 C0 00
		];
#if 0
		samsung,reg_poc_read_pos_tx_cmds_revA = [
			/* B0 para is set with poc_read_tx_cmds_revA to reduce rx time */
			15 01 00 00 00 00 02 B0 12
		];

		samsung,poc_status_rx_cmds_revA		= [06 01 00 00 00 00 01 EB 04 00];	/* EB Check  */
		samsung,poc_checksum_rx_cmds_revA	= [06 01 00 00 00 00 01 EC 05 00];	/* CheckSum */
#endif
		samsung,poc_mca_check_rx_cmds_revA	= [06 01 00 00 00 00 01 EC 0A 00];	/* MCA Check */
#if 0
		samsung,poc_compensation_cmds_revA = [
			29 00 00 00 00 00 03 F0 5A 5A
			29 00 00 00 00 00 02 B0 0A
			29 00 00 00 00 00 09 EB 02 1A 33 5E 8C B3 D9 FF /* Dimming Set */
			29 00 00 00 00 00 02 B0 05
			29 00 00 00 00 00 02 EB FF	/* Dimming Step */
			29 00 00 00 00 00 02 F7 01
			29 01 00 00 00 00 03 F0 A5 A5
		];
#endif
		/* *************************************************************
		 *   ALPM
		 * *************************************************************
		 */
		samsung,self_grid_on_revA = [
			29 00 00 00 00 00 03 F0 5A 5A	/* TEST KEY Enable */
			29 00 00 00 00 00 0A BF 01 07 00 00 00 10 00 00 00	/* DBIST On */
			29 01 00 00 00 00 03 F0 A5 A5	/* TEST KEY Disable */
		];

		samsung,self_grid_off_revA = [
			29 00 00 00 22 00 03 F0 5A 5A	/* TEST KEY Enable - delay 34ms after dipslay_on */
			29 00 00 00 00 00 0A BF 00 07 00 00 00 10 00 00 00	/* DBIST Off */
			29 01 00 00 00 00 03 F0 A5 A5	/* TEST KEY Disable */
		];
		samsung,lpm_on_tx_cmds_revA = [
			29 00 00 00 00 00 03 F0 5A 5A	/* TEST KEY Enable */
			29 01 00 00 01 00 03 B1 18 F0	/* AOR MAX setting */
			29 00 00 00 00 00 05 BB 05 0C 08 1C		/* 0x0C, 0x08, 0x1C : HLPM 60nit */
													/* 0x8C, 0x48, 0x78 : HLPM 30nit */
													/* 0x8C, 0x78, 0x72 : HLPM 10nit */
			29 00 00 00 00 00 02 53 22		/* 22 : HLPM 60/30/10nit On, 23 2nit On */
			29 01 00 00 01 00 02 F7 03		/* Gamma & AID update */
			29 01 00 00 00 00 03 F0 A5 A5	/* TEST KEY Disable */
		];
		samsung,lpm_off_tx_cmds_revA = [
			29 00 00 00 00 00 03 F0 5A 5A	/* TEST KEY Enable */
			29 01 00 00 01 00 02 53 20		/* WRCTRLD: Dimming speed: 0x20=normal transition, 0x28=smooth transition */
			29 00 00 00 00 00 03 B1 11 70	/* AOR setting */
			29 01 00 00 00 00 03 F0 A5 A5	/* TEST KEY Disable */
		];
		/* HLPM / ALPM brightness Commands: default alpm 2nit */
		samsung,lpm_brightnes_tx_cmds_revA		= [
			29 00 00 00 00 00 03 F0 5A 5A	/* TEST KEY Enable */
			29 01 00 00 00 00 05 BB 05 0C 08 1C /* HLPM control */
			29 00 00 00 00 00 02 53 00
			29 01 00 00 01 00 02 F7 03		/* Gamma & AID update */
			29 00 00 00 00 00 03 F0 A5 A5	/* TEST KEY Disable */
		];
		/* ALPM/HLPM 2nit or 60nit On Commands */
		samsung,lpm_2nit_tx_cmds_revA = [29 00 00 00 00 00 02 53 23];	/* HLPM on*/
		samsung,lpm_10nit_tx_cmds_revA = [29 00 00 00 00 00 02 53 22];	/* ALPM on*/
		samsung,lpm_30nit_tx_cmds_revA = [29 00 00 00 00 00 02 53 22];	/* ALPM on*/
		samsung,lpm_60nit_tx_cmds_revA = [29 00 00 00 00 00 02 53 22];	/* ALPM on*/

		samsung,lpm_ctrl_hlpm_2nit_tx_cmds_revA		= [29 00 00 00 00 00 05 BB 05 8C 08 1C];
		samsung,lpm_ctrl_hlpm_10nit_tx_cmds_revA	= [29 00 00 00 00 00 05 BB 05 8C 78 72];
		samsung,lpm_ctrl_hlpm_30nit_tx_cmds_revA	= [29 00 00 00 00 00 05 BB 05 8C 48 78];
		samsung,lpm_ctrl_hlpm_60nit_tx_cmds_revA	= [29 00 00 00 00 00 05 BB 05 0C 08 1C];

		/*
		* ************************************************************************************************************************
		* DMS (Dynamic Mode Switch)
		* ************************************************************************************************************************
		*/

		qcom,mdss-dsi-display-timings {
			hd {
				qcom,display-topology = <1 0 1>;
				qcom,default-topology-index = <0>;

				qcom,mdss-dsi-panel-width = <816>;
				qcom,mdss-dsi-panel-height = <2260>;

				qcom,mdss-dsi-h-pulse-width = <112>;
				qcom,mdss-dsi-h-back-porch = <120>;
				qcom,mdss-dsi-h-front-porch = <120>;
				qcom,mdss-dsi-h-sync-skew = <0>;

				qcom,mdss-dsi-v-pulse-width = <112>;
				qcom,mdss-dsi-v-back-porch = <120>;
				qcom,mdss-dsi-v-front-porch = <120>;

				qcom,mdss-mdp-transfer-time-us = <15866>;
				qcom,mdss-dsi-panel-framerate = <60>;

				qcom,mdss-dsi-panel-clockrate = <1116000000>; /* 1116 */

				qcom,mdss-dsi-panel-phy-timings = [00 24 0A 0A 26 24 0A 0A 06 03 04 00 1E 1A];	/* SM8250 : dsi_phy_v4_0 */

				qcom,mdss-dsi-t-clk-pre = <0x1E>;
				qcom,mdss-dsi-t-clk-post = <0x1A>;

				qcom,mdss-dsi-on-command = [
					29 00 00 00 00 00 03 F0 5A 5A	/* TEST KEY2 Enable */
					29 00 00 00 00 00 03 9F A5 A5	/* TEST KEY1 Enable */

					05 01 00 00 14 00 01 11		/* Sleep out, wait 20ms */

					/* **** COMMON SETTING **** */
					29 00 00 00 00 00 05 2A 00 00 03 2F		/* CASET */
					29 00 00 00 00 00 05 2B 00 00 08 D3		/* CASET */

					29 00 00 00 00 00 02 35 00		/* TE Vsync On */

					29 00 00 00 00 00 02 ED 44 		/* ERR_FG Setting */

					29 00 00 00 00 00 09
						F4 CB 1E 18 3A 9F 0F 0B C0		/* AVC 2.0 setting */

					29 00 00 00 00 00 10 B9
						00 00 14 00 18 00 00 00 00 11 03 02 40 02 40		/* TSP SYNC Enable */

					/* **** BRIGHTNESS SETTING **** */
					29 00 00 00 00 00 02 53 28				/* WRCTRLD */
					29 00 00 00 00 00 03 51 03 FF			/* WRDISBV */


					29 00 00 00 00 00 03 9F 5A 5A	/* TEST KEY1 Enable */
					29 01 00 00 00 00 03 F0 A5 A5	/* TEST KEY2 Disable */
				];

				qcom,mdss-dsi-off-command=[
					/* **** DISPLAY OFF **** */
					05 00 00 00 00 00 01 28
					05 01 00 00 78 00 01 10		/* Sleep out, wait 120ms */
				];
				qcom,mdss-dsi-on-command-state = "dsi_lp_mode"; /* TBD */
				qcom,mdss-dsi-off-command-state = "dsi_hs_mode";
			};
		};
	};
};
