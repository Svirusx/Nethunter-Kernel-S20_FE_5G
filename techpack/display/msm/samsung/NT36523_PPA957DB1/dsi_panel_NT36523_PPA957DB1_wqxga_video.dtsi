/* Copyright (c) 2012, Samsung Electronics Corporation. All rights reserved.
 *
 * This program is free software; you can redistribute it and/or modify
 * it under the terms of the GNU General Public License version 2 and
 * only version 2 as published by the Free Software Foundation.
 *
 * This program is distributed in the hope that it will be useful,
 * but WITHOUT ANY WARRANTY; without even the implied warranty of
 * MERCHANTABILITY or FITNESS FOR A PARTICULAR PURPOSE.  See the
 * GNU General Public License for more details.
 */
&mdss_mdp{
	 ss_dsi_panel_NT36523_PPA957DB1_WQXGA: ss_dsi_panel_NT36523_PPA957DB1_WQXGA {
	 	qcom,mdss-dsi-panel-name = "ss_dsi_panel_NT36523_PPA957DB1_WQXGA";
		label = "ss_dsi_panel_NT36523_PPA957DB1_WQXGA";

		qcom,mdss-dsi-bpp = <24>;

		qcom,mdss-dsi-underflow-color = <0xFF>;
		qcom,mdss-dsi-border-color = <0>;

		qcom,mdss-dsi-bl-pmic-control-type = "bl_ctrl_dcs";

		qcom,mdss-dsi-bl-min-level = <4>;
		qcom,mdss-dsi-bl-max-level = <462>;
		qcom,mdss-brightness-max-level = <462>;
		qcom,mdss-dsi-interleave-mode = <0>;
		qcom,mdss-dsi-panel-type = "dsi_video_mode";
		qcom,mdss-dsi-traffic-mode = "burst_mode";
		qcom,mdss-dsi-bllp-eof-power-mode;
		qcom,mdss-dsi-bllp-power-mode;

		qcom,mdss-dsi-pixel-packing = "loose";

		qcom,mdss-dsi-virtual-channel-id = <0>;
		qcom,mdss-dsi-color-order = "rgb_swap_rgb";
		qcom,mdss-dsi-lane-0-state;
		qcom,mdss-dsi-lane-1-state;
		qcom,mdss-dsi-lane-2-state;

		qcom,mdss-dsi-stream = <0>;
		qcom,mdss-dsi-mdp-trigger = "none";
		qcom,mdss-dsi-dma-trigger = "trigger_sw";

		qcom,mdss-pan-physical-width-dimension = <148>;
		qcom,mdss-pan-physical-height-dimension = <236>;

		qcom,mdss-dsi-panel-mode-gpio-state = "invalid";
		qcom,mdss-dsi-reset-sequence = <0 12>, <1 12>, <0 12>, <1 12>;
		qcom,adjust-timer-wakeup-ms = <1>;

		qcom,mdss-dsi-lp11-init;

		qcom,mdss-dsi-rx-eot-ignore;
		qcom,mdss-dsi-tx-eot-append;

		qcom,panel-cphy-mode;

		qcom,esd-check-enabled;
		qcom,mdss-dsi-panel-status-check-mode ="irq_check";


		qcom,dsi-supported-dfps-list = <120 96 60 48>;
		qcom,mdss-dsi-pan-enable-dynamic-fps;
		qcom,mdss-dsi-pan-fps-update = "dfps_immediate_porch_mode_vfp";


/*
 * ************************************************************************************************************************************
 *
 *
 *			Below  parameters are samsung dependent thigs
 *
 *
 * ************************************************************************************************************************************
 */
		samsung,panel-vendor = "CST";
		samsung,disp-model = "PPA957DB1";
		samsung,support_panel_max = <1>;
		samsung,tft-common-support;
		samsung,pll_ssc_disabled;
		samsung,elvss_interpolation_temperature = <(-20)>;
		samsung,aot_enable;
		samsung,lp11_sleep_ms_time = <60>;
		//samsung,esc-clk-128M;

		samsung,phy_vreg_ctrl_0 = <0x50>;
		samsung,phy_ctrl2 = <0x64>;
		samsung,phy_offset_top_ctrl = <0x1F>;
		samsung,phy_offset_bot_ctrl = <0x1F>;
		samsung,phy_offset_mid_ctrl = <0x1F>;
		samsung,phy_str_swi_cal_sel_ctrl = <0x04>;

		/*
		* ************************************************************************************************************************
		*  Tx
		* ************************************************************************************************************************
		*/

		samsung,display_on_tx_cmds_revA = [15 01 00 00 00 00 02 29 00];

		/* BRIGHTNESS_MAX_PACKET = 30 */
		samsung,brightness_tx_cmds_revA = [
			39 01 00 00 00 00 03 51 00 00 /* 8bit brightness control */
		];

		samsung,packet_size_tx_cmds_revA = [
			37 01 00 00 00 00 02 21 00
		];

		samsung,manufacture_id0_rx_cmds_revA 	= [06 01 00 00 00 00 01 DA 01 00];
		samsung,manufacture_id1_rx_cmds_revA 	= [06 01 00 00 00 00 01 DB 01 00];
		samsung,manufacture_id2_rx_cmds_revA 	= [06 01 00 00 00 00 01 DC 01 00];

		samsung,mtp_read_sysfs_rx_cmds_revA = [06 01 00 00 00 00 01 01 01 01];
		samsung,mtp_write_sysfs_tx_cmds_revA = [39 01 00 00 00 00 02 00 00];


		samsung,dfps_tx_cmds_revA = [
			15 00 00 00 00 00 02 FF 2A
			15 00 00 00 00 00 02 FB 01

			15 00 00 00 00 00 02 23 0D

			15 00 00 00 00 00 02 FF 10
			15 01 00 00 00 00 02 FB 01
		];

		/*
		 * ************************************************************************************************************************
		 * candela to index mappings
		 * ************************************************************************************************************************
		 */
		samsung,candela_map_table_revA = <
		/* THIS TABLE USED FOR SMART-DIMMING */
		/*<idx>   <from>  <till> <candella> */
			0	0	0	2
			1       1	1       3
			2       2	2       4
			3       3	3       5
			4       4	4       6
			5       5	5       7
			6       6	6       8
			7       7	7       9
			8       8	8       10
			9       9	9       11
			10	10	10      12
			11	11	11      13
			12	12	12      14
			13	13	13      15
			14	14	14      16
			15	15	15      17
			16	16	16      19
			17	17	17      20
			18	18	18      21
			19	19	19      22
			20	20	20      24
			21	21	21      25
			22	22	23      27
			23	24	25      29
			24	26	27      30
			25	28	29      32
			26	30	31      34
			27	32	33      37
			28	34	35      39
			29	36	37      41
			30	38	39      44
			31	40	41      47
			32	42	43      50
			33	44	45      53
			34	46	48      56
			35	49	51      60
			36	52	54      64
			37	55	57      68
			38	58	60      72
			39	61	63      77
			40	64	66      82
			41	67	69      87
			42	70	72      93
			43	73	76      98
			44	77	80      105
			45	81	86      111
			46	87	91      119
			47	92	97      126
			48	98	104	134
			49	105	110	143
			50	111	118	152
			51	119	125	162
			52	126	133	172
			53	134	142	183
			54	143	150	195
			55	151	160	207
			56	161	170	220
			57	171	181	234
			58	182	192	249
			59	193	203	265
			60	204	214	282
			61	215	225	300
			62	226	235	316
			63	236	245	333
			64	246	511	360
		>;

		/*
		* ************************************************************************************************************************
		* DMS (Dynamic Mode Switch)
		* (TABS7 does not support MULTI_RESOLUTION, only WQXGA.)
		* ************************************************************************************************************************
		*/

		qcom,mdss-dsi-display-timings {
			wqxga@0 {
				qcom,display-topology = <2 0 2>;
				qcom,default-topology-index = <0>;

				qcom,mdss-dsi-panel-width = <800>; // 1600/2
				qcom,mdss-dsi-panel-height = <2560>;
				qcom,mdss-dsi-panel-framerate = <120>;
				qcom,mdss-dsi-h-pulse-width = <2>;
				qcom,mdss-dsi-h-back-porch = <30>;
				qcom,mdss-dsi-h-front-porch = <84>;
				qcom,mdss-dsi-h-sync-skew = <0>;
				qcom,mdss-dsi-v-pulse-width = <1>;
				qcom,mdss-dsi-v-back-porch = <7>;
				qcom,mdss-dsi-v-front-porch = <26>;

				qcom,mdss-dsi-panel-clockrate = <998000000>;
				qcom,mdss-dsi-panel-phy-timings = [00 24 0A 0A
												11
												3E
												0D
												1E
												0A
												02
												04
												00 1E 1A];

				qcom,mdss-dsi-on-command= [
					15 00 00 00 00 00 02 FF 10
					15 00 00 00 00 00 02 B9 05
					15 00 00 00 00 00 02 FF 20
					15 00 00 00 00 00 02 18 40
					15 00 00 00 00 00 02 FF 10
					15 00 00 00 00 00 02 B9 02
					15 00 00 00 00 00 02 FF D0
					15 00 00 00 00 00 02 FB 01
					15 00 00 00 00 00 02 00 30
					15 00 00 00 00 00 02 09 EE
					15 00 00 00 00 00 02 1C AA
					15 00 00 00 00 00 02 1D 0A
					15 00 00 00 00 00 02 FF F0
					15 00 00 00 00 00 02 FB 01
					15 00 00 00 00 00 02 3A 08
					15 00 00 00 00 00 02 FF 20
					15 00 00 00 00 00 02 FB 01
					15 00 00 00 00 00 02 05 09
					15 00 00 00 00 00 02 06 C0
					15 00 00 00 00 00 02 07 32
					15 00 00 00 00 00 02 08 1E
					15 00 00 00 00 00 02 0D 23
					15 00 00 00 00 00 02 0E 4B
					15 00 00 00 00 00 02 0F 37
					15 00 00 00 00 00 02 30 10
					15 00 00 00 00 00 02 31 02
					15 00 00 00 00 00 02 32 42
					15 00 00 00 00 00 02 58 60
					15 00 00 00 00 00 02 60 BB
					15 00 00 00 00 00 02 62 36
					15 00 00 00 00 00 02 63 A6
					15 00 00 00 00 00 02 69 98
					15 00 00 00 00 00 02 6D 66
					15 00 00 00 00 00 02 75 B1
					15 00 00 00 00 00 02 77 3B
					15 00 00 00 00 00 02 94 00
					15 00 00 00 00 00 02 95 D7
					15 00 00 00 00 00 02 96 D7
					15 00 00 00 00 00 02 FF 24
					15 00 00 00 00 00 02 FB 01
					15 00 00 00 00 00 02 00 23
					15 00 00 00 00 00 02 01 00
					15 00 00 00 00 00 02 02 22
					15 00 00 00 00 00 02 03 00
					15 00 00 00 00 00 02 04 13
					15 00 00 00 00 00 02 05 12
					15 00 00 00 00 00 02 06 11
					15 00 00 00 00 00 02 07 10
					15 00 00 00 00 00 02 08 0F
					15 00 00 00 00 00 02 09 0E
					15 00 00 00 00 00 02 0A 0D
					15 00 00 00 00 00 02 0B 0C
					15 00 00 00 00 00 02 0C 00
					15 00 00 00 00 00 02 0D 04
					15 00 00 00 00 00 02 0E 05
					15 00 00 00 00 00 02 0F 28
					15 00 00 00 00 00 02 10 00
					15 00 00 00 00 00 02 11 27
					15 00 00 00 00 00 02 12 00
					15 00 00 00 00 00 02 13 26
					15 00 00 00 00 00 02 14 00
					15 00 00 00 00 00 02 15 27
					15 00 00 00 00 00 02 16 23
					15 00 00 00 00 00 02 17 00
					15 00 00 00 00 00 02 18 22
					15 00 00 00 00 00 02 19 00
					15 00 00 00 00 00 02 1A 13
					15 00 00 00 00 00 02 1B 12
					15 00 00 00 00 00 02 1C 11
					15 00 00 00 00 00 02 1D 10
					15 00 00 00 00 00 02 1E 0F
					15 00 00 00 00 00 02 1F 0E
					15 00 00 00 00 00 02 20 0D
					15 00 00 00 00 00 02 21 0C
					15 00 00 00 00 00 02 22 00
					15 00 00 00 00 00 02 23 04
					15 00 00 00 00 00 02 24 05
					15 00 00 00 00 00 02 25 28
					15 00 00 00 00 00 02 26 00
					15 00 00 00 00 00 02 27 27
					15 00 00 00 00 00 02 28 00
					15 00 00 00 00 00 02 29 26
					15 00 00 00 00 00 02 2A 00
					15 00 00 00 00 00 02 2B 27
					15 00 00 00 00 00 02 2F 04
					15 00 00 00 00 00 02 30 03
					15 00 00 00 00 00 02 33 03
					15 00 00 00 00 00 02 34 04
					15 00 00 00 00 00 02 37 33
					15 00 00 00 00 00 02 3A 4A
					15 00 00 00 00 00 02 3B 00
					15 00 00 00 00 00 02 3D 02
					15 00 00 00 00 00 02 4D 43
					15 00 00 00 00 00 02 4E 65
					15 00 00 00 00 00 02 4F 87
					15 00 00 00 00 00 02 50 21
					15 00 00 00 00 00 02 51 56
					15 00 00 00 00 00 02 52 34
					15 00 00 00 00 00 02 53 12
					15 00 00 00 00 00 02 54 78
					39 00 00 00 00 00 03 55 04 04
					15 00 00 00 00 00 02 56 08
					15 00 00 00 00 00 02 58 10
					15 00 00 00 00 00 02 59 10
					15 00 00 00 00 00 02 5A 08
					15 00 00 00 00 00 02 5B 4B
					15 00 00 00 00 00 02 5C 00
					15 00 00 00 00 00 02 5D 00
					39 00 00 00 00 00 03 5E 00 04
					15 00 00 00 00 00 02 60 C8
					15 00 00 00 00 00 02 61 00
					15 00 00 00 00 00 02 63 A0
					15 00 00 00 00 00 02 91 40
					15 00 00 00 00 00 02 92 56
					15 00 00 00 00 00 02 93 1A
					15 00 00 00 00 00 02 94 08
					15 00 00 00 00 00 02 96 62
					15 00 00 00 00 00 02 97 C2
					15 00 00 00 00 00 02 98 80
					15 00 00 00 00 00 02 AB 33
					39 00 00 00 00 00 0D B6 05 00 05 00 00 00 00 00 05 05 00 00
					15 00 00 00 00 00 02 C2 DA
					15 00 00 00 00 00 02 C3 00
					15 00 00 00 00 00 02 C4 2F
					15 00 00 00 00 00 02 DB 71
					15 00 00 00 00 00 02 DC 58
					15 00 00 00 00 00 02 DF 01
					15 00 00 00 00 00 02 E0 6D
					15 00 00 00 00 00 02 E1 01
					15 00 00 00 00 00 02 E2 FF
					15 00 00 00 00 00 02 E5 01
					15 00 00 00 00 00 02 E6 58
					15 00 00 00 00 00 02 FF 25
					15 00 00 00 00 00 02 FB 01
					15 00 00 00 00 00 02 05 00
					15 00 00 00 00 00 02 13 01
					15 00 00 00 00 00 02 14 36
					15 00 00 00 00 00 02 19 07
					15 00 00 00 00 00 02 1B 11
					15 00 00 00 00 00 02 1E 00
					15 00 00 00 00 00 02 1F 08
					15 00 00 00 00 00 02 20 4B
					15 00 00 00 00 00 02 25 00
					15 00 00 00 00 00 02 26 08
					15 00 00 00 00 00 02 27 4B
					15 00 00 00 00 00 02 3F 00
					15 00 00 00 00 00 02 40 02
					15 00 00 00 00 00 02 43 00
					15 00 00 00 00 00 02 48 02
					15 00 00 00 00 00 02 49 42
					15 00 00 00 00 00 02 5B 00
					15 00 00 00 00 00 02 C0 0C
					15 00 00 00 00 00 02 C2 40
					15 00 00 00 00 00 02 C8 04
					15 00 00 00 00 00 02 F1 10
					15 00 00 00 00 00 02 FF 26
					15 00 00 00 00 00 02 FB 01
					15 00 00 00 00 00 02 00 A1
					15 00 00 00 00 00 02 04 50
					15 00 00 00 00 00 02 06 50
					15 00 00 00 00 00 02 0A F5
					15 00 00 00 00 00 02 0C 08
					15 00 00 00 00 00 02 0D 00
					15 00 00 00 00 00 02 11 00
					15 00 00 00 00 00 02 12 51
					15 00 00 00 00 00 02 13 18
					15 00 00 00 00 00 02 14 1D
					15 00 00 00 00 00 02 16 11
					15 00 00 00 00 00 02 19 10
					15 00 00 00 00 00 02 1A F0
					15 00 00 00 00 00 02 1B 10
					15 00 00 00 00 00 02 1C 00
					15 00 00 00 00 00 02 1D 00
					15 00 00 00 00 00 02 1E 56
					15 00 00 00 00 00 02 1F FF
					15 00 00 00 00 00 02 20 00
					15 00 00 00 00 00 02 21 07
					15 00 00 00 00 00 02 2A 10
					15 00 00 00 00 00 02 2B F0
					15 00 00 00 00 00 02 2F 05
					15 00 00 00 00 00 02 30 56
					15 00 00 00 00 00 02 33 66
					15 00 00 00 00 00 02 34 66
					15 00 00 00 00 00 02 35 66
					15 00 00 00 00 00 02 39 00
					15 00 00 00 00 00 02 8B 50
					15 00 00 00 00 00 02 C7 00
					15 00 00 00 00 00 02 C8 00
					15 00 00 00 00 00 02 FF 27
					15 00 00 00 00 00 02 FB 01
					15 00 00 00 00 00 02 00 00
					15 00 00 00 00 00 02 01 19
					15 00 00 00 00 00 02 02 02
					15 00 00 00 00 00 02 03 A2
					15 00 00 00 00 00 02 04 00
					15 00 00 00 00 00 02 05 36
					15 00 00 00 00 00 02 06 32
					15 00 00 00 00 00 02 07 30
					15 00 00 00 00 00 02 08 96
					15 00 00 00 00 00 02 09 8B
					15 00 00 00 00 00 02 0A 96
					15 00 00 00 00 00 02 0B 03
					15 00 00 00 00 00 02 0C 2A
					15 00 00 00 00 00 02 0D 86
					15 00 00 00 00 00 02 0E 94
					15 00 00 00 00 00 02 0F 03
					15 00 00 00 00 00 02 10 2C
					15 00 00 00 00 00 02 31 08
					15 00 00 00 00 00 02 58 80
					15 00 00 00 00 00 02 59 19
					15 00 00 00 00 00 02 5A 0A
					15 00 00 00 00 00 02 5B 3C
					15 00 00 00 00 00 02 5C 00
					15 00 00 00 00 00 02 5D 5A
					15 00 00 00 00 00 02 5E 32
					15 00 00 00 00 00 02 5F 10
					15 00 00 00 00 00 02 60 00
					15 00 00 00 00 00 02 61 FF
					15 00 00 00 00 00 02 62 DC
					15 00 00 00 00 00 02 63 09
					15 00 00 00 00 00 02 64 32
					15 00 00 00 00 00 02 65 FA
					15 00 00 00 00 00 02 66 DC
					15 00 00 00 00 00 02 67 09
					15 00 00 00 00 00 02 68 32
					15 00 00 00 00 00 02 75 00
					15 00 00 00 00 00 02 76 00
					15 00 00 00 00 00 02 77 08
					15 00 00 00 00 00 02 78 00
					15 00 00 00 00 00 02 95 00
					15 00 00 00 00 00 02 96 00
					15 00 00 00 00 00 02 97 00
					15 00 00 00 00 00 02 C0 00
					15 00 00 00 00 00 02 C3 80
					15 00 00 00 00 00 02 C4 19
					15 00 00 00 00 00 02 C5 0F
					15 00 00 00 00 00 02 C6 45
					15 00 00 00 00 00 02 C7 00
					15 00 00 00 00 00 02 C8 BA
					15 00 00 00 00 00 02 C9 32
					15 00 00 00 00 00 02 CA 10
					15 00 00 00 00 00 02 CB FA
					15 00 00 00 00 00 02 CC E5
					15 00 00 00 00 00 02 CD FA
					15 00 00 00 00 00 02 D0 10
					15 00 00 00 00 00 02 D1 04
					15 00 00 00 00 00 02 D2 30
					15 00 00 00 00 00 02 E5 09
					15 00 00 00 00 00 02 E6 62
					15 00 00 00 00 00 02 E7 E0
					15 00 00 00 00 00 02 E8 F8
					15 00 00 00 00 00 02 E9 09
					15 00 00 00 00 00 02 EA 64
					15 00 00 00 00 00 02 F7 00
					15 00 00 00 00 00 02 F8 00
					15 00 00 00 00 00 02 F9 08
					15 00 00 00 00 00 02 FF 2A
					15 00 00 00 00 00 02 FB 01
					15 00 00 00 00 00 02 22 1F
					15 00 00 00 00 00 02 23 0D
					15 00 00 00 00 00 02 24 00
					15 00 00 00 00 00 02 25 56
					15 00 00 00 00 00 02 27 00
					15 00 00 00 00 00 02 28 1A
					15 00 00 00 00 00 02 29 00
					15 00 00 00 00 00 02 2A 1A
					15 00 00 00 00 00 02 2B 0A
					15 00 00 00 00 00 02 2D 3C
					15 00 00 00 00 00 02 2F 00
					15 00 00 00 00 00 02 30 56
					15 00 00 00 00 00 02 32 00
					15 00 00 00 00 00 02 33 1A
					15 00 00 00 00 00 02 34 00
					15 00 00 00 00 00 02 35 1A
					15 00 00 00 00 00 02 36 00
					15 00 00 00 00 00 02 37 1A
					15 00 00 00 00 00 02 38 00
					15 00 00 00 00 00 02 39 56
					15 00 00 00 00 00 02 3B 00
					15 00 00 00 00 00 02 3D 1A
					15 00 00 00 00 00 02 3F 00
					15 00 00 00 00 00 02 40 1A
					15 00 00 00 00 00 02 41 02
					15 00 00 00 00 00 02 42 A2
					15 00 00 00 00 00 02 43 00
					15 00 00 00 00 00 02 44 56
					15 00 00 00 00 00 02 46 00
					15 00 00 00 00 00 02 47 1A
					15 00 00 00 00 00 02 48 00
					15 00 00 00 00 00 02 49 1A
					15 00 00 00 00 00 02 4A 0F
					15 00 00 00 00 00 02 4B 4D
					15 00 00 00 00 00 02 64 41
					15 00 00 00 00 00 02 6A 41
					15 00 00 00 00 00 02 79 41
					15 00 00 00 00 00 02 7C 41
					15 00 00 00 00 00 02 7F 41
					15 00 00 00 00 00 02 82 41
					15 00 00 00 00 00 02 85 41
					15 00 00 00 00 00 02 97 3C
					15 00 00 00 00 00 02 98 02
					15 00 00 00 00 00 02 99 95
					15 00 00 00 00 00 02 9A 06
					15 00 00 00 00 00 02 9B 00
					15 00 00 00 00 00 02 9C 0B
					15 00 00 00 00 00 02 9D 0A
					15 00 00 00 00 00 02 9E 90
					15 00 00 00 00 00 02 A2 30
					15 00 00 00 00 00 02 A3 00
					15 00 00 00 00 00 02 A4 30
					15 00 00 00 00 00 02 E8 15
					15 00 00 00 00 00 02 FF 22
					15 00 00 00 00 00 02 FB 01
					15 00 00 00 00 00 02 9F 50
					15 00 00 00 00 00 02 FF 23
					15 00 00 00 00 00 02 FB 01
					15 00 00 00 00 00 02 A3 50
					15 00 00 00 00 00 02 00 20
					15 00 00 00 00 00 02 07 20
					15 00 00 00 00 00 02 08 04
					15 00 00 00 00 00 02 09 2C
					15 00 00 00 00 00 02 11 02
					15 00 00 00 00 00 02 12 80
					15 00 00 00 00 00 02 15 83
					15 00 00 00 00 00 02 16 0C
					15 00 00 00 00 00 02 29 80
					15 00 00 00 00 00 02 30 FF
					15 00 00 00 00 00 02 31 FC
					15 00 00 00 00 00 02 32 F9
					15 00 00 00 00 00 02 33 F6
					15 00 00 00 00 00 02 34 F3
					15 00 00 00 00 00 02 35 F1
					15 00 00 00 00 00 02 36 EE
					15 00 00 00 00 00 02 37 EB
					15 00 00 00 00 00 02 38 E9
					15 00 00 00 00 00 02 39 E6
					15 00 00 00 00 00 02 3A E4
					15 00 00 00 00 00 02 3B E1
					15 00 00 00 00 00 02 3D DF
					15 00 00 00 00 00 02 3F DD
					15 00 00 00 00 00 02 40 DB
					15 00 00 00 00 00 02 41 D9
					15 00 00 00 00 00 02 FF 10
					15 00 00 00 00 00 02 FB 01
					15 00 00 00 00 00 02 35 00
					39 00 00 00 00 00 03 51 00 00
					15 00 00 00 00 00 02 53 24
					15 00 00 00 00 00 02 55 00
					15 00 00 00 00 00 02 BB 13
					39 00 00 00 00 00 06 3B 03 08 1A 04 04
					15 01 00 00 78 00 02 11 00 /* 120ms delay */
					//15 00 00 00 00 00 02 29 00


					/* ESD RELATED */
					15 00 00 00 00 00 02 FF 27
					15 00 00 00 00 00 02 FB 01
					15 00 00 00 00 00 02 D0 11 // Enable IC status/MIPI error report detection
					15 00 00 00 00 00 02 D1 05 //output ESD detection output to FTE1 pin
					15 00 00 00 00 00 02 DE FF //all bit
					15 00 00 00 00 00 02 DF FF //all bit
					15 00 00 00 00 00 02 FF 10
					15 01 00 00 00 00 02 FB 01
				];

				qcom,mdss-dsi-off-command=[
					39 00 00 00 00 00 03 51 00 00     /* 0% pwm duty */
					05 00 00 00 00 00 02 28 00		/* Display Off */
					05 01 00 00 00 00 02 10 00		/* Sleep in*/
				];

				qcom,mdss-dsi-on-command-state = "dsi_lp_mode";
				qcom,mdss-dsi-off-command-state = "dsi_hs_mode";
			};
		};
	};
};

