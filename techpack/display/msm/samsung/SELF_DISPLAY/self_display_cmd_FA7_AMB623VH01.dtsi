/* Copyright (c) 2012, Samsung Electronics Corporation. All rights reserved.
 *
 * This program is free software; you can redistribute it and/or modify
 * it under the terms of the GNU General Public License version 2 and
 * only version 2 as published by the Free Software Foundation.
 *
 * This program is distributed in the hope that it will be useful,
 * but WITHOUT ANY WARRANTY; without even the implied warranty of
 * MERCHANTABILITY or FITNESS FOR A PARTICULAR PURPOSE.  See the
 * GNU General Public License for more details.
 */

&soc {
	self_display_FA7_AMB623VH01_dtsi: self_display_FA7_AMB623VH01_dtsi {
		label = "self_display_FA7_AMB623VH01_dtsi";

		/*
		 *************************************************************************************************************************
		 * Self Display Operation (Enable/Disable)
		 *************************************************************************************************************************
		 */

		samsung,self_dispaly_on_revA = [
			29 01 00 00 00 00 03 FC 5A 5A	/* TEST KEY Enable */
			29 01 00 00 00 00 02 B0 33	/* Global para */
			29 01 00 00 00 00 02 FE 24	/* Move Setting */
			29 01 00 00 00 00 07 76 08 10 83 30 08 D4
			29 01 00 00 00 00 03 FC A5 A5	/* TEST KEY Disable */
		];

		samsung,self_dispaly_off_revA = [
			29 01 00 00 00 00 03 F0 5A 5A	/* TEST KEY Enable */
			29 01 00 00 00 00 03 7C 00 00		/* Self ICON Off */
			29 01 00 00 00 00 02 7D 01		/* Self Move 2C Sync Off */
			29 01 00 00 00 00 02 77 01		/* Self Clock 2C Sync Off */
			29 01 00 00 00 00 03 79 00 00	/* Self Blink 2C Sync Off */
			29 01 00 00 00 00 07 76 08 10 03 30 08 D4
			29 01 00 00 00 00 03 F0 A5 A5	/* TEST KEY Disable */
		];

		/*
		 *************************************************************************************************************************
		 * Self Display Operation (SELF MOVE)
		 *************************************************************************************************************************
		 */

		/* Inverval 100ms Move Pattern */
		samsung,self_move_on_100_revA = [
			29 01 00 00 00 00 03 F0 5A 5A	/* TEST KEY Enable */
			29 01 00 00 00 00 61 7D
				00 00 00 00 00 00 22
				23 27 23 77 73 27 33 17 73 77
				23 27 23 77 73 27 33 17 73 77
				23 27 23 77 73 27 33 17 73 77
				23 27 23 77 73 27 33 17 73 77
				23 27 23 77 73 27 33 17 73 77
				23 27 23 77 73 27 33 17 73
				44 44 1C CC C3 44 44 1C CC C3
				44 44 1C CC C3 44 44 1C CC C3
				44 44 1C CC C3 44 44 1C CC C3
			29 01 00 00 00 00 03 F0 A5 A5	/* TEST KEY Disable */
		];

		/* Inverval 200ms Move Pattern */
		samsung,self_move_on_200_revA = [
			29 01 00 00 00 00 03 F0 5A 5A	/* TEST KEY Enable */
			29 01 00 00 00 00 61 7D
				00 00 00 00 00 00 55
				23 27 23 77 73 27 33 17 73 77
				23 27 23 77 73 27 33 17 73 77
				23 27 23 77 73 27 33 17 73 77
				23 27 23 77 73 27 33 17 73 77
				23 27 23 77 73 27 33 17 73 77
				23 27 23 77 73 27 33 17 73
				44 44 1C CC C3 44 44 1C CC C3
				44 44 1C CC C3 44 44 1C CC C3
				44 44 1C CC C3 44 44 1C CC C3
			29 01 00 00 00 00 03 F0 A5 A5	/* TEST KEY Disable */
		];

		/* Inverval 500ms Move Pattern */
		samsung,self_move_on_500_revA = [
			29 01 00 00 00 00 03 F0 5A 5A	/* TEST KEY Enable */
			29 01 00 00 00 00 61 7D
				00 00 00 00 00 00 dd
				23 27 23 77 73 27 33 17 73 77
				23 27 23 77 73 27 33 17 73 77
				23 27 23 77 73 27 33 17 73 77
				23 27 23 77 73 27 33 17 73 77
				23 27 23 77 73 27 33 17 73 77
				23 27 23 77 73 27 33 17 73
				44 44 1C CC C3 44 44 1C CC C3
				44 44 1C CC C3 44 44 1C CC C3
				44 44 1C CC C3 44 44 1C CC C3
			29 01 00 00 00 00 03 F0 A5 A5	/* TEST KEY Disable */
		];

		/* Inverval 1000ms(1Sec) Move Pattern */
		samsung,self_move_on_1000_revA = [
			29 01 00 00 00 00 03 F0 5A 5A	/* TEST KEY Enable */
			29 01 00 00 00 00 61 7D
				00 00 00 00 00 00 dd
				00 23 00 27 00 23 00 77 00 73
				00 27 00 33 00 17 00 73 00 77
				00 23 00 27 00 23 00 77 00 73
				00 27 00 33 00 17 00 73 00 77
				00 23 00 27 00 23 00 77 00 73
				00 27 00 33 00 17 00 73 00
				04 04 04 04 01 0C 0C 0C 0C 03
				04 04 04 04 01 0C 0C 0C 0C 03
				04 04 04 04 01 0C 0C 0C 0C 03
			29 01 00 00 00 00 03 F0 A5 A5	/* TEST KEY Disable */
		];

		/* Debug Move Pattern(Only for 1000ms Interval) */
		samsung,self_move_on_debug_revA = [
			29 01 00 00 00 00 03 F0 5A 5A	/* TEST KEY Enable */
			29 01 00 00 00 00 61 7D
				00 00 00 00 00 00 00
				23 27 23 77 73 27 33 17 73 77
				23 27 23 77 73 27 33 17 73 77
				23 27 23 77 73 27 33 17 73 77
				23 27 23 77 73 27 33 17 73 77
				23 27 23 77 73 27 33 17 73 77
				23 27 23 77 73 27 33 17 73
				44 44 1C CC C3 44 44 1C CC C3
				44 44 1C CC C3 44 44 1C CC C3
				44 44 1C CC C3 44 44 1C CC C3
			29 01 00 00 00 00 03 F0 A5 A5	/* TEST KEY Disable */
		];

		samsung,self_move_2c_sync_off_revA = [
			29 01 00 00 00 00 03 F0 5A 5A	/* TEST KEY Enable */
			29 01 00 00 00 00 02 7D 01
			29 01 00 00 00 00 03 F0 A5 A5	/* TEST KEY Disable */
		];


		/*
		 *************************************************************************************************************************
		 * Self Display Operation (SELF TIME UPDATE)
		 *************************************************************************************************************************
		 */

		samsung,self_time_set_revA = [
			29 01 00 00 00 00 03 F0 5A 5A	/* TEST KEY Enable */
			29 01 00 00 00 00 0B 77
				00 04 00 00 00
				00 00 03 00 00
			29 01 00 00 00 00 02 78 01		/* Time Update */
			29 01 00 00 00 00 03 F0 A5 A5	/* TEST KEY Disable */
		];

		/*
		 *************************************************************************************************************************
		 * Self Display Operation (SELF VIDEO)
		 *************************************************************************************************************************
		 */

		samsung,self_video_mem_setting_revA = [
			29 01 00 00 22 00 04 7B 00 00 00		/* Self Video Off 34ms delay */
			29 01 00 00 00 00 02 75 04
			/* image data (4C,5C) ... */
		];

		samsung,self_video_on_revA = [
			29 01 00 00 00 00 03 F0 5A 5A	/* TEST KEY Enable */
			29 01 00 00 00 00 58 7B
				00 C0 11 00 00 00 00 00
				00 00 00 00 00 00 00 00
				00 00 00 00 00 00 00 00
				00 00 00 00 00 00 00 00
				00 00 00 00 0B 8F 18 00
				05 00 05 00 05 00 05 00
				05 00 05 00 05 00 05 00
				05 00 05 00 05 00 05 00
				05 00 05 00 05 00 05 00
				05 00 05 00 05 00 05 00
				05 00 05 00 05 00 05
			29 01 00 00 00 00 03 F0 A5 A5	/* TEST KEY Disable */
		];

		samsung,self_video_off_revA = [
			29 01 00 00 00 00 03 F0 5A 5A	/* TEST KEY Enable */
			29 01 00 00 00 00 04 7B 00 C0 00
			29 01 00 00 00 00 03 F0 A5 A5	/* TEST KEY Disable */
		];

		/*
		 *************************************************************************************************************************
		 * Self Display Operation (SELF MASK)
		 *************************************************************************************************************************
		 */

		samsung,self_mask_mem_setting_revA = [
			29 01 00 00 00 00 02 7A 00		/* Self Mask Off 34ms delay */
			29 01 00 00 00 00 02 75 10		/* MA_SEL(1), IC_SEL, VI_SEL, DC_SEL, AC_SEL */
			/* image data (4C,5C) ... */
		];

		samsung,self_mask_on_revA = [
			29 01 00 00 00 00 03 F0 5A 5A	/* TEST KEY Enable */
			29 01 00 00 00 00 10 7A
				01 00 00 00 95 08 3E 08
				D3 08 10 00 00 00 00
			29 01 00 00 00 00 03 F0 A5 A5	/* TEST KEY Disable */
		];

		samsung,self_mask_on_factory_revA = [
			29 01 00 00 00 00 03 F0 5A 5A	/* TEST KEY Enable */
			29 01 00 00 00 00 10 7A
				01 08 D4 08 D5 08 D6 08
				D7 08 10 00 00 00 00
			29 01 00 00 00 00 03 F0 A5 A5	/* TEST KEY Disable */
		];

		samsung,self_mask_off_revA = [
			29 01 00 00 00 00 03 F0 5A 5A	/* TEST KEY Enable  */
			29 01 00 00 00 00 02 7A 00		/* SM_MASK_EN(0)	*/
			29 01 00 00 00 00 03 F0 A5 A5	/* TEST KEY Disable */
		];

		/*
		 *************************************************************************************************************************
		 * Self Display Operation (SELF ICON)
		 *************************************************************************************************************************
		 */

		samsung,self_icon_mem_setting_revA = [
			29 01 00 00 22 00 03 7C 00 00	/* Self ICON Disable 34ms delay */
			29 01 00 00 00 00 02 75 08		/* MA_SEL, IC_SEL(1), VI_SEL, DC_SEL, AC_SEL */
			/* image data (4C,5C) ... */
		];

		samsung,self_icon_grid_revA = [  //need to check
			29 01 00 00 00 00 03 F0 5A 5A	/* TEST KEY Enable */
			29 01 00 00 00 00 16 7C
								00 11 02 00 02
								00 01 00 01 00
								70 11 00 00 00
								00 03 2F 08 D3 
								1E
			29 01 00 00 00 00 03 F0 A5 A5	/* TEST KEY Disable */
		];

		samsung,self_icon_on_grid_on_revA = [
			29 01 00 00 00 00 03 F0 5A 5A	/* TEST KEY Enable */
			29 01 00 00 00 00 0B 7C
				00 10 00 00 00 00 00 00
				00 00 70 11 00 00 00 00
				03 2F 08 D3 1E
			29 01 00 00 00 00 03 F0 A5 A5	/* TEST KEY Disable */
		];

		samsung,self_icon_on_grid_off_revA = [
			29 01 00 00 00 00 03 F0 5A 5A	/* TEST KEY Enable */
			29 01 00 00 00 00 0B 7C
				00 11 02 00 02 00 01 00
				01 00
			29 01 00 00 00 00 03 F0 A5 A5	/* TEST KEY Disable */
		];

		samsung,self_icon_off_grid_on_revA = [
			29 01 00 00 00 00 03 F0 5A 5A	/* TEST KEY Enable */
			29 01 00 00 00 00 16 7C
				00 10 00 00 00 00 00 00
				00 00 70 11 00 00 00 00
				05 A0 0B 90 1E
			29 01 00 00 00 00 03 F0 A5 A5	/* TEST KEY Disable */
		];

		samsung,self_icon_off_grid_off_revA = [
			29 01 00 00 00 00 03 F0 5A 5A	/* TEST KEY Enable */
			29 01 00 00 00 00 03 7C 00 00
			29 01 00 00 00 00 03 F0 A5 A5	/* TEST KEY Disable */
		];

		samsung,self_icon_grid_2c_sync_off_revA = [
			29 01 00 00 00 00 03 F0 5A 5A	/* TEST KEY Enable */
			29 01 00 00 00 00 02 7C 03
			29 01 00 00 00 00 03 F0 A5 A5	/* TEST KEY Disable */
		];

		/*
		 *************************************************************************************************************************
		 * Self Display Operation (SELF ALALOG CLOCK)
		 *************************************************************************************************************************
		 */

		samsung,self_aclock_sidemem_setting_revA = [
			29 01 00 00 22 00 03 77 00 00	/*Self Clock & Self Timer Off 34ms delay */
			29 01 00 00 00 00 02 75 01
			/* image data (4C,5C) ... */
		];

		samsung,self_aclock_on_revA = [
			29 01 00 00 00 00 03 F0 5A 5A	/* TEST KEY Enable */
			29 01 00 00 00 00 16 77
				00 07 00 0A 0A 1D 00 03
				00 01 97 02 00 00 00 5A
				14 5A 14 5A 14
			29 01 00 00 00 00 02 78 01		/* Time Update */
			29 01 00 00 00 00 03 F0 A5 A5	/* TEST KEY Disable */
		];

		samsung,self_aclock_time_update_revA = [
			29 01 00 00 00 00 03 F0 5A 5A	/* TEST KEY Enable */
/*			29 01 00 00 00 00 08 77
								00 07 00 05 03
								20 00
*/
			29 01 00 00 00 00 02 78 01		/* SC_TIME_UPDATE */
			29 01 00 00 00 00 03 F0 A5 A5	/* TEST KEY Disable */
		];

		samsung,self_aclock_rotation_revA = [
			29 01 00 00 00 00 03 F0 5A 5A	/* TEST KEY Enable */
			29 01 00 00 00 00 0F 77
				00 07 00 0A 0A 1D 00 03
				00 02 00 02 00 01
			29 01 00 00 00 00 03 F0 A5 A5	/* TEST KEY Disable */
		];

		samsung,self_aclock_off_revA = [
			29 01 00 00 00 00 03 F0 5A 5A	/* TEST KEY Enable */
			29 01 00 00 00 00 03 77 00 00
			29 01 00 00 00 00 03 F0 A5 A5	/* TEST KEY Disable */
		];

		samsung,self_aclock_hide_revA = [
			29 01 00 00 00 00 03 F0 5A 5A	/* TEST KEY Enable */
			29 01 00 00 00 00 03 77 00 05
			29 01 00 00 00 00 03 F0 A5 A5	/* TEST KEY Disable */
		];


		/*
		 *************************************************************************************************************************
		 * Self Display Operation (SELF DIGITAL CLOCK)
		 *************************************************************************************************************************
		 */

		samsung,self_dclock_sidemem_setting_revA = [
			29 01 00 00 22 00 03 77 00 00	/* Self Clock & Self Timer Off 34ms delay */
			29 01 00 00 00 00 02 75 02
			/* image data (4C,5C) ... */
		];

		samsung,self_dclock_on_revA = [
			29 01 00 00 00 00 03 F0 5A 5A	/* TEST KEY Enable */
			29 01 00 00 00 00 2A 77
				00 36 05 0A 03 00 00 03
				00 00 00 00 00 00 00 00
				00 00 00 00 00 01 2C 01
				90 01 F4 01 90 01 2C 02
				F4 02 F4 01 F4 00 C8 01
				64
			29 01 00 00 00 00 02 78 01		/* Time Update */
			29 01 00 00 00 00 03 F0 A5 A5	/* TEST KEY Disable */
		];

		samsung,self_dclock_blinking_on_revA = [
			29 01 00 00 00 00 03 F0 5A 5A	/* TEST KEY Enable */
			29 01 00 00 00 00 1B 79
				00 C0 00 00 00 00 57 01
				0A 0A 00 FF 00 00 FF 00
				02 08 06 72 02 08 06 D6
				1D 1D
			29 01 00 00 00 00 03 F0 A5 A5	/* TEST KEY Disable */
		];

		samsung,self_dclock_time_update_revA = [
			29 01 00 00 00 00 03 F0 5A 5A	/* TEST KEY Enable */
/*			29 01 00 00 00 00 08 77
								00 36 05 03 1A
								20 00
*/
			29 01 00 00 00 00 02 78 01		/* SC_TIME_UPDATE */
			29 01 00 00 00 00 03 F0 A5 A5	/* TEST KEY Disable */
		];

		samsung,self_dclock_off_revA = [
			29 01 00 00 00 00 03 F0 5A 5A	/* TEST KEY Enable */
			29 01 00 00 00 00 03 77 00 00
			29 01 00 00 00 00 03 F0 A5 A5	/* TEST KEY Disable */
		];

		samsung,self_dclock_hide_revA = [
			29 01 00 00 00 00 03 F0 5A 5A	/* TEST KEY Enable */
			29 01 00 00 00 00 03 77 00 14
			29 01 00 00 00 00 03 F0 A5 A5	/* TEST KEY Disable */
		];

		samsung,self_dclock_blinking_off_revA = [
			29 01 00 00 00 00 03 F0 5A 5A	/* TEST KEY Enable */
			29 01 00 00 00 00 03 79 00 00
			29 01 00 00 00 00 03 F0 A5 A5	/* TEST KEY Disable */
		];

		samsung,self_clock_2c_sync_off_revA = [
			29 01 00 00 00 00 03 F0 5A 5A	/* TEST KEY Enable */
			29 01 00 00 00 00 02 77 01
			29 01 00 00 00 00 03 F0 A5 A5	/* TEST KEY Disable */
		];

		/*
		 *************************************************************************************************************************
		 * Self Display Operation (DEBUGGING FEATURE)
		 *************************************************************************************************************************
		 */

		samsung,self_disp_debug_rx_cmds_revA = [ 06 01 00 00 00 00 01 7F 12 00];	/* read 7F 1st ~ 18th */

		samsung,self_mask_check_tx_pre1_revA = [
			29 01 00 00 00 00 03 9F A5 A5	/* TEST KEY Enable */
			29 01 00 00 00 00 03 F0 5A 5A	/* TEST KEY Enable */
			29 01 00 00 00 00 03 FC 5A 5A	/* TEST KEY Enable */
			29 01 00 00 14 00 02 7A 00	/* self mask off, delay 1 frame */

			/* side memory write */
			29 01 00 00 00 00 02 75 10
			29 01 00 00 00 00 02 75 10

			/* write self mask data (4C, 5C) */

			29 01 00 00 00 00 03 FC A5 A5	/* TEST KEY Disable */
			29 01 00 00 00 00 03 F0 A5 A5	/* TEST KEY Disable */
			29 01 00 00 00 00 03 9F 5A 5A	/* TEST KEY Enable */
		];

		samsung,self_mask_check_tx_pre2_revA = [
			29 01 00 00 00 00 03 9F A5 A5	/* TEST KEY Enable */
			29 01 00 00 00 00 03 F0 5A 5A	/* TEST KEY Enable */
			29 01 00 00 00 00 03 FC 5A 5A	/* TEST KEY Enable */

			29 01 00 00 00 00 02 75 01

			29 01 00 00 00 00 02 B0 1B
			29 01 00 00 00 00 02 FE 80
			29 01 00 00 00 00 02 B0 2F
			29 01 00 00 00 00 02 FE 25
			29 01 00 00 00 00 0A BF 01 07 00 00 00 10 00 00 00
			29 01 00 00 28 00 10 7A			/* self mask on */
						01 01 F4 02 33 08 D4 08 D5 08 10 3F FF FF FF /* delay 2frame */

			/* delay 2 frames in self_mask_check() function */

			29 01 00 00 00 00 03 FC A5 A5	/* TEST KEY Disable */
			29 01 00 00 00 00 03 F0 A5 A5	/* TEST KEY Disable */
			29 01 00 00 00 00 03 9F 5A 5A	/* TEST KEY Enable */
		];

		samsung,self_mask_check_rx_cmds_revA = [ 06 01 00 00 00 00 01 FB 08 0C];	/* read FBh 13th ~ 20th */

		samsung,self_mask_check_tx_post_revA = [
			29 01 00 00 00 00 03 9F A5 A5	/* TEST KEY Enable */
			29 01 00 00 00 00 03 F0 5A 5A	/* TEST KEY Enable */
			29 01 00 00 00 00 03 FC 5A 5A	/* TEST KEY Enable */

			29 01 00 00 00 00 10 7A
						01 08 D4 08 D5 08 D6 08 D7 08 10 00 00 00 00
						/* self mask restore */

			29 01 00 00 00 00 0A BF 00 07 FF 00 00 10 00 00 00	/* Exit DBIST */
			29 01 00 00 00 00 03 FC A5 A5	/* TEST KEY Disable */
			29 01 00 00 00 00 03 F0 A5 A5	/* TEST KEY Disable */
			29 01 00 00 00 00 03 9F 5A 5A	/* TEST KEY Enable */
		];
	};
};
