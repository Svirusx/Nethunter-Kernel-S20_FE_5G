/* Copyright (c) 2012, Samsung Electronics Corporation. All rights reserved.
 *
 * This program is free software; you can redistribute it and/or modify
 * it under the terms of the GNU General Public License version 2 and
 * only version 2 as published by the Free Software Foundation.
 *
 * This program is distributed in the hope that it will be useful,
 * but WITHOUT ANY WARRANTY; without even the implied warranty of
 * MERCHANTABILITY or FITNESS FOR A PARTICULAR PURPOSE.  See the
 * GNU General Public License for more details.
 */

&mdss_mdp {
	ss_dsi_panel_S6TUUM1_AMSA24VU01_WQXGA: ss_dsi_panel_S6TUUM1_AMSA24VU01_WQXGA {
		qcom,mdss-dsi-panel-name = "ss_dsi_panel_S6TUUM1_AMSA24VU01_WQXGA";
		label = "ss_dsi_panel_S6TUUM1_AMSA24VU01_WQXGA";

		qcom,mdss-dsi-bpp = <24>;

		/*qcom,cmd-sync-wait-broadcast;*/

		qcom,mdss-dsi-h-pulse-width = <24>;
		qcom,mdss-dsi-h-back-porch = <16>;
		qcom,mdss-dsi-h-front-porch = <20>;
		qcom,mdss-dsi-h-sync-skew = <0>;

		qcom,mdss-dsi-v-pulse-width = <24>;
		qcom,mdss-dsi-v-back-porch = <16>;
		qcom,mdss-dsi-v-front-porch = <16>;

		qcom,mdss-dsi-h-left-border = <0>;
		qcom,mdss-dsi-h-right-border = <0>;
		qcom,mdss-dsi-v-top-border = <0>;
		qcom,mdss-dsi-v-bottom-border = <0>;

		qcom,mdss-dsi-underflow-color = <0xFF>;
		qcom,mdss-dsi-border-color = <0>;

		qcom,mdss-dsi-panel-framerate = <60>;
		//qcom,mdss-dsi-panel-clockrate = <1500000000>;
		qcom,mdss-dsi-panel-phy-timings = [00 30 0D 0D 2A 28 0C 0D 09 02 04 00 27 1C];	// 1500 Mbps
		qcom,mdss-dsi-t-clk-pre = <0x27>;
		qcom,mdss-dsi-t-clk-post = <0x1C>;

		qcom,mdss-dsi-bl-pmic-control-type = "bl_ctrl_dcs";

		qcom,mdss-dsi-bl-min-level = <1>;
		qcom,mdss-dsi-bl-max-level = <355>;
		qcom,mdss-brightness-max-level = <355>;
		qcom,mdss-brightness-default-level = <255>;
		qcom,mdss-dsi-interleave-mode = <0>;
		qcom,mdss-dsi-panel-type = "dsi_cmd_mode";

		qcom,mdss-dsi-te-check-enable;
		qcom,mdss-dsi-te-using-te-pin;
		qcom,mdss-dsi-te-pin-select = <1>;

		/*qcom,dynamic-mode-switch-enabled;*/
		/*qcom,dynamic-mode-switch-type = "dynamic-resolution-switch-immediate";*/

		qcom,mdss-dsi-te-dcs-command = <1>;
		qcom,mdss-dsi-wr-mem-start = <0x2C>;
		qcom,mdss-dsi-wr-mem-continue = <0x3C>;

		qcom,mdss-dsi-pixel-packing = "loose";

		qcom,mdss-dsi-virtual-channel-id = <0>;
		qcom,mdss-dsi-color-order = "rgb_swap_rgb";
		qcom,mdss-dsi-lane-0-state;
		//qcom,mdss-dsi-lane-1-state;
		//qcom,mdss-dsi-lane-2-state;
		//qcom,mdss-dsi-lane-3-state;
		//qcom,mdss-dsi-lane-map = "lane_map_0123";
		samsung,num_of_data_lanes = <1>;

		qcom,mdss-dsi-stream = <0>;
		qcom,mdss-dsi-mdp-trigger = "none";
		qcom,mdss-dsi-dma-trigger = "trigger_sw";

		qcom,mdss-pan-physical-width-dimension = <272>; /* 272.82, round off */
		qcom,mdss-pan-physical-height-dimension = <175>; /* 175.0608, round off */

		qcom,mdss-dsi-reset-sequence = <0 5>, <1 5>;

		/*qcom,mdss-dsi-lp11-init;*/
		/*qcom,mdss-dsi-init-delay-us = <1000>;*/

		qcom,mdss-dsi-rx-eot-ignore;
		qcom,mdss-dsi-tx-eot-append;

		/* HDR Setting */
		qcom,mdss-dsi-panel-hdr-enabled;
		qcom,mdss-dsi-panel-hdr-color-primaries = <15635 16450 34000 16000 13250 34500 7500 3000>;
		qcom,mdss-dsi-panel-peak-brightness = <5400000>;
		qcom,mdss-dsi-panel-average-brightness = <2000000>;
		qcom,mdss-dsi-panel-blackness-level = <2000>;

		qcom,ulps-enabled;
		/* qcom,suspend-ulps-enabled; */
		qcom,esd-check-enabled;
		//qcom,mdss-dsi-panel-status-check-mode ="irq_check";
		/*qcom,mdss-dsi-panel-status-read-length;*/
		/*qcom,mdss-dsi-panel-status-value;*/
		/*qcom,mdss-dsi-panel-status-irq-trigger1 = "rising";*/
		qcom,mdss-dsi-panel-status-irq-trigger1 = "falling";

		/* *************************************************************
		 * Below  parameters are samsung dependent thigs
		 * *************************************************************
		 */
		samsung,panel-vendor = "SDC";
		samsung,disp-model = "AMSA24VU01";
		/*samsung,tcon-clk-on-support;*/ /* Enable only if HS clock is needed always like ANA */
		samsung,anapass-power-seq;
		samsung,delay-after-tcon-ready = <100>;
		//samsung,panel-lpm-enable;
		samsung,esc-clk-128M;
		samsung,support_gamma_mode2;
		//samsung,support_irc;
		//samsung,elvss_interpolation_temperature = <(-15)>;
		//samsung,support_factory_panel_swap;
		//samsung,support_gct;
		//samsung,support_pac;
		//samsung,support_gpara;
		// samsung,support_poc_driver;
		//samsung,support_dynamic_mipi_clk;
		samsung,pll_ssc_disabled;
		samsung,need_brightness_lock;
		samsung,no_qcom_pps;

		/* *************************************************************
		 *  Tx
		 * *************************************************************
		 */
		//samsung,level0_key_enable_tx_cmds_revA	= [29 01 00 00 00 00 03 9F A5 A5]; /* PASSWD0 */
		//samsung,level0_key_disable_tx_cmds_revA	= [29 01 00 00 00 00 03 9F 5A 5A]; /* PASSWD0 */
		//samsung,level1_key_enable_tx_cmds_revA	= [29 01 00 00 00 00 03 F0 5A 5A]; /* PASSWD1 */
		//samsung,level1_key_disable_tx_cmds_revA	= [29 01 00 00 00 00 03 F0 A5 A5]; /* PASSWD1 */
		//samsung,level2_key_enable_tx_cmds_revA	= [29 01 00 00 00 00 03 FC 5A 5A];
		//samsung,level2_key_disable_tx_cmds_revA	= [29 01 00 00 00 00 03 FC A5 A5];

		/* BRIGHTNESS_MAX_PACKET = 50 */
		samsung,brightness_tx_cmds_revA = [
			39 01 00 00 00 00 01 00
			39 01 00 00 00 00 01 00
			39 01 00 00 00 00 01 00
			39 01 00 00 00 00 01 00
			39 01 00 00 00 00 01 00
			39 01 00 00 00 00 01 00
			39 01 00 00 00 00 01 00
			39 01 00 00 00 00 01 00
			39 01 00 00 00 00 01 00
			39 01 00 00 00 00 01 00
			39 01 00 00 00 00 01 00
			39 01 00 00 00 00 01 00
			39 01 00 00 00 00 01 00
			39 01 00 00 00 00 01 00
			39 01 00 00 00 00 01 00
			39 01 00 00 00 00 01 00
			39 01 00 00 00 00 01 00
			39 01 00 00 00 00 01 00
			39 01 00 00 00 00 01 00
			39 01 00 00 00 00 01 00
			39 01 00 00 00 00 01 00
			39 01 00 00 00 00 01 00
			39 01 00 00 00 00 01 00
			39 01 00 00 00 00 01 00
			39 01 00 00 00 00 01 00
			39 01 00 00 00 00 01 00
			39 01 00 00 00 00 01 00
			39 01 00 00 00 00 01 00
			39 01 00 00 00 00 01 00
			39 01 00 00 00 00 01 00
			39 01 00 00 00 00 01 00
			39 01 00 00 00 00 01 00
			39 01 00 00 00 00 01 00
			39 01 00 00 00 00 01 00
			39 01 00 00 00 00 01 00
			39 01 00 00 00 00 01 00
			39 01 00 00 00 00 01 00
			39 01 00 00 00 00 01 00
			39 01 00 00 00 00 01 00
			39 01 00 00 00 00 01 00
			39 01 00 00 00 00 01 00
			39 01 00 00 00 00 01 00
			39 01 00 00 00 00 01 00
			39 01 00 00 00 00 01 00
			39 01 00 00 00 00 01 00
			39 01 00 00 00 00 01 00
			39 01 00 00 00 00 01 00
			39 01 00 00 00 00 01 00
			39 01 00 00 00 00 01 00
			39 01 00 00 00 00 01 00
		];

		//samsung,mdnie_tx_cmds_revA = [
		//	39 01 00 00 00 00 00 00 00
		//];

		//samsung,packet_size_tx_cmds_revA = [
		//7 01 00 00 00 00 02 07 00
		//];

		//samsung,reg_read_pos_tx_cmds_revA = [
		//	15 01 00 00 00 00 02 B0 00
		//];

		//samsung,manufacture_read_pre_tx_cmds_revA = [
		//	05 01 00 00 14 00 02 11 00			/* Sleep out, wait 20ms(0x14) */
		//];

		//samsung,display_on_tx_cmds_revA = [
		//	05 01 00 00 00 00 02 29 00
		//];

		samsung,display_off_tx_cmds_revA = [05 01 00 00 00 00 02 28 00];

		/* *************************************************************
		 *  Rx (Module Information READ)
		 * *************************************************************
		 */
		samsung,mdnie_read_rx_cmds_revA		= [06 01 00 00 00 00 01 A1 04 00]; /* White color position */
		samsung,manufacture_date_rx_cmds_revA	= [06 01 00 00 00 00 01 A1 04 04]; /* manufacture data 4 byte*/
		samsung,octa_id_rx_cmds_revA		= [06 01 00 00 00 00 01 A1 14 0B]; /* manufacture information */
		samsung,cell_id_rx_cmds_revA		= [06 01 00 00 00 00 01 A1 07 04]; /* manufacture data 7 byte*/
		samsung,ddi_id_rx_cmds_revA		= [06 01 00 00 00 00 01 d6 05 00]; /* CHIP ID : read D6 1~5th */

		samsung,manufacture_id0_rx_cmds_revA	= [06 01 00 00 00 00 01 da 01 00];
		samsung,manufacture_id1_rx_cmds_revA	= [06 01 00 00 00 00 01 db 01 00];
		samsung,manufacture_id2_rx_cmds_revA	= [06 01 00 00 00 00 01 dc 01 00];

		//samsung,smart_dimming_mtp_rx_cmds_revA	= [06 01 00 00 00 00 01 c8 20 00];

		samsung,ldi_debug0_rx_cmds_revA		= [06 01 00 00 00 00 01 0A 01 00]; /* rddpm */
		//samsung,ldi_debug1_rx_cmds_revA		= [06 01 00 00 00 00 01 0E 01 00]; /* no operation */
		samsung,ldi_debug2_rx_cmds_revA		= [06 01 00 00 00 00 01 0E 01 00]; /* errfg */
		samsung,ldi_debug3_rx_cmds_revA		= [06 01 00 00 00 00 01 0E 01 00]; /* rddsm*/
		samsung,ldi_debug4_rx_cmds_revA		= [06 01 00 00 00 00 01 05 01 00]; /* dsierr */
		//samsung,ldi_debug5_rx_cmds_revA		= [06 01 00 00 00 00 01 0F 01 00]; /* self_diag*/

		/* 255 bytes, its ddi max size is 512, and sw limit is ff = 255... */
		//samsung,ldi_debug_logbuf_rx_cmds_revA	= [06 01 00 00 00 00 01 9C FF 00];

		samsung,mtp_read_sysfs_rx_cmds_revA	= [06 01 00 00 00 00 01 00 00 00];
		samsung,mtp_write_sysfs_tx_cmds_revA	= [
			39 00 00 00 00 00 3D 00
						00 00 00 00 00 00 00 00 00 00
						00 00 00 00 00 00 00 00 00 00
						00 00 00 00 00 00 00 00 00 00
						00 00 00 00 00 00 00 00 00 00
						00 00 00 00 00 00 00 00 00 00
						00 00 00 00 00 00 00 00 00 00
		];

		/* *************************************************************
		 *  Finger Print Green Circle
		 * *************************************************************
		 */
		samsung,fp_green_circle_on_tx_cmds_revA = [
			29 01 00 00 00 00 03 F0 5A 5A
			29 01 00 00 00 00 02 7A 21
			29 01 00 00 00 00 03 F0 A5 A5
		];

		samsung,fp_green_circle_off_tx_cmds_revA = [
			29 01 00 00 00 00 03 F0 5A 5A
			29 01 00 00 00 00 02 7A 23
			29 01 00 00 00 00 03 F0 A5 A5
		];

		/* *************************************************************
		 * TEST MODE
		 * **************************************************************
		 */

		/* DIA */
		//samsung,dia_on_tx_cmds_revA = [
		//	05 01 00 00 32 00 01 15
		//];

		//samsung,dia_off_tx_cmds_revA = [
		//	39 01 00 00 00 00 0B F0 00 00 00 00 02 00 00 00 12 34
		//];

		/* MCD TEST */
		samsung,mcd_on_tx_cmds_revA = [
					05 01 00 00 00 00 02 15 00
					39 01 00 00 00 00 0B F0 00 00 00 00 02 00 00 00 11 22
		];

		samsung,mcd_off_tx_cmds_revA = [
					05 01 00 00 00 00 02 15 00
					39 01 00 00 00 00 0B F0 00 00 00 00 02 00 00 00 55 66
		];


		/* *************************************************************
		 * ACL command list and mappings
		 * **************************************************************
		 */
#if 0
		samsung,acl_on_tx_cmds_revA = [
			/* 32 frame AVG ACL ON, Start 50%, ACL 15%, 32Frame AVG */
			29 01 00 00 00 00 02 55 02	/* ACL ON */
		];

		samsung,acl_off_tx_cmds_revA = [
			/* 16 Frame AVG ACL OFF, Start Point 60%, ACL 0%*/
			29 01 00 00 00 00 02 55 00	/* ACL OFF */
		];
#endif

		samsung,elvss_rx_cmds_revA = [ 06 01 00 00 00 00 01 B7 02 08];	/* read B7 9th, 10th para */

		/* *************************************************************
		 * candela to index mappings
		 * **************************************************************
		 */
		samsung,candela_map_table_revA = < /* THIS TABLE USED FOR DIMMING */
		/* <idx> <from> <till> <gm2_wrdisbv> <cd> */
			0		0		0		10 				2
			1		1		1		13 				3
			2		2		2		16 				4
			3		3		3		24 				6
			4		4		4		32 				7
			5		5		5		40 				8
			6		6		6		48 				9
			7		7		7		56 				10
			8		8		8		64 				12
			9		9		9		72 				13
			10		10		10		80 				14
			11		11		11		88 				15
			12		12		12		96 				16
			13		13		13		104 			18
			14		14		14		112 			19
			15		15		15		120 			20
			16		16		16		128 			22
			17		17		17		136 			23
			18		18		18		144 			24
			19		19		19		153 			26
			20		20		20		161 			27
			21		21		21		169 			29
			22		22		22		177 			30
			23		23		23		185 			32
			24		24		24		193 			33
			25		25		25		201 			34
			26		26		26		209 			36
			27		27		27		217 			37
			28		28		28		225 			39
			29		29		29		233 			40
			30		30		30		241 			42
			31		31		31		249 			43
			32		32		32		257 			44
			33		33		33		265 			46
			34		34		34		273 			47
			35		35		35		281 			49
			36		36		36		289 			50
			37		37		37		297 			52
			38		38		38		305 			53
			39		39		39		313 			54
			40		40		40		321 			56
			41		41		41		329 			58
			42		42		42		337 			59
			43		43		43		345 			60
			44		44		44		353 			62
			45		45		45		361 			63
			46		46		46		369 			65
			47		47		47		377 			66
			48		48		48		385 			68
			49		49		49		393 			69
			50		50		50		401 			70
			51		51		51		409 			72
			52		52		52		417 			73
			53		53		53		425 			75
			54		54		54		433 			76
			55		55		55		442 			78
			56		56		56		450 			79
			57		57		57		458 			80
			58		58		58		466 			82
			59		59		59		474 			83
			60		60		60		482 			85
			61		61		61		490 			86
			62		62		62		498 			88
			63		63		63		506 			89
			64		64		64		514 			90
			65		65		65		522 			92
			66		66		66		530 			94
			67		67		67		538 			95
			68		68		68		546 			97
			69		69		69		554 			98
			70		70		70		562 			99
			71		71		71		570 			101
			72		72		72		578 			102
			73		73		73		586 			104
			74		74		74		594 			105
			75		75		75		602 			107
			76		76		76		610 			108
			77		77		77		618 			109
			78		78		78		626 			111
			79		79		79		634 			112
			80		80		80		642 			114
			81		81		81		650 			115
			82		82		82		658 			117
			83		83		83		666 			118
			84		84		84		674 			120
			85		85		85		682 			121
			86		86		86		690 			123
			87		87		87		698 			124
			88		88		88		706 			125
			89		89		89		714 			127
			90		90		90		722 			128
			91		91		91		730 			130
			92		92		92		739 			131
			93		93		93		747 			133
			94		94		94		755 			134
			95		95		95		763 			135
			96		96		96		771 			137
			97		97		97		779 			138
			98		98		98		787 			140
			99		99		99		795 			141
			100		100		100		803 			143
			101		101		101		811 			144
			102		102		102		819 			145
			103		103		103		827 			147
			104		104		104		835 			149
			105		105		105		843 			150
			106		106		106		851 			151
			107		107		107		859 			153
			108		108		108		867 			154
			109		109		109		875 			156
			110		110		110		883 			157
			111		111		111		891 			159
			112		112		112		899 			160
			113		113		113		907 			161
			114		114		114		915 			163
			115		115		115		923 			164
			116		116		116		931 			166
			117		117		117		939 			167
			118		118		118		947 			169
			119		119		119		955 			170
			120		120		120		963 			171
			121		121		121		971 			173
			122		122		122		979 			174
			123		123		123		987 			176
			124		124		124		995 			177
			125		125		125		1003 			179
			126		126		126		1011 			180
			127		127		127		1019 			181
			128		128		128		1028 			183
			129		129		129		1036 			185
			130		130		130		1044 			187
			131		131		131		1052 			188
			132		132		132		1060 			191
			133		133		133		1068 			192
			134		134		134		1076 			194
			135		135		135		1084 			196
			136		136		136		1092 			198
			137		137		137		1100 			200
			138		138		138		1108 			202
			139		139		139		1116 			203
			140		140		140		1124 			206
			141		141		141		1132 			207
			142		142		142		1140 			209
			143		143		143		1148 			211
			144		144		144		1156 			213
			145		145		145		1164 			215
			146		146		146		1172 			216
			147		147		147		1180 			218
			148		148		148		1188 			220
			149		149		149		1196 			222
			150		150		150		1204 			224
			151		151		151		1212 			226
			152		152		152		1220 			228
			153		153		153		1228 			230
			154		154		154		1236 			231
			155		155		155		1244 			233
			156		156		156		1252 			235
			157		157		157		1260 			237
			158		158		158		1268 			239
			159		159		159		1276 			241
			160		160		160		1284 			243
			161		161		161		1292 			245
			162		162		162		1300 			246
			163		163		163		1308 			249
			164		164		164		1317 			250
			165		165		165		1325 			252
			166		166		166		1333 			254
			167		167		167		1341 			256
			168		168		168		1349 			258
			169		169		169		1357 			259
			170		170		170		1365 			261
			171		171		171		1373 			263
			172		172		172		1381 			265
			173		173		173		1389 			267
			174		174		174		1397 			269
			175		175		175		1405 			271
			176		176		176		1413 			273
			177		177		177		1421 			274
			178		178		178		1429 			276
			179		179		179		1437 			278
			180		180		180		1445 			280
			181		181		181		1453 			282
			182		182		182		1461 			284
			183		183		183		1469 			286
			184		184		184		1477 			287
			185		185		185		1485 			289
			186		186		186		1493 			291
			187		187		187		1501 			293
			188		188		188		1509 			295
			189		189		189		1517 			297
			190		190		190		1525 			299
			191		191		191		1533 			301
			192		192		192		1541 			302
			193		193		193		1549 			304
			194		194		194		1557 			306
			195		195		195		1565 			308
			196		196		196		1573 			310
			197		197		197		1581 			312
			198		198		198		1589 			314
			199		199		199		1597 			316
			200		200		200		1605 			317
			201		201		201		1614 			319
			202		202		202		1622 			321
			203		203		203		1630 			323
			204		204		204		1638 			325
			205		205		205		1646 			327
			206		206		206		1654 			329
			207		207		207		1662 			330
			208		208		208		1670 			332
			209		209		209		1678 			334
			210		210		210		1686 			336
			211		211		211		1694 			338
			212		212		212		1702 			340
			213		213		213		1710 			342
			214		214		214		1718 			344
			215		215		215		1726 			345
			216		216		216		1734 			347
			217		217		217		1742 			349
			218		218		218		1750 			351
			219		219		219		1758 			353
			220		220		220		1766 			354
			221		221		221		1774 			357
			222		222		222		1782 			358
			223		223		223		1790 			360
			224		224		224		1798 			362
			225		225		225		1806 			364
			226		226		226		1814 			366
			227		227		227		1822 			368
			228		228		228		1830 			370
			229		229		229		1838 			372
			230		230		230		1846 			373
			231		231		231		1854 			375
			232		232		232		1862 			377
			233		233		233		1870 			379
			234		234		234		1878 			381
			235		235		235		1886 			383
			236		236		236		1894 			385
			237		237		237		1903 			386
			238		238		238		1911 			388
			239		239		239		1919 			390
			240		240		240		1927 			392
			241		241		241		1935 			394
			242		242		242		1943 			396
			243		243		243		1951 			397
			244		244		244		1959 			400
			245		245		245		1967 			401
			246		246		246		1975 			403
			247		247		247		1983 			405
			248		248		248		1991 			407
			249		249		249		1999 			409
			250		250		250		2007 			411
			251		251		251		2015 			412
			252		252		252		2023 			415
			253		253		253		2031 			416
			254		254		254		2039 			418
			255		255		255		2047			420
		>;

		samsung,hbm_candela_map_table_revA = <
		/* <idx> <from> <till> <gm2_wrdisbv> <cd> <auto> */
			0		256		256		2047		421		0
			1		257		257		2047		423		0
			2		258		258		2047		424		0
			3		259		259		2047		425		0
			4		260		260		2047		428		0
			5		261		261		2047		429		0
			6		262		262		2047		431		0
			7		263		263		2047		432		0
			8		264		264		2047		434		0
			9		265		265		2047		436		0
			10		266		266		2047		437		0
			11		267		267		2047		439		0
			12		268		268		2047		441		0
			13		269		269		2047		442		0
			14		270		270		2047		444		0
			15		271		271		2047		446		0
			16		272		272		2047		447		0
			17		273		273		2047		449		0
			18		274		274		2047		450		0
			19		275		275		2047		453		0
			20		276		276		2047		454		0
			21		277		277		2047		455		0
			22		278		278		2047		457		0
			23		279		279		2047		459		0
			24		280		280		2047		460		0
			25		281		281		2047		462		0
			26		282		282		2047		464		0
			27		283		283		2047		466		0
			28		284		284		2047		467		0
			29		285		285		2047		469		0
			30		286		286		2047		471		0
			31		287		287		2047		472		0
			32		288		288		2047		473		0
			33		289		289		2047		476		0
			34		290		290		2047		477		0
			35		291		291		2047		479		0
			36		292		292		2047		480		0
			37		293		293		2047		482		0
			38		294		294		2047		484		0
			39		295		295		2047		485		0
			40		296		296		2047		487		0
			41		297		297		2047		489		0
			42		298		298		2047		490		0
			43		299		299		2047		492		0
			44		300		300		2047		494		0
			45		301		301		2047		495		0
			46		302		302		2047		497		0
			47		303		303		2047		498		0
			48		304		304		2047		500		0
			49		305		305		2047		502		0
			50		306		306		2047		503		0
			51		307		307		2047		505		0
			52		308		308		2047		507		0
			53		309		309		2047		508		0
			54		310		310		2047		510		0
			55		311		311		2047		512		0
			56		312		312		2047		513		0
			57		313		313		2047		515		0
			58		314		314		2047		517		0
			59		315		315		2047		519		0
			60		316		316		2047		520		0
			61		317		317		2047		521		0
			62		318		318		2047		523		0
			63		319		319		2047		525		0
			64		320		320		2047		526		0
			65		321		321		2047		528		0
			66		322		322		2047		530		0
			67		323		323		2047		532		0
			68		324		324		2047		533		0
			69		325		325		2047		535		0
			70		326		326		2047		537		0
			71		327		327		2047		538		0
			72		328		328		2047		539		0
			73		329		329		2047		542		0
			74		330		330		2047		543		0
			75		331		331		2047		545		0
			76		332		332		2047		546		0
			77		333		333		2047		548		0
			78		334		334		2047		550		0
			79		335		335		2047		551		0
			80		336		336		2047		553		0
			81		337		337		2047		555		0
			82		338		338		2047		556		0
			83		339		339		2047		558		0
			84		340		340		2047		560		0
			85		341		341		2047		561		0
			86		342		342		2047		563		0
			87		343		343		2047		564		0
			88		344		344		2047		566		0
			89		345		345		2047		568		0
			90		346		346		2047		569		0
			91		347		347		2047		571		0
			92		348		348		2047		573		0
			93		349		349		2047		574		0
			94		350		350		2047		576		0
			95		351		351		2047		578		0
			96		352		352		2047		580		0
			97		353		353		2047		581		0
			98		354		354		2047		583		0
			99		355		355		2047		585		0
			100		356		356		2047		586		0
			101		357		357		2047		587		0
			102		358		358		2047		589		0
			103		359		359		2047		591		0
			104		360		360		2047		593		0
			105		361		361		2047		594		0
			106		362		362		2047		596		0
			107		363		363		2047		598		0
			108		364		364		2047		599		0
			109		365		365		2047		601		0
			110		366		366		2047		603		0
			111		367		367		2047		604		0
			112		368		368		2047		606		0
			113		369		369		2047		608		0
			114		370		370		2047		609		0
			115		371		371		2047		611		0
			116		372		372		2047		612		0
			117		373		373		2047		614		0
			118		374		374		2047		616		0
			119		375		375		2047		617		0
			120		376		376		2047		619		0
			121		377		377		2047		621		0
			122		378		378		2047		622		0
			123		379		379		2047		624		0
			124		380		380		2047		626		0
			125		381		381		2047		627		0
			126		382		382		2047		629		0
			127		383		383		2047		630		0
			128		384		384		2047		633		0
			129		385		385		2047		634		0
			130		386		386		2047		635		0
			131		387		387		2047		637		0
			132		388		388		2047		639		0
			133		389		389		2047		640		0
			134		390		390		2047		642		0
			135		391		391		2047		644		0
			136		392		392		2047		646		0
			137		393		393		2047		647		0
			138		394		394		2047		649		0
			139		395		395		2047		651		0
			140		396		396		2047		652		0
			141		397		397		2047		653		0
			142		398		398		2047		656		0
			143		399		399		2047		657		0
			144		400		400		2047		659		0
			145		401		401		2047		660		0
			146		402		402		2047		662		0
			147		403		403		2047		664		0
			148		404		404		2047		665		0
			149		405		405		2047		667		0
			150		406		406		2047		669		0
			151		407		407		2047		670		0
			152		408		408		2047		672		0
			153		409		409		2047		674		0
			154		410		410		2047		675		0
			155		411		411		2047		677		0
			156		412		412		2047		678		0
			157		413		413		2047		680		0
			158		414		414		2047		682		0
			159		415		415		2047		683		0
			160		416		416		2047		685		0
			161		417		417		2047		687		0
			162		418		418		2047		688		0
			163		419		419		2047		690		0
			164		420		420		2047		692		0
			165		421		421		2047		693		0
			166		422		422		2047		695		0
			167		423		423		2047		697		0
			168		424		424		2047		699		0
			169		425		425		2047		700		0
		>;

		samsung,gamma_mode2_normal_tx_cmds_revA=[
			05 01 00 00 00 00 01 15
			39 01 00 00 00 00 0A 53 00 00 00 00 01 00 00 00 20
			05 01 00 00 00 00 01 15
			39 01 00 00 00 00 0B 51 00 00 00 00 02 00 00 00 D8 0D
		]; /* B5 1th para: TSET */

		samsung,gamma_mode2_hbm_tx_cmds_revA=[
			05 01 00 00 00 00 01 15
			39 01 00 00 00 00 0A 53 00 00 00 00 01 00 00 00 E0
			05 01 00 00 00 00 01 15
			39 01 00 00 00 00 0B 51 00 00 00 00 02 00 00 00 FF 07
		]; /* B5 1th para: TSET */

		/* *************************************************************
		 * Dynamic MIPI Clock
		 * **************************************************************
		 */
#if 0
		samsung,ffc_tx_cmds_revA = [
			29 00 00 00 00 00 03 FC 5A 5A		/* TEST KEY3 Enable*/
			29 00 00 00 00 00 06 C5 09 30 0E 26 BE	/* default: 897.6 Mbps */
			29 00 00 00 00 00 03 FC A5 A5		/* TEST KEY3 Disable*/
		];

	        samsung,dyn_mipi_clk_ffc_cmds_revA = [
	            29 00 00 00 00 00 08 C5 0D 00 C8 29 0F 29 0F    /* 0. Default 1362 Mbps */
	            29 00 00 00 00 00 08 C5 0D 00 C8 2A 1C 2A 1C    /* 1. 1328 Mbps */
	            29 00 00 00 00 00 08 C5 0D 00 C8 29 0F 29 0F    /* 2. 1362 Mbps */
	            29 00 00 00 00 00 08 C5 0D 00 C8 28 E1 28 E1    /* 3. 1368 Mbps */
	            29 00 00 00 00 00 08 C5 0D 00 C8 28 E1 28 E1    /* 4. 1368 Mbps */
	        ];
#endif
	        samsung,dynamic_mipi_clk_timing_table = <
	            /*<bitclk><>*/
	            1500000000 /* clk id 0 default */
      	            1500000000 /* clk id 1 default */
	            1488000000 /* clk id 2 */
	            1514000000 /* clk id 3 */
	            1540000000 /* clk id 4 */
	            1576000000 /* clk id 5 */
	        >;

		samsung,dynamic_mipi_clk_sel_table = <
			/*<RAT><BAND><from><end><clk index>*/
			1	1	128	232	1
			1	1	233	251	2
			1	2	0	27	3
			1	2	28	124	4
			1	2	975	1023	3
			1	3	512	611	1
			1	3	612	666	2
			1	3	667	748	4
			1	3	749	854	2
			1	3	855	885	3
			1	4	512	605	2
			1	4	606	704	4
			1	4	705	794	2
			1	4	795	810	3
			2	11	10562	10618	4
			2	11	10619	10685	2
			2	11	10686	10768	3
			2	11	10769	10838	2
			2	12	9662	9744	2
			2	12	9745	9843	4
			2	12	9844	9932	2
			2	12	9933	9938	3
			2	13	1162	1249	1
			2	13	1250	1305	2
			2	13	1306	1386	4
			2	13	1387	1493	2
			2	13	1494	1513	3
			2	14	1537	1595	1
			2	14	1596	1660	2
			2	14	1661	1738	3
			2	15	4357	4449	1
			2	15	4450	4458	2
			2	17	2237	2261	4
			2	17	2262	2363	1
			2	17	2364	2455	4
			2	17	2456	2550	1
			2	17	2551	2563	2
			2	18	2937	3001	3
			2	18	3002	3088	4
			3	91	0	142	1
			3	91	143	271	2
			3	91	272	437	3
			3	91	438	599	2
			3	92	600	789	2
			3	92	790	987	4
			3	92	988	1166	2
			3	92	1167	1199	3
			3	93	1200	1400	1
			3	93	1401	1511	2
			3	93	1512	1674	4
			3	93	1675	1887	2
			3	93	1888	1949	3
			3	94	1950	2092	1
			3	94	2093	2221	2
			3	94	2222	2387	3
			3	94	2388	2399	1
			3	95	2400	2610	1
			3	95	2611	2649	2
			3	97	2750	2824	4
			3	97	2825	3028	1
			3	97	3029	3212	4
			3	97	3213	3402	1
			3	97	3403	3449	2
			3	98	3450	3604	3
			3	98	3605	3799	4
			3	102	5010	5179	3
			3	103	5180	5279	4
			3	104	5280	5379	1
			3	107	5730	5849	3
			3	108	5850	5999	4
			3	109	6000	6149	1
			3	110	6150	6302	4
			3	110	6303	6449	3
			3	111	6450	6582	3
			3	111	6583	6599	1
			3	115	8040	8229	2
			3	115	8230	8427	4
			3	115	8428	8606	2
			3	115	8607	8689	3
			3	116	8690	8745	3
			3	116	8746	8937	4
			3	116	8938	9039	2
			3	118	9210	9408	1
			3	118	9409	9517	3
			3	118	9518	9659	4
			3	119	9660	9769	4
			3	120	9770	9869	2
			3	122	9920	10112	3
			3	122	10113	10284	1
			3	122	10285	10359	2
			3	124	36200	36342	2
			3	124	36343	36349	3
			3	128	37750	37937	4
			3	128	37938	38154	1
			3	128	38155	38249	2
			3	129	38250	38448	1
			3	129	38449	38563	2
			3	129	38564	38649	3
			3	130	38650	38824	4
			3	130	38825	38902	2
			3	130	38903	39083	3
			3	130	39084	39278	2
			3	130	39279	39462	3
			3	130	39463	39649	2
			3	131	39650	39823	2
			3	131	39824	40046	1
			3	131	40047	40199	2
			3	131	40200	40420	1
			3	131	40421	40577	4
			3	131	40578	40794	1
			3	131	40795	40964	4
			3	131	40965	41168	1
			3	131	41169	41352	4
			3	131	41353	41542	1
			3	131	41543	41589	2
			3	132	41590	41753	2
			3	132	41754	41923	1
			3	132	41924	42130	2
			3	132	42131	42297	1
			3	132	42298	42506	2
			3	132	42507	42671	1
			3	132	42672	42882	2
			3	132	42883	43045	1
			3	132	43046	43258	2
			3	132	43259	43419	1
			3	132	43420	43589	2
			3	138	55240	55408	2
			3	138	55409	55569	1
			3	138	55570	55785	2
			3	138	55786	55943	1
			3	138	55944	56161	2
			3	138	56162	56317	1
			3	138	56318	56537	2
			3	138	56538	56691	1
			3	138	56692	56739	2
			3	156	66436	66578	1
			3	156	66579	66707	2
			3	156	66708	66873	3
			3	156	66874	67083	2
			3	156	67084	67252	3
			3	156	67253	67335	2
			3	161	68586	68786	3
			3	161	68787	68928	4
			3	161	68929	68935	1
			5	61	1	667	1
			5	61	670	799	2
			5	61	991	1424	4
			5	62	0	378	2
			5	62	380	774	4
			5	62	776	1132	2
			5	62	1134	1199	3
			5	71	0	540	3
			5	71	544	719	4
			5	71	720	919	3
		>;

		/*
		 * ************************************************************************************************************************
		 *  FD Settings
		 * ************************************************************************************************************************
		 */

		//samsung,fd_on_tx_cmds_revA = [
		//	29 01 00 00 00 00 03 F0 5A 5A
		//	29 01 00 00 00 00 03 B0 0B B5
		//	29 01 00 00 00 00 02 B5 40
		//	29 01 00 00 00 00 03 F0 A5 A5
		//];

		//samsung,fd_off_tx_cmds_revA = [
		//	29 01 00 00 00 00 03 F0 5A 5A
		//	29 01 00 00 00 00 03 B0 0B B5
		//	29 01 00 00 00 00 02 B5 80
		//	29 01 00 00 00 00 03 F0 A5 A5
		//];

		/*
		* ************************************************************************************************************************
		*  DMS (Dynamic Mode Switch)
		* ************************************************************************************************************************
		*/

		qcom,mdss-dsi-display-timings {
			wqxga {
				qcom,display-topology = <1 1 1>, <2 2 1>;
				qcom,default-topology-index = <1>;
				qcom,mdss-dsi-timing-default;
				qcom,mdss-dsi-panel-width = <2100>;
				qcom,mdss-dsi-panel-height = <1314>;

				qcom,mdss-dsi-h-pulse-width = <24>;
				qcom,mdss-dsi-h-back-porch = <16>;
				qcom,mdss-dsi-h-front-porch = <20>;
				qcom,mdss-dsi-h-sync-skew = <0>;

				qcom,mdss-dsi-v-pulse-width = <24>;
				qcom,mdss-dsi-v-back-porch = <16>;
				qcom,mdss-dsi-v-front-porch = <16>;

				qcom,mdss-dsi-panel-framerate = <60>;
				qcom,mdss-dsi-panel-clockrate = <1500000000>; /* 1176.5 Mbps*/
				qcom,mdss-dsi-panel-phy-timings = [00 30 0D 0D 2A 28 0C 0D 09 02 04 00 27 1C];	// 1500 Mbps
				qcom,mdss-dsi-t-clk-pre = <0x27>;
				qcom,mdss-dsi-t-clk-post = <0x1C>;

				/*qcom,mdss-dsi-timing-switch-command; use samsung,panel_multires_XXX instead*/
				/*qcom,mdss-dsi-timing-switch-command-state;*/

				/*only for factory binary*/
				//qcom,mdss-fd-on-command = [
				//	29 01 00 00 00 00 03 F1 5A 5A	/* TEST KEY Enable */
				//	29 01 00 00 00 00 02 D0 08
				//	29 01 00 00 00 00 03 F1 A5 A5
				//	29 01 00 00 00 00 03 F0 5A 5A
				//	29 01 00 00 00 00 02 B0 03
				//	29 01 00 00 00 00 02 CD 04
				//	29 01 00 00 00 00 03 F0 A5 A5	/* TEST KEY Disable */
				//];

				qcom,mdss-dsi-on-command = [
					/* G-Para */
					39 01 00 00 00 00 0B B0 00 00 00 00 02 00 00 00 00 54
					/* DSC Dummy */
					39 01 00 00 00 00 0D C6 00 00 00 00 04 00 00 00 20 C4 30 00

					/* G-Para */
					39 01 00 00 00 00 0B B0 00 00 00 00 02 00 00 00 00 CC
					/* CASET/PASET */
					39 01 00 00 00 00 11 CD 00 00 00 00 08 00 00 00 00 00 08 33 00 00 05 21


					/* G-Para */
					39 01 00 00 00 00 0B B0 00 00 00 00 02 00 00 00 00 C4
					/* cSRAM Setting */
					39 01 00 00 00 00 0D CD 00 00 00 00 04 00 00 00 B0 00 00 00

					/* G-Para */
					39 01 00 00 00 00 0B B0 00 00 00 00 02 00 00 00 00 F4
					/* Window Size setting */
					39 01 00 00 00 00 11 CD 00 00 00 00 08 00 00 00 B0 00 00 00 22 05 00 00

					/* DSC Compression Enable */
					07 01 00 00 00 00 01 01

					/* PPS Setting */
					39 01 00 00 00 00 61 9E 00 00 00 00 58 00 00 00
								11 01 00 89 30 80 05 22 08 34
								00 12 04 1A 04 1A 02 00 03 0D
								00 20 02 43 00 0E 00 0C 05 A6  
								02 E8 18 00 10 F0 03 0C 20 00
								06 0B 0B 33 0E 1C 2A 38 46 54
								62 69 70 77 79 7B 7D 7E 01 02
								01 00 09 40 09 BE 19 FC 19 FA
								19 F8 1A 38 1A 78 1A B6 2A F6 // b6
								2b 34 2b 74 3B 74 63 74    
								//2a f4 2a f4 4b 34 63 74

					39 01 00 00 00 00 0B B0 00 00 00 00 02 00 00 00 00 00
					39 01 00 00 00 00 0A BA 00 00 00 00 01 00 00 00 02
					
					/* Image Boundary */
					39 01 00 00 00 00 0B B0 00 00 00 00 02 00 00 00 03 3E
					39 01 00 00 00 00 0B D6 00 00 00 00 02 00 00 00 D8 0D

					/* Brightness */
					39 01 00 00 00 00 0A 53 00 00 00 00 01 00 00 00 20
					39 01 00 00 00 00 0B 51 00 00 00 00 02 00 00 00 FF 07

					/* Display On */
					05 01 00 00 14 00 01 29
				];

				qcom,mdss-dsi-off-command=[
					05 01 00 00 14 00 02 28 00
				];

				qcom,mdss-dsi-on-command-state = "dsi_hs_mode";
				qcom,mdss-dsi-off-command-state = "dsi_hs_mode";

			/*
				qcom,partial-update-enabled = "single_roi";
				qcom,panel-roi-alignment=<1400 12 1400 12 1400 12>;
			*/
				qcom,compression-mode = "dsc";
				qcom,lm-split = <1050 1050>;
				qcom,mdss-dsc-encoders = <2>;
				qcom,mdss-dsc-slice-height = <18>;
				qcom,mdss-dsc-slice-width = <1050>;
				qcom,mdss-dsc-slice-per-pkt = <1>;
				qcom,mdss-dsc-bit-per-component = <8>;
				qcom,mdss-dsc-bit-per-pixel = <8>;
				qcom,mdss-dsc-block-prediction-enable;
			};
		};
	};
};
