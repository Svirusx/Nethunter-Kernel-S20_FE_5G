/* Copyright (c) 2012, Samsung Electronics Corporation. All rights reserved.
 *
 * This program is free software; you can redistribute it and/or modify
 * it under the terms of the GNU General Public License version 2 and
 * only version 2 as published by the Free Software Foundation.
 *
 * This program is distributed in the hope that it will be useful,
 * but WITHOUT ANY WARRANTY; without even the implied warranty of
 * MERCHANTABILITY or FITNESS FOR A PARTICULAR PURPOSE.  See the
 * GNU General Public License for more details.
 */

&mdss_mdp {
	ss_dsi_panel_S6E3FA9_AMB667UM01_FHD: ss_dsi_panel_S6E3FA9_AMB667UM01_FHD {
		qcom,mdss-dsi-panel-name = "ss_dsi_panel_S6E3FA9_AMB667UM01_FHD";
		label = "ss_dsi_panel_S6E3FA9_AMB667UM01_FHD";

		qcom,mdss-dsi-bpp = <24>;

		/*qcom,cmd-sync-wait-broadcast;*/

		qcom,mdss-dsi-h-pulse-width = <80>;
		qcom,mdss-dsi-h-back-porch = <88>;
		qcom,mdss-dsi-h-front-porch = <84>;
		qcom,mdss-dsi-h-sync-skew = <0>;

		qcom,mdss-dsi-v-pulse-width = <2>;
		qcom,mdss-dsi-v-back-porch = <2>;
		qcom,mdss-dsi-v-front-porch = <16>;

		qcom,mdss-dsi-h-left-border = <0>;
		qcom,mdss-dsi-h-right-border = <0>;
		qcom,mdss-dsi-v-top-border = <0>;
		qcom,mdss-dsi-v-bottom-border = <0>;

		qcom,mdss-dsi-panel-framerate = <60>;
		qcom,mdss-dsi-panel-clockrate = <1160000000>;
		//qcom,mdss-dsi-panel-phy-timings = [00 25 0A 0A 27 24 0A 0A 07 02 04 00 1F 1A]; // 1176.5 Mbps
		qcom,mdss-dsi-panel-phy-timings = [00 26 0A 0A 1B 25 0A 0A 0A 02 04 00 20 0F]; // 1160 Mbps

		qcom,mdss-dsi-underflow-color = <0xFF>;
		qcom,mdss-dsi-border-color = <0>;

		qcom,mdss-dsi-bl-pmic-control-type = "bl_ctrl_dcs";

		qcom,mdss-dsi-bl-min-level = <1>;
		qcom,mdss-dsi-bl-max-level = <425>;
		qcom,mdss-brightness-max-level = <425>;
		qcom,mdss-brightness-default-level = <255>;
		qcom,mdss-dsi-interleave-mode = <0>;
		qcom,mdss-dsi-panel-type = "dsi_cmd_mode";

		qcom,mdss-dsi-te-check-enable;
		qcom,mdss-dsi-te-using-te-pin;
		qcom,mdss-dsi-te-pin-select = <1>;

		/*qcom,dynamic-mode-switch-enabled;*/
		/*qcom,dynamic-mode-switch-type = "dynamic-resolution-switch-immediate";*/

		qcom,mdss-dsi-te-dcs-command = <1>;
		qcom,mdss-dsi-wr-mem-start = <0x2C>;
		qcom,mdss-dsi-wr-mem-continue = <0x3C>;

		qcom,mdss-dsi-pixel-packing = "loose";

		qcom,mdss-dsi-virtual-channel-id = <0>;
		qcom,mdss-dsi-color-order = "rgb_swap_rgb";
		qcom,mdss-dsi-lane-0-state;
		qcom,mdss-dsi-lane-1-state;
		qcom,mdss-dsi-lane-2-state;
		qcom,mdss-dsi-lane-3-state;
		//qcom,mdss-dsi-lane-map = "lane_map_0123";

		qcom,mdss-dsi-t-clk-pre = <0x20>;
		qcom,mdss-dsi-t-clk-post = <0x0F>;

		qcom,mdss-dsi-stream = <0>;
		qcom,mdss-dsi-mdp-trigger = "none";
		qcom,mdss-dsi-dma-trigger = "trigger_sw";

		qcom,mdss-pan-physical-width-dimension = <70>;
		qcom,mdss-pan-physical-height-dimension = <155>;

		qcom,mdss-dsi-reset-sequence = <0 10>, <1 10>;

		/*qcom,mdss-dsi-lp11-init;*/
		/*qcom,mdss-dsi-init-delay-us = <1000>;*/

		qcom,mdss-dsi-rx-eot-ignore;
		qcom,mdss-dsi-tx-eot-append;

		/* HDR Setting */
		qcom,mdss-dsi-panel-hdr-enabled;
		qcom,mdss-dsi-panel-hdr-color-primaries = <15635 16450 34000 16000 13250 34500 7500 3000>;
		qcom,mdss-dsi-panel-peak-brightness = <5400000>;
		qcom,mdss-dsi-panel-average-brightness = <2000000>;
		qcom,mdss-dsi-panel-blackness-level = <2000>;

		qcom,ulps-enabled;
		/* qcom,suspend-ulps-enabled; */
		qcom,esd-check-enabled;
		qcom,mdss-dsi-panel-status-check-mode ="irq_check";
		/*qcom,mdss-dsi-panel-status-read-length;*/
		/*qcom,mdss-dsi-panel-status-value;*/
		/*qcom,mdss-dsi-panel-status-irq-trigger1 = "rising";*/
		qcom,mdss-dsi-panel-status-irq-trigger1 = "falling"; /* DISP_DET */

		/* *************************************************************
		 * Below  parameters are samsung dependent thigs
		 * *************************************************************
		 */
		samsung,panel-vendor = "SDC";
		samsung,disp-model = "AMB667UM01";
		samsung,panel-lpm-enable;
		samsung,support_gamma_mode2;
		//samsung,support_irc;
		//samsung,elvss_interpolation_temperature = <(-15)>;
		samsung,support_factory_panel_swap;
		//samsung,support_gct;
		//samsung,support_pac;
		//samsung,support_gpara;
		samsung,support_dynamic_mipi_clk;
		samsung,pll_ssc_disabled;

		/* *************************************************************
		 *  POC CONTROL
		 * *************************************************************
		 */
		samsung,support_poc_driver;
		samsung,poc_start_addr = <0>;
		samsung,poc_image_size = <390528>;		/* 390,528 bytes */
		samsung,poc_mca_check_rx_cmds_revA = [06 01 00 00 00 00 01 91 5E 00]; /* MCA Check */

		samsung,poc_write_loop_cnt = <256>;
		samsung,poc_write_data_size = <256>;

		/*
		 * Flash SPI cmds
		 *
		 * TX ) [tx_bpw tx_size(1) tx_size(2) tx_buf(1) ... tx_buf(tx_size)]
		 *      Max tx data of page proglem is 256bytes. (0x0100).
		 *		1byte is for instruction, 3bytes are for address.
		 *		Total 260bytes are needed for page program cmds.
		 *
		 * RX ) [tx_bpw tx_size(1) tx_size(2) tx_buf(1) ... tx_buf(tx_size) rx_bpw rx_size(1) rx_size(2)]
		 *		Entire memory can be accessed with a single instruction as long as the clock continues.
		 *      We restrict rx size as 4096bytes (0x1000).
		 */

		/* MX (Macronix) flash chip */
		samsung,support_ddi_spi;

		/* WRITE */
		samsung,flash_spi_wr_enable = [08 00 01 06];
		samsung,flash_spi_wr_page_program = [08 01 04 02 00 00 00
			 01 02 03 00 00 00 00 00 00 00 00 00 00 00 00 00 00 00 00 00 00 00 00 00 00 00 00 00 00 00 00 00
			 04 05 06 00 00 00 00 00 00 00 00 00 00 00 00 00 00 00 00 00 00 00 00 00 00 00 00 00 00 00 00 00
			 00 00 00 00 00 00 00 00 00 00 00 00 00 00 00 00 00 00 00 00 00 00 00 00 00 00 00 00 00 00 00 00
			 00 00 00 00 00 00 00 00 00 00 00 00 00 00 00 00 00 00 00 00 00 00 00 00 00 00 00 00 00 00 00 00
			 00 00 00 00 00 00 00 00 00 00 00 00 00 00 00 00 00 00 00 00 00 00 00 00 00 00 00 00 00 00 00 00
			 00 00 00 00 00 00 00 00 00 00 00 00 00 00 00 00 00 00 00 00 00 00 00 00 00 00 00 00 00 00 00 00
			 00 00 00 00 00 00 00 00 00 00 00 00 00 00 00 00 00 00 00 00 00 00 00 00 00 00 00 00 00 00 00 00
			 00 00 00 00 00 00 00 00 00 00 00 00 00 00 00 00 00 00 00 00 00 00 00 00 00 00 00 00 00 00 1e 5f
		];

		samsung,flash_spi_wr_status_reg1 = [08 00 02 01 00];
		/* 0xFC : Block Protection / QE(quad spi mode) disable */
		samsung,flash_spi_wr_status_reg1_end = [08 00 02 01 FC];

		/* ERASE */
		samsung,flash_spi_er = [08 00 04 00 00 00 00];

		/* READ */
		samsung,flash_spi_rd_data = [08 00 04 03 00 00 00 08 10 00];
		samsung,flash_spi_rd_status_reg1 = [08 00 01 05 08 00 01];
		samsung,flash_spi_rd_manufacture_id = [08 00 01 9F 08 00 01];

		/* *************************************************************
		 *  Tx
		 * *************************************************************
		 */
		samsung,level0_key_enable_tx_cmds_revA	= [29 01 00 00 00 00 03 9F A5 A5]; /* PASSWD0 */
		samsung,level0_key_disable_tx_cmds_revA	= [29 01 00 00 00 00 03 9F 5A 5A]; /* PASSWD0 */
		samsung,level1_key_enable_tx_cmds_revA	= [29 01 00 00 00 00 03 F0 5A 5A]; /* PASSWD1 */
		samsung,level1_key_disable_tx_cmds_revA	= [29 01 00 00 00 00 03 F0 A5 A5]; /* PASSWD1 */
		samsung,level2_key_enable_tx_cmds_revA	= [29 01 00 00 00 00 03 FC 5A 5A];
		samsung,level2_key_disable_tx_cmds_revA	= [29 01 00 00 00 00 03 FC A5 A5];

		/* BRIGHTNESS_MAX_PACKET = 50 */
		samsung,brightness_tx_cmds_revA = [
			39 01 00 00 00 00 01 00
			39 01 00 00 00 00 01 00
			39 01 00 00 00 00 01 00
			39 01 00 00 00 00 01 00
			39 01 00 00 00 00 01 00
			39 01 00 00 00 00 01 00
			39 01 00 00 00 00 01 00
			39 01 00 00 00 00 01 00
			39 01 00 00 00 00 01 00
			39 01 00 00 00 00 01 00
			39 01 00 00 00 00 01 00
			39 01 00 00 00 00 01 00
			39 01 00 00 00 00 01 00
			39 01 00 00 00 00 01 00
			39 01 00 00 00 00 01 00
			39 01 00 00 00 00 01 00
			39 01 00 00 00 00 01 00
			39 01 00 00 00 00 01 00
			39 01 00 00 00 00 01 00
			39 01 00 00 00 00 01 00
			39 01 00 00 00 00 01 00
			39 01 00 00 00 00 01 00
			39 01 00 00 00 00 01 00
			39 01 00 00 00 00 01 00
			39 01 00 00 00 00 01 00
			39 01 00 00 00 00 01 00
			39 01 00 00 00 00 01 00
			39 01 00 00 00 00 01 00
			39 01 00 00 00 00 01 00
			39 01 00 00 00 00 01 00
			39 01 00 00 00 00 01 00
			39 01 00 00 00 00 01 00
			39 01 00 00 00 00 01 00
			39 01 00 00 00 00 01 00
			39 01 00 00 00 00 01 00
			39 01 00 00 00 00 01 00
			39 01 00 00 00 00 01 00
			39 01 00 00 00 00 01 00
			39 01 00 00 00 00 01 00
			39 01 00 00 00 00 01 00
			39 01 00 00 00 00 01 00
			39 01 00 00 00 00 01 00
			39 01 00 00 00 00 01 00
			39 01 00 00 00 00 01 00
			39 01 00 00 00 00 01 00
			39 01 00 00 00 00 01 00
			39 01 00 00 00 00 01 00
			39 01 00 00 00 00 01 00
			39 01 00 00 00 00 01 00
			39 01 00 00 00 00 01 00
		];

		//samsung,mdnie_tx_cmds_revA = [
		//	39 01 00 00 00 00 00 00 00
		//];

		samsung,packet_size_tx_cmds_revA = [
			37 01 00 00 00 00 02 07 00
		];

		/* use poinging gpara (long write) */
		samsung,reg_read_pos_tx_cmds_revA = [
			29 00 00 00 00 00 03 B0 00 00
		];

		samsung,display_on_tx_cmds_revA = [
			29 00 00 00 00 00 03 9F A5 A5
			05 01 00 00 00 00 02 29 00	/* display on */
			29 00 00 00 14 00 03 9F 5A 5A	/* delay 20ms */

			29 00 00 00 00 00 03 F0 5A 5A
			29 00 00 00 00 00 03 B0 04 B6
			29 00 00 00 00 00 02 B6 08	/* smooth dimming 8 steps setting */
			29 00 00 00 00 00 03 F0 A5 A5
		];

		samsung,display_off_tx_cmds_revA = [05 01 00 00 00 00 02 28 00];

		/* *************************************************************
		 *  Rx (Module Information READ)
		 * *************************************************************
		 */
		samsung,mdnie_read_rx_cmds_revA		= [06 01 00 00 00 00 01 A1 04 00]; /* White color position */
		samsung,manufacture_date_rx_cmds_revA	= [06 01 00 00 00 00 01 A1 04 04]; /* manufacture data 4 byte*/
		samsung,octa_id_rx_cmds_revA		= [06 01 00 00 00 00 01 A1 14 0B]; /* OCTA ID : read A1 12~31th bytes */
		samsung,cell_id_rx_cmds_revA		= [06 01 00 00 00 00 01 A1 07 04]; /* CELL ID : read A1 5~11th bytes*/

		samsung,ddi_id_rx_cmds_revA		= [06 01 00 00 00 00 01 d6 05 00]; /* CHIP ID : read D6 1~5th */

		samsung,manufacture_id0_rx_cmds_revA	= [06 01 00 00 00 00 01 da 01 00];
		samsung,manufacture_id1_rx_cmds_revA	= [06 01 00 00 00 00 01 db 01 00];
		samsung,manufacture_id2_rx_cmds_revA	= [06 01 00 00 00 00 01 dc 01 00];

		//samsung,smart_dimming_mtp_rx_cmds_revA	= [06 01 00 00 00 00 01 c8 20 00];

		samsung,ldi_debug0_rx_cmds_revA		= [06 01 00 00 00 00 01 0A 01 00]; /* rddpm */
		//samsung,ldi_debug1_rx_cmds_revA		= [06 01 00 00 00 00 01 0E 01 00]; /* no operation */
		samsung,ldi_debug2_rx_cmds_revA		= [06 01 00 00 00 00 01 EE 01 00]; /* errfg */
		samsung,ldi_debug3_rx_cmds_revA		= [06 01 00 00 00 00 01 0E 01 00]; /* rddsm*/
		samsung,ldi_debug4_rx_cmds_revA		= [06 01 00 00 00 00 01 05 01 00]; /* dsierr */
		//samsung,ldi_debug5_rx_cmds_revA		= [06 01 00 00 00 00 01 0F 01 00]; /* self_diag*/

		/* 255 bytes, its ddi max size is 512, and sw limit is ff = 255... */
		//samsung,ldi_debug_logbuf_rx_cmds_revA	= [06 01 00 00 00 00 01 9C FF 00];

		samsung,mtp_read_sysfs_rx_cmds_revA	= [06 01 00 00 00 00 01 00 00 00];

		samsung,mtp_write_sysfs_tx_cmds_revA	= [
			29 00 00 00 00 00 3D 00
						00 00 00 00 00 00 00 00 00 00
						00 00 00 00 00 00 00 00 00 00
						00 00 00 00 00 00 00 00 00 00
						00 00 00 00 00 00 00 00 00 00
						00 00 00 00 00 00 00 00 00 00
						00 00 00 00 00 00 00 00 00 00
		];

		/* *************************************************************
		 *  COPR
		 * *************************************************************
		 */
		samsung,copr_enable_tx_cmds_revA = [
			29 01 00 00 00 00 03 F0 5A 5A
			29 01 00 00 00 00 1D E1 09 15 15 00 00 00 00 00 00 00 03 03 02 87 00 6A 02 AB 00 8C 00 00 00 00 04 37 09 23
			29 01 00 00 00 00 03 F0 A5 A5
		];

		samsung,copr_disable_tx_cmds_revA = [
			29 01 00 00 00 00 03 F0 5A 5A
			29 01 00 00 00 00 02 E1 00
			29 01 00 00 00 00 03 F0 A5 A5
		];

		/* *************************************************************
		 *  Finger Print Green Circle
		 * *************************************************************
		 */
		samsung,fp_green_circle_on_tx_cmds_revA = [
			29 01 00 00 00 00 03 F0 5A 5A
			29 01 00 00 00 00 02 7A 21
			29 01 00 00 00 00 03 F0 A5 A5
		];

		samsung,fp_green_circle_off_tx_cmds_revA = [
			29 01 00 00 00 00 03 F0 5A 5A
			29 01 00 00 00 00 02 7A 23
			29 01 00 00 00 00 03 F0 A5 A5
		];

		/* *************************************************************
		 *  SELF DISPLAY
		 * *************************************************************
		 */
		samsung,support_self_display;
		ss,self_display = <&self_display_FA9_dtsi>;

		/* *************************************************************
		 * VINT
		 * *************************************************************
		 */
		samsung,vint_tx_cmds_revA = [
			29 01 00 00 00 00 02 F4 CC
		];

		/* DIA */
		samsung,dia_on_tx_cmds_revA = [
			29 00 00 00 00 00 03 F0 5A 5A
			29 00 00 00 00 00 02 C6 02	/* DIA off=01, DIA on=02*/
			29 01 00 00 00 00 02 F7 03	/* gamma update */
			29 00 00 00 00 00 03 F0 A5 A5
		];

		samsung,dia_off_tx_cmds_revA = [
			29 00 00 00 00 00 03 F0 5A 5A
			29 00 00 00 00 00 02 C6 01	/* DIA off=01, DIA on=02*/
			29 01 00 00 00 00 02 F7 03	/* gamma update */
			29 00 00 00 00 00 03 F0 A5 A5
		];

		/* *************************************************************
		 * TEST MODE
		 * **************************************************************
		 */
		/* MCD TEST */
		samsung,mcd_on_tx_cmds_revA = [
			29 01 00 00 00 00 03 F0 5A 5A
			29 01 00 00 00 00 02 F4 CE
			29 01 00 00 00 00 2B CB
				00 00 42 0F 00 02 00 00
				00 00 00 00 00 00 00 00
				00 00 50 00 00 40 47 00
				4D 00 00 00 20 07 28 38
				51 00 00 00 00 00 F0 F0
				0B 46

			29 01 00 00 00 00 02 F7 03		/* gamma update */

			29 01 00 00 00 00 03 B0 05 F6
			29 01 00 00 00 00 02 F6 00
			29 01 00 00 00 00 03 B0 04 CC
			29 01 00 00 00 00 02 CC 12	/* MCD on */
			29 01 00 00 64 00 02 F7 03	/* gamma update, delay 100ms */
			29 01 00 00 00 00 03 F0 A5 A5
		];

		samsung,mcd_off_tx_cmds_revA = [
			29 01 00 00 00 00 03 F0 5A 5A
			29 01 00 00 00 00 02 F4 CC
			29 01 00 00 00 00 2B CB
				00 00 42 0B 00 06 00 00
				00 00 00 00 00 00 00 00
				00 00 50 00 00 40 47 00
				4D 00 00 00 20 07 28 38
				51 00 00 00 00 00 F0 F0
				00 00
			29 01 00 00 00 00 03 B0 05 F6
			29 01 00 00 00 00 02 F6 90
			29 01 00 00 00 00 03 B0 04 CC
			29 01 00 00 00 00 02 CC 00
			29 01 00 00 64 00 02 F7 03			/* 100 ms Delay */
			29 01 00 00 00 00 03 F0 A5 A5
		];


		/* GRAY SPOT TEST */
		samsung,gray_spot_test_on_tx_cmds_revA = [
			29 01 00 00 00 00 03 F0 5A 5A
			29 01 00 00 00 00 03 B0 05 F6
			29 01 00 00 00 00 02 F6 00
			29 01 00 00 00 00 03 B0 07 F2
			29 01 00 00 00 00 06 F2 02 00 58 38 D0
			29 01 00 00 00 00 03 B0 11 F4
			29 01 00 00 00 00 02 F4 1E
			29 01 00 00 00 00 05 B5 19 8D 35 00
			29 01 00 00 64 00 02 F7 03
			29 01 00 00 00 00 03 F0 A5 A5
		];

		samsung,gray_spot_test_off_tx_cmds_revA = [
			29 01 00 00 00 00 03 F0 5A 5A
			29 01 00 00 00 00 03 B0 05 F6
			29 01 00 00 00 00 02 F6 90
			29 01 00 00 00 00 03 B0 07 F2
			29 01 00 00 00 00 06 F2 02 0E 58 38 50
			29 01 00 00 00 00 03 B0 11 F4
			29 01 00 00 00 00 02 F4 1E
			29 01 00 00 00 00 05 B5 19 8D 35 00
			29 01 00 00 64 00 02 F7 03
			29 01 00 00 00 00 03 F0 A5 A5
		];

		samsung,gray_spot_rx_cmds_revA	= [06 01 00 00 00 00 01 B5 02 02];

		/* MICRO CRACK Test */
		samsung,micro_short_test_on_tx_cmds_revA = [
			29 00 00 00 00 00 03 F0 5A 5A
			29 01 00 00 00 00 03 B0 03 F6
			29 01 00 00 00 00 04 F6 3B 00 78
			29 00 00 00 00 00 03 BF 33 25
			29 01 00 00 00 00 03 F0 A5 A5
		];

		samsung,micro_short_test_off_tx_cmds_revA = [
			29 00 00 00 00 00 03 F0 5A 5A
			29 01 00 00 00 00 03 B0 03 F6
			29 01 00 00 00 00 04 F6 00 00 90
			29 00 00 00 00 00 03 BF 00 07
			29 01 00 00 00 00 03 F0 A5 A5
		];

		/* CCD TEST */
		samsung,ccd_test_on_tx_cmds_revA = [
			29 00 00 00 00 00 03 F0 5A 5A
			29 01 00 00 00 00 03 B0 02 CC
			29 01 00 00 01 00 02 CC 01	/* wait 1 ms */
			29 01 00 00 00 00 03 F0 A5 A5
		];

		samsung,ccd_pass_val = <0x00>;
		samsung,ccd_fail_val = <0x04>;

		samsung,ccd_state_rx_cmds_revA= [06 01 00 00 00 00 01 CD 01 0E];

		samsung,ccd_test_off_tx_cmds_revA = [
			29 00 00 00 00 00 03 F0 5A 5A
			29 01 00 00 00 00 03 B0 02 CC
			29 01 00 00 00 00 02 CC 00
			29 01 00 00 00 00 03 F0 A5 A5
		];

		/* *************************************************************
		 * ACL command list and mappings
		 * **************************************************************
		 */
		samsung,acl_on_tx_cmds_revA = [
			/* 32 frame AVG ACL ON, Start 50%, ACL 15%, 32Frame AVG */
			29 01 00 00 00 00 02 55 02	/* ACL ON */
		];

		samsung,acl_off_tx_cmds_revA = [
			/* 16 Frame AVG ACL OFF, Start Point 60%, ACL 0%*/
			29 01 00 00 00 00 02 55 00	/* ACL OFF */
		];

		samsung,elvss_rx_cmds_revA = [ 06 01 00 00 00 00 01 B7 02 08];	/* read B7 9th, 10th para */

		/* *************************************************************
		 * Dynamic MIPI Clock
		 * **************************************************************
		 */
		samsung,ffc_cmds_line_position = <2>;
		samsung,ffc_tx_cmds_revA = [
			29 00 00 00 00 00 03 F0 5A 5A
			29 00 00 00 00 00 03 FC 5A 5A
			29 00 00 00 00 00 0A C5 0D 10 64 1F 1F 05 00 26 B0	/* Default : 1160 Mbps (580) */
			29 01 00 00 00 00 03 F0 A5 A5
			29 01 00 00 00 00 03 FC A5 A5
		];

		samsung,dyn_mipi_clk_ffc_cmds_revA = [
			29 00 00 00 00 00 0A C5 0D 10 64 1F 1F 05 00 26 B0	/* 0 : 1160   Mbps (580   ) */
			29 00 00 00 00 00 0A C5 0D 10 64 1E 3C 05 00 26 B0	/* 1 : 1194   Mbps (597   ) */
			29 00 00 00 00 00 0A C5 0D 10 64 1F 61 05 00 26 B0	/* 2 : 1150.5 Mbps (575.25) */
			29 00 00 00 00 00 0A C5 0D 10 64 1F 34 05 00 26 B0	/* 3 : 1157   Mbps (578.5 ) */
			29 00 00 00 00 00 0A C5 0D 10 64 1F 1F 05 00 26 B0	/* 4 : 1160   Mbps (580   ) */
		];

		samsung,dynamic_mipi_clk_timing_table = <
			/*<bitclk><>*/
			1160000000 /* clk id 0 default */
			1194000000 /* clk id 1 A */
			1150500000 /* clk id 2 B */
			1157000000 /* clk id 3 C */
			1160000000 /* clk id 4 D */
		>;

		samsung,dynamic_mipi_clk_sel_table = <
			/*<RAT><BAND><from><end><clk index>*/
			1	1	0	0	2
			1	2	0	0	3
			1	3	0	0	2
			1	4	0	0	2
			2	11	10562	10658	1
			2	11	10659	10733	2
			2	11	10734	10838	1
			2	12	9662	9738	2
			2	12	9739	9912	1
			2	12	9913	9938	2
			2	13	1162	1291	1
			2	13	1292	1366	2
			2	13	1367	1513	1
			2	14	1537	1633	1
			2	14	1634	1708	2
			2	14	1709	1738	1
			2	15	4357	4439	1
			2	15	4440	4458	2
			2	17	2237	2271	1
			2	17	2272	2345	3
			2	17	2346	2519	1
			2	17	2520	2563	3
			2	18	2937	2988	1
			2	18	2989	3056	2
			2	18	3057	3063	3
			2	18	3064	3088	1
			3	91	0	217	1
			3	91	218	367	2
			3	91	368	599	1
			3	92	600	627	1
			3	92	628	777	2
			3	92	778	1124	1
			3	92	1125	1199	2
			3	93	1200	1482	1
			3	93	1483	1632	2
			3	93	1633	1949	1
			3	94	1950	2167	1
			3	94	2168	2317	2
			3	94	2318	2399	1
			3	95	2400	2589	1
			3	95	2590	2649	2
			3	97	2750	2842	1
			3	97	2843	2990	3
			3	97	2991	3339	1
			3	97	3340	3449	3
			3	98	3450	3577	1
			3	98	3578	3712	2
			3	98	3713	3727	3
			3	98	3728	3799	1
			3	102	5010	5107	1
			3	102	5108	5179	2
			3	103	5180	5257	2
			3	103	5258	5279	1
			3	104	5280	5379	1
			3	107	5730	5777	1
			3	107	5778	5849	2
			3	108	5850	5999	1
			3	109	6000	6129	1
			3	109	6130	6149	2
			3	110	6150	6274	2
			3	110	6275	6449	1
			3	111	6450	6490	2
			3	111	6491	6599	1
			3	115	8040	8067	1
			3	115	8068	8217	2
			3	115	8218	8564	1
			3	115	8565	8689	2
			3	116	8690	8979	1
			3	116	8980	9039	2
			3	118	9210	9514	1
			3	118	9515	9659	2
			3	119	9660	9769	1
			3	120	9770	9869	1
			3	122	9920	10249	1
			3	122	10250	10269	3
			3	122	10270	10322	4
			3	122	10323	10359	2
			3	124	36200	36349	1
			3	128	37750	37844	1
			3	128	37845	37861	2
			3	128	37862	37994	3
			3	128	37995	38249	1
			3	129	38250	38279	1
			3	129	38280	38429	2
			3	129	38430	38649	1
			3	130	38650	38957	1
			3	130	38958	39064	2
			3	130	39065	39107	3
			3	130	39108	39454	1
			3	130	39455	39543	2
			3	130	39544	39604	3
			3	130	39605	39649	1
			3	131	39650	39987	1
			3	131	39988	40021	2
			3	131	40022	40137	3
			3	131	40138	40484	1
			3	131	40485	40501	2
			3	131	40502	40634	3
			3	131	40635	40982	1
			3	131	40983	41130	3
			3	131	41131	41479	1
			3	131	41480	41589	3
			3	132	41590	41842	1
			3	132	41843	41992	2
			3	132	41993	42340	1
			3	132	42341	42490	2
			3	132	42491	42837	1
			3	132	42838	42987	2
			3	132	42988	43335	1
			3	132	43336	43468	2
			3	132	43469	43485	3
			3	132	43486	43589	1
			3	138	55240	55485	1
			3	138	55486	55618	2
			3	138	55619	55635	3
			3	138	55636	55982	1
			3	138	55983	56097	2
			3	138	56098	56132	3
			3	138	56133	56480	1
			3	138	56481	56576	2
			3	138	56577	56630	3
			3	138	56631	56739	1
			3	156	66436	66653	1
			3	156	66654	66803	2
			3	156	66804	67150	1
			3	156	67151	67300	2
			3	156	67301	67335	1
			3	161	68586	68808	1
			3	161	68809	68935	2
			4	51	0	0	1
			4	52	0	0	1
			4	53	0	0	1
			4	54	0	0	1
			4	55	0	0	3
			4	56	0	0	1
			5	61	0	0	1
			5	62	0	0	3
			5	71	0	0	1
		>;

		/* *************************************************************
		 * candela to index mappings
		 * **************************************************************
		 */
		samsung,candela_map_table_revA = < /* THIS TABLE USED FOR DIMMING */
		/* <idx> <from> <till> <gm2_wrdisbv> <cd> */
			0	0	0	3	2
			1	1	1	3	2
			2	2	2	6	3
			3	3	3	6	3
			4	4	4	9	4
			5	5	5	9	4
			6	6	6	12	6
			7	7	7	12	6
			8	8	8	15	7
			9	9	9	15	7
			10	10	10	18	8
			11	11	11	21	9
			12	12	12	24	11
			13	13	13	24	11
			14	14	14	27	12
			15	15	15	30	13
			16	16	16	32	14
			17	17	17	34	15
			18	18	18	37	16
			19	19	19	39	17
			20	20	20	42	18
			21	21	21	44	19
			22	22	22	47	20
			23	23	23	50	21
			24	24	24	52	22
			25	25	25	55	23
			26	26	26	58	24
			27	27	27	60	25
			28	28	28	63	26
			29	29	29	66	27
			30	30	30	69	28
			31	31	31	72	29
			32	32	32	75	31
			33	33	33	77	32
			34	34	34	80	33
			35	35	35	83	34
			36	36	36	86	35
			37	37	37	89	37
			38	38	38	92	38
			39	39	39	96	39
			40	40	40	99	40
			41	41	41	102	42
			42	42	42	105	43
			43	43	43	108	44
			44	44	44	111	45
			45	45	45	114	47
			46	46	46	118	48
			47	47	47	121	49
			48	48	48	124	51
			49	49	49	127	52
			50	50	50	131	53
			51	51	51	134	55
			52	52	52	137	56
			53	53	53	141	57
			54	54	54	144	59
			55	55	55	148	60
			56	56	56	151	61
			57	57	57	155	63
			58	58	58	158	64
			59	59	59	161	65
			60	60	60	165	67
			61	61	61	169	68
			62	62	62	172	70
			63	63	63	176	71
			64	64	64	179	73
			65	65	65	183	74
			66	66	66	186	75
			67	67	67	190	77
			68	68	68	194	78
			69	69	69	197	80
			70	70	70	201	81
			71	71	71	205	83
			72	72	72	208	84
			73	73	73	212	86
			74	74	74	216	87
			75	75	75	220	89
			76	76	76	223	90
			77	77	77	227	92
			78	78	78	231	93
			79	79	79	235	95
			80	80	80	238	96
			81	81	81	242	98
			82	82	82	246	99
			83	83	83	250	101
			84	84	84	254	102
			85	85	85	258	104
			86	86	86	262	106
			87	87	87	266	107
			88	88	88	270	109
			89	89	89	273	110
			90	90	90	277	112
			91	91	91	281	113
			92	92	92	285	115
			93	93	93	289	117
			94	94	94	293	118
			95	95	95	297	120
			96	96	96	301	122
			97	97	97	305	123
			98	98	98	310	125
			99	99	99	314	126
			100	100	100	318	128
			101	101	101	322	130
			102	102	102	326	131
			103	103	103	330	133
			104	104	104	334	135
			105	105	105	338	136
			106	106	106	342	138
			107	107	107	347	140
			108	108	108	351	141
			109	109	109	355	143
			110	110	110	359	145
			111	111	111	363	146
			112	112	112	368	148
			113	113	113	372	150
			114	114	114	376	151
			115	115	115	380	153
			116	116	116	385	155
			117	117	117	389	157
			118	118	118	393	158
			119	119	119	398	160
			120	120	120	402	162
			121	121	121	406	163
			122	122	122	411	165
			123	123	123	415	167
			124	124	124	419	169
			125	125	125	424	170
			126	126	126	428	172
			127	127	127	432	174
			128	128	128	437	176
			129	129	129	441	177
			130	130	130	446	179
			131	131	131	450	181
			132	132	132	454	183
			133	133	133	459	185
			134	134	134	463	186
			135	135	135	468	188
			136	136	136	472	190
			137	137	137	477	192
			138	138	138	481	194
			139	139	139	486	195
			140	140	140	490	197
			141	141	141	495	199
			142	142	142	498	201
			143	143	143	502	203
			144	144	144	506	204
			145	145	145	511	206
			146	146	146	515	208
			147	147	147	520	210
			148	148	148	524	212
			149	149	149	528	214
			150	150	150	533	215
			151	151	151	537	217
			152	152	152	542	219
			153	153	153	546	221
			154	154	154	551	223
			155	155	155	555	225
			156	156	156	560	227
			157	157	157	564	229
			158	158	158	569	230
			159	159	159	573	232
			160	160	160	578	234
			161	161	161	582	236
			162	162	162	587	238
			163	163	163	591	240
			164	164	164	596	242
			165	165	165	600	244
			166	166	166	605	246
			167	167	167	609	247
			168	168	168	614	249
			169	169	169	619	251
			170	170	170	623	253
			171	171	171	628	255
			172	172	172	632	257
			173	173	173	637	259
			174	174	174	642	261
			175	175	175	646	263
			176	176	176	651	265
			177	177	177	656	267
			178	178	178	660	269
			179	179	179	665	271
			180	180	180	670	273
			181	181	181	674	275
			182	182	182	679	276
			183	183	183	684	278
			184	184	184	688	280
			185	185	185	693	282
			186	186	186	698	284
			187	187	187	703	286
			188	188	188	707	288
			189	189	189	712	290
			190	190	190	717	292
			191	191	191	722	294
			192	192	192	726	296
			193	193	193	731	298
			194	194	194	736	300
			195	195	195	741	302
			196	196	196	746	304
			197	197	197	750	306
			198	198	198	755	308
			199	199	199	760	310
			200	200	200	765	312
			201	201	201	770	314
			202	202	202	775	316
			203	203	203	779	318
			204	204	204	784	320
			205	205	205	789	322
			206	206	206	794	324
			207	207	207	799	326
			208	208	208	804	329
			209	209	209	809	331
			210	210	210	814	333
			211	211	211	818	335
			212	212	212	823	337
			213	213	213	828	339
			214	214	214	833	341
			215	215	215	838	343
			216	216	216	843	345
			217	217	217	846	346
			218	218	218	851	348
			219	219	219	855	350
			220	220	220	859	352
			221	221	221	864	354
			222	222	222	868	355
			223	223	223	872	357
			224	224	224	877	359
			225	225	225	882	361
			226	226	226	886	363
			227	227	227	891	365
			228	228	228	897	367
			229	229	229	902	370
			230	230	230	908	372
			231	231	231	913	374
			232	232	232	918	376
			233	233	233	922	378
			234	234	234	927	380
			235	235	235	931	382
			236	236	236	936	384
			237	237	237	940	385
			238	238	238	944	387
			239	239	239	949	389
			240	240	240	953	391
			241	241	241	958	393
			242	242	242	963	395
			243	243	243	968	397
			244	244	244	973	399
			245	245	245	977	401
			246	246	246	982	403
			247	247	247	988	405
			248	248	248	993	408
			249	249	249	998	410
			250	250	250	1004	412
			251	251	251	1008	414
			252	252	252	1011	415
			253	253	253	1015	417
			254	254	254	1019	418
			255	255	255	1023	420
		>;
		samsung,hbm_candela_map_table_revA = <
		/* <idx> <from> <till> <gm2_wrdisbv> <cd> <auto> */
			0		256		256		3            421		0
			1		257		257		5            423		0
			2		258		258		7            424		0
			3		259		259		9            425		0
			4		260		260		12           428		0
			5		261		261		14           429		0
			6		262		262		17           431		0
			7		263		263		19           432		0
			8		264		264		21           434		0
			9		265		265		24           436		0
			10		266		266		26           437		0
			11		267		267		29           439		0
			12		268		268		31           441		0
			13		269		269		33           442		0
			14		270		270		36           444		0
			15		271		271		38           446		0
			16		272		272		40           447		0
			17		273		273		43           449		0
			18		274		274		45           450		0
			19		275		275		48           453		0
			20		276		276		50           454		0
			21		277		277		52           455		0
			22		278		278		55           457		0
			23		279		279		57           459		0
			24		280		280		59           460		0
			25		281		281		62           462		0
			26		282		282		64           464		0
			27		283		283		67           466		0
			28		284		284		69           467		0
			29		285		285		71           469		0
			30		286		286		74           471		0
			31		287		287		76           472		0
			32		288		288		78           473		0
			33		289		289		81           476		0
			34		290		290		83           477		0
			35		291		291		86           479		0
			36		292		292		88           480		0
			37		293		293		90           482		0
			38		294		294		93           484		0
			39		295		295		95           485		0
			40		296		296		97           487		0
			41		297		297		100          489		0
			42		298		298		102          490		0
			43		299		299		105          492		0
			44		300		300		107          494		0
			45		301		301		109          495		0
			46		302		302		112          497		0
			47		303		303		114          498		0
			48		304		304		116          500		0
			49		305		305		119          502		0
			50		306		306		121          503		0
			51		307		307		124          505		0
			52		308		308		126          507		0
			53		309		309		128          508		0
			54		310		310		131          510		0
			55		311		311		133          512		0
			56		312		312		135          513		0
			57		313		313		138          515		0
			58		314		314		140          517		0
			59		315		315		143          519		0
			60		316		316		145          520		0
			61		317		317		147          521		0
			62		318		318		150          523		0
			63		319		319		152          525		0
			64		320		320		154          526		0
			65		321		321		157          528		0
			66		322		322		159          530		0
			67		323		323		162          532		0
			68		324		324		164          533		0
			69		325		325		166          535		0
			70		326		326		169          537		0
			71		327		327		171          538		0
			72		328		328		173          539		0
			73		329		329		176          542		0
			74		330		330		178          543		0
			75		331		331		181          545		0
			76		332		332		183          546		0
			77		333		333		185          548		0
			78		334		334		188          550		0
			79		335		335		190          551		0
			80		336		336		192          553		0
			81		337		337		195          555		0
			82		338		338		197          556		0
			83		339		339		200          558		0
			84		340		340		202          560		0
			85		341		341		204          561		0
			86		342		342		207          563		0
			87		343		343		209          564		0
			88		344		344		211          566		0
			89		345		345		214          568		0
			90		346		346		216          569		0
			91		347		347		219          571		0
			92		348		348		221          573		0
			93		349		349		223          574		0
			94		350		350		226          576		0
			95		351		351		228          578		0
			96		352		352		231          580		0
			97		353		353		233          581		0
			98		354		354		235          583		0
			99		355		355		238          585		0
			100		356		356		240          586		0
			101		357		357		242          587		0
			102		358		358		245          589		0
			103		359		359		247          591		0
			104		360		360		250          593		0
			105		361		361		252          594		0
			106		362		362		254          596		0
			107		363		363		257          598		0
			108		364		364		259          599		0
			109		365		365		261          601		0
			110		366		366		264          603		0
			111		367		367		266          604		0
			112		368		368		269          606		0
			113		369		369		271          608		0
			114		370		370		273          609		0
			115		371		371		276          611		0
			116		372		372		278          612		0
			117		373		373		280          614		0
			118		374		374		283          616		0
			119		375		375		285          617		0
			120		376		376		288          619		0
			121		377		377		290          621		0
			122		378		378		292          622		0
			123		379		379		295          624		0
			124		380		380		297          626		0
			125		381		381		299          627		0
			126		382		382		302          629		0
			127		383		383		304          630		0
			128		384		384		307          633		0
			129		385		385		309          634		0
			130		386		386		311          635		0
			131		387		387		314          637		0
			132		388		388		316          639		0
			133		389		389		318          640		0
			134		390		390		321          642		0
			135		391		391		323          644		0
			136		392		392		326          646		0
			137		393		393		328          647		0
			138		394		394		330          649		0
			139		395		395		333          651		0
			140		396		396		335          652		0
			141		397		397		337          653		0
			142		398		398		340          656		0
			143		399		399		342          657		0
			144		400		400		345          659		0
			145		401		401		347          660		0
			146		402		402		349          662		0
			147		403		403		352          664		0
			148		404		404		354          665		0
			149		405		405		356          667		0
			150		406		406		359          669		0
			151		407		407		361          670		0
			152		408		408		364          672		0
			153		409		409		366          674		0
			154		410		410		368          675		0
			155		411		411		371          677		0
			156		412		412		373          678		0
			157		413		413		375          680		0
			158		414		414		378          682		0
			159		415		415		380          683		0
			160		416		416		383          685		0
			161		417		417		385          687		0
			162		418		418		387          688		0
			163		419		419		390          690		0
			164		420		420		392          692		0
			165		421		421		394          693		0
			166		422		422		397          695		0
			167		423		423		399          697		0
			168		424		424		402          699		0
			169		425		425		404          700		0
		>;

		samsung,aod_candela_map_table_revA = <
		/* <idx> <from> <till> <gm2_wrdisbv> <cd> */
			0	0	12	0	2
			1	13	31	0	10
			2	32	54	0	30
			3	55	255	0	60
		>;

		samsung,gamma_mode2_normal_tx_cmds_revA=[
			29 00 00 00 00 00 02 53 28	/* dimming speed: normal=20, smooth=28 */
			39 00 00 00 00 00 04 B5 19 8D 10
			39 01 00 00 00 00 03 51 03 FF
		]; /* B5 1th para: TSET */

		samsung,gamma_mode2_hbm_tx_cmds_revA=[
			29 00 00 00 00 00 02 53 E0	/* dimming speed: normal=E0 */
			39 00 00 00 00 00 04 B5 19 8D 10
			39 01 00 00 00 00 03 51 03 FF
		]; /* B5 1th para: TSET */

		/* *************************************************************
		 *  HMT
		 * **************************************************************
		 */
		samsung,hmt_enabled;
		samsung,hmt_candela_map_table_revA = <
		/*   <idx>   <from>  <till>  <gm2_wrdisbv> <cd> */
			0	0	0 	268	26 
			1	1 	1 	271	26 
			2	2 	2 	274	27 
			3	3 	3 	277	27 
			4	4 	4 	280	27 
			5	5 	5 	283	28 
			6	6 	6 	286	28 
			7	7 	7 	289	28 
			8	8 	8 	292	29 
			9	9 	9 	295	29 
			10	10 	10 	298	29 
			11	11 	11 	301	30 
			12	12 	12 	304	30 
			13	13 	13 	306	30 
			14	14 	14 	309	31 
			15	15 	15 	312	31 
			16	16 	16 	315	31 
			17	17 	17 	318	32 
			18	18 	18 	321	32 
			19	19 	19 	324	32 
			20	20 	20 	327	33 
			21	21 	21 	330	33 
			22	22 	22 	333	33 
			23	23 	23 	336	34 
			24	24 	24 	339	34 
			25	25 	25 	342	34 
			26	26 	26 	345	35 
			27	27 	27 	348	35 
			28	28 	28 	351	35 
			29	29 	29 	354	36 
			30	30 	30 	357	36 
			31	31 	31 	360	36 
			32	32 	32 	363	37 
			33	33 	33 	366	37 
			34	34 	34 	369	37 
			35	35 	35 	372	38 
			36	36 	36 	375	38 
			37	37 	37 	378	38 
			38	38 	38 	380	38 
			39	39 	39 	383	39 
			40	40 	40 	386	39 
			41	41 	41 	389	39 
			42	42 	42 	392	40 
			43	43 	43 	395	40 
			44	44 	44 	398	40 
			45	45 	45 	401	41 
			46	46 	46 	404	41 
			47	47 	47 	407	41 
			48	48 	48 	410	42 
			49	49 	49 	413	42 
			50	50 	50 	416	42 
			51	51 	51 	419	43 
			52	52 	52 	422	43 
			53	53 	53 	425	43 
			54	54 	54 	428	44 
			55	55 	55 	431	44 
			56	56 	56 	434	44 
			57	57 	57 	437	45 
			58	58 	58 	440	45 
			59	59 	59 	443	45 
			60	60 	60 	446	46 
			61	61 	61 	449	46 
			62	62 	62 	452	46 
			63	63 	63 	455	47 
			64	64 	64 	457	47 
			65	65 	65 	460	47 
			66	66 	66 	463	48 
			67	67 	67 	466	48 
			68	68 	68 	469	48 
			69	69 	69 	472	49 
			70	70 	70 	475	49 
			71	71 	71 	478	49 
			72	72 	72 	481	50 
			73	73 	73 	484	50 
			74	74 	74 	487	50 
			75	75 	75 	490	51 
			76	76 	76 	493	51 
			77	77 	77 	496	51 
			78	78 	78 	499	52 
			79	79 	79 	502	52 
			80	80 	80 	505	52 
			81	81 	81 	508	53 
			82	82 	82 	511	53 
			83	83 	83 	514	53 
			84	84 	84 	517	54 
			85	85 	85 	520	54 
			86	86 	86 	523	54 
			87	87 	87 	526	55 
			88	88 	88 	529	55 
			89	89 	89 	531	55 
			90	90 	90 	534	56 
			91	91 	91 	537	56 
			92	92 	92 	540	56 
			93	93 	93 	543	57 
			94	94 	94 	546	57 
			95	95 	95 	549	57 
			96	96 	96 	552	58 
			97	97 	97 	555	58 
			98	98 	98 	558	58 
			99	99 	99 	561	59 
			100	100 	100 	564	59 
			101	101 	101 	567	59 
			102	102 	102 	570	60 
			103	103 	103 	573	60 
			104	104 	104 	576	60 
			105	105 	105 	579	61 
			106	106 	106 	582	61 
			107	107 	107 	585	61 
			108	108 	108 	588	62 
			109	109 	109 	591	62 
			110	110 	110 	594	62 
			111	111 	111 	597	63 
			112	112 	112 	600	63 
			113	113 	113 	603	63 
			114	114 	114 	606	64 
			115	115 	115 	608	64 
			116	116 	116 	611	64 
			117	117 	117 	614	64 
			118	118 	118 	617	65 
			119	119 	119 	620	65 
			120	120 	120 	623	65 
			121	121 	121 	626	66 
			122	122 	122 	629	66 
			123	123 	123 	632	66 
			124	124 	124 	635	67 
			125	125 	125 	638	67 
			126	126 	126 	641	67 
			127	127 	127 	644	68 
			128	128 	128 	647	68 
			129	129 	129 	650	69 
			130	130 	130 	653	69 
			131	131 	131 	656	69 
			132	132 	132 	659	70 
			133	133 	133 	662	70 
			134	134 	134 	665	70 
			135	135 	135 	668	71 
			136	136 	136 	671	71 
			137	137 	137 	674	71 
			138	138 	138 	677	72 
			139	139 	139 	680	72 
			140	140 	140 	682	72 
			141	141 	141 	685	72 
			142	142 	142 	688	73 
			143	143 	143 	691	73 
			144	144 	144 	694	73 
			145	145 	145 	697	74 
			146	146 	146 	700	74 
			147	147 	147 	703	74 
			148	148 	148 	706	75 
			149	149 	149 	709	75 
			150	150 	150 	712	75 
			151	151 	151 	715	76 
			152	152 	152 	718	76 
			153	153 	153 	721	76 
			154	154 	154 	724	77 
			155	155 	155 	727	77 
			156	156 	156 	730	77 
			157	157 	157 	733	78 
			158	158 	158 	736	78 
			159	159 	159 	739	78 
			160	160 	160 	742	79 
			161	161 	161 	745	79 
			162	162 	162 	748	79 
			163	163 	163 	751	80 
			164	164 	164 	754	80 
			165	165 	165 	757	80 
			166	166 	166 	759	81 
			167	167 	167 	762	81 
			168	168 	168 	765	81 
			169	169 	169 	768	82 
			170	170 	170 	771	82 
			171	171 	171 	774	82 
			172	172 	172 	777	83 
			173	173 	173 	780	83 
			174	174 	174 	783	83 
			175	175 	175 	786	84 
			176	176 	176 	789	84 
			177	177 	177 	792	84 
			178	178 	178 	795	85 
			179	179 	179 	798	85 
			180	180 	180 	801	85 
			181	181 	181 	804	86 
			182	182 	182 	807	86 
			183	183 	183 	810	86 
			184	184 	184 	813	87 
			185	185 	185 	816	87 
			186	186 	186 	819	87 
			187	187 	187 	822	88 
			188	188 	188 	825	88 
			189	189 	189 	828	88 
			190	190 	190 	831	89 
			191	191 	191 	833	89 
			192	192 	192 	836	89 
			193	193 	193 	839	90 
			194	194 	194 	842	90 
			195	195 	195 	845	90 
			196	196 	196 	848	91 
			197	197 	197 	851	91 
			198	198 	198 	854	91 
			199	199 	199 	857	92 
			200	200 	200 	860	92 
			201	201 	201 	863	92 
			202	202 	202 	866	93 
			203	203 	203 	869	93 
			204	204 	204 	872	93 
			205	205 	205 	875	94 
			206	206 	206 	878	94 
			207	207 	207 	881	94 
			208	208 	208 	884	95 
			209	209 	209 	887	95 
			210	210 	210 	890	95 
			211	211 	211 	893	96 
			212	212 	212 	896	96 
			213	213 	213 	899	96 
			214	214 	214 	902	97 
			215	215 	215 	905	97 
			216	216 	216 	908	97 
			217	217 	217 	910	97 
			218	218 	218 	913	98 
			219	219 	219 	916	98 
			220	220 	220 	919	98 
			221	221 	221 	922	99 
			222	222 	222 	925	99 
			223	223 	223 	928	99 
			224	224 	224 	931	100 
			225	225 	225 	934	100 
			226	226 	226 	937	100 
			227	227 	227 	940	101 
			228	228 	228 	943	101 
			229	229 	229 	946	101 
			230	230 	230 	949	102 
			231	231 	231 	952	102 
			232	232 	232 	955	102 
			233	233 	233 	958	103 
			234	234 	234 	961	103 
			235	235 	235 	964	103 
			236	236 	236 	967	104 
			237	237 	237 	970	104 
			238	238 	238 	973	104 
			239	239 	239 	976	105 
			240	240 	240 	979	105 
			241	241 	241 	982	105 
			242	242 	242 	984	106 
			243	243 	243 	987	106 
			244	244 	244 	990	106 
			245	245 	245 	993	107 
			246	246 	246 	996	107 
			247	247 	247 	999	107 
			248	248 	248 	1002	108 
			249	249 	249 	1005	108 
			250	250 	250 	1008	108 
			251	251 	251 	1011	109 
			252	252 	252 	1014	109 
			253	253 	253 	1017	109 
			254	254 	254 	1020	110 
			255	255 	255 	1023	110 
		>;

		samsung,hmt_enable_tx_cmds_revA = [
			29 00 00 00 00 00 03 F0 5A 5A				/* Test Key Enable */
			29 00 00 00 00 00 03 B0 E0 B7				/* Global Para */
			29 00 00 00 00 00 05 B7 A7 9A 09 00			/* AOR 80% */
			29 00 00 00 00 00 07 CB 00 00 42 03 00 0E	/* LTPS Setting */
			29 00 00 00 00 00 02 F7 03					/* LTPS Update */

			/* WRDISBV 51h: 03 FF = max , 01 0C = min, will be update in hmt brighntess */

			29 01 00 00 00 00 03 F0 A5 A5				/* Test Key Disable */
		];

		samsung,hmt_disable_tx_cmds_revA = [
			29 00 00 00 00 00 03 F0 5A 5A				/* Test Key Enable */
			29 00 00 00 00 00 03 B0 E0 B7				/* Global Para */
			29 00 00 00 00 00 05 B7 A1 84 00 60		/* AOR 0% */
			29 00 00 00 00 00 07 CB 00 00 42 0B 00 06	/* LTPS Setting */
			29 00 00 00 00 00 02 F7 03					/* LTPS Update */
			29 01 00 00 00 00 03 F0 A5 A5				/* Test Key Disable */
		];

		samsung,gamma_mode2_hmt_tx_cmds_revA=[
			29 01 00 00 00 00 03 51 03 FF
		];

		/*
		 * ************************************************************************************************************************
		 *  FD Settings
		 * ************************************************************************************************************************
		 */

		samsung,fd_on_tx_cmds_revA = [
			29 01 00 00 00 00 03 F0 5A 5A
			29 01 00 00 00 00 03 B0 0B B5
			29 01 00 00 00 00 02 B5 40
			29 01 00 00 00 00 03 F0 A5 A5
		];

		samsung,fd_off_tx_cmds_revA = [
			29 01 00 00 00 00 03 F0 5A 5A
			29 01 00 00 00 00 03 B0 0B B5
			29 01 00 00 00 00 02 B5 80
			29 01 00 00 00 00 03 F0 A5 A5
		];

		/* *************************************************************
		 *   APLPM
		 * *************************************************************
		 */

		samsung,lpm_on_tx_cmds_revA = [ // TX_LPM_ON
			/* Image write for HLPM/ALPM Mode */
			29 00 00 00 00 00 03 F0 5A 5A	/* TEST KEY Enable */
			29 00 00 00 00 00 03 B0 02 BB	/* Global Para */
			29 00 00 00 00 00 03 BB 09 18	/* HLPM AOR SETTING */
			29 00 00 00 01 00 02 53 22	/* HLPM On Setting */
			29 01 00 00 11 00 03 F0 A5 A5	/* TEST KEY Disable, delay 17ms */
		];

		samsung,lpm_off_tx_cmds_revA = [
			/* Image write for Normal Mode */
			29 00 00 00 00 00 03 F0 5A 5A	/* TEST KEY Enable */

			29 00 00 00 00 00 03 B0 0A B5
			29 00 00 00 00 00 06 B5 00 00 00 00 00	/* ASWIRE off Setting */

			29 00 00 00 01 00 02 53 20	/* ALPM/HLPM off, delay 1ms  */
			29 01 00 00 00 00 03 F0 A5 A5	/* TEST KEY Disable */
		];

		/* ALPM/HLPM 2nit or 60nit On Commands */
		samsung,lpm_2nit_tx_cmds_revA  = [29 01 00 00 00 00 02 53 23];
		samsung,lpm_10nit_tx_cmds_revA = [29 01 00 00 00 00 02 53 22];
		samsung,lpm_30nit_tx_cmds_revA = [29 01 00 00 00 00 02 53 22];
		samsung,lpm_60nit_tx_cmds_revA = [29 01 00 00 00 00 02 53 22];

		/* HLPM / ALPM Control Commands */
		samsung,lpm_ctrl_hlpm_2nit_tx_cmds_revA  = [29 01 00 00 00 00 03 BB 89 0C];
		samsung,lpm_ctrl_hlpm_10nit_tx_cmds_revA = [29 01 00 00 00 00 03 BB 89 07];
		samsung,lpm_ctrl_hlpm_30nit_tx_cmds_revA = [29 01 00 00 00 00 03 BB 59 0C];
		samsung,lpm_ctrl_hlpm_60nit_tx_cmds_revA = [29 01 00 00 00 00 03 BB 09 18];

		/* HLPM / ALPM brightness Commands: default alpm 2nit */
		samsung,lpm_brightnes_tx_cmds_revA = [
			29 00 00 00 00 00 03 F0 5A 5A	/* TEST KEY Enable */
			29 00 00 00 01 00 02 53 22	/* HLPM On Setting */
			29 00 00 00 00 00 03 B0 02 BB	/* Global Para */
			29 00 00 00 00 00 03 BB 09 18	/* HLPM AOR SETTING */
			29 01 00 00 00 00 03 F0 A5 A5	/* TEST KEY Disable */
		];

		/* AOR Control(97.3%) Commands */
		//samsung,lpm_ctrl_hlpm_off_tx_cmds_revA		= [29 01 00 00 00 00 02 53 20];
		samsung,lpm-init-delay-ms = <124>;

		/*
		* ************************************************************************************************************************
		* Self mask check debug (SELF MASK CHECK)
		*************************************************************************************************************************
		*/
		samsung,mask_crc_pass_data = [0F 09];

		/*
		* ************************************************************************************************************************
		*  DMS (Dynamic Mode Switch)
		* ************************************************************************************************************************
		*/

		qcom,mdss-dsi-display-timings {
			fhd {
				qcom,display-topology = <1 0 1>;
				qcom,default-topology-index = <0>;
				qcom,mdss-dsi-timing-default;
				qcom,mdss-dsi-panel-width = <1080>;
				qcom,mdss-dsi-panel-height = <2400>;

				qcom,mdss-dsi-h-pulse-width = <80>;
				qcom,mdss-dsi-h-back-porch = <88>;
				qcom,mdss-dsi-h-front-porch = <84>;
				qcom,mdss-dsi-h-sync-skew = <0>;

				qcom,mdss-dsi-v-pulse-width = <2>;
				qcom,mdss-dsi-v-back-porch = <2>;
				qcom,mdss-dsi-v-front-porch = <15>;

				qcom,mdss-dsi-panel-framerate = <60>;
				qcom,mdss-mdp-transfer-time-us = <15866>;

				qcom,mdss-dsi-panel-clockrate = <1160000000>; /* 1160 Mbps*/
				qcom,mdss-dsi-panel-phy-timings = [00 26 0A 0A 1B 25 0A 0A 0A 02 04 00 20 0F];	/* 1160 Mbps */

				/*qcom,mdss-dsi-timing-switch-command; use samsung,panel_multires_XXX instead*/
				/*qcom,mdss-dsi-timing-switch-command-state;*/

				qcom,mdss-dsi-t-clk-pre = <0x20>;
				qcom,mdss-dsi-t-clk-post = <0x0F>;

				/*only for factory binary*/
				qcom,mdss-fd-on-command = [
					29 01 00 00 00 00 03 F1 5A 5A	/* TEST KEY Enable */
					29 01 00 00 00 00 02 D0 08
					29 01 00 00 00 00 03 F1 A5 A5
					29 01 00 00 00 00 03 F0 5A 5A
					29 01 00 00 00 00 02 B0 03
					29 01 00 00 00 00 02 CD 04
					29 01 00 00 00 00 03 F0 A5 A5	/* TEST KEY Disable */
				];

				qcom,mdss-dsi-on-command = [
					05 00 00 00 78 00 02 11 00	/* Sleep out, delay 120ms */

					/* TE Vsync On */
					29 00 00 00 00 00 03 F0 5A 5A
					29 00 00 00 00 00 02 35 00
					29 00 00 00 00 00 03 F0 A5 A5

					/* PAGE Address Setting */
					29 00 00 00 00 00 05 2A 00 00 04 37
					29 00 00 00 00 00 05 2B 00 00 09 5F

					/* FFC SET */
					29 00 00 00 00 00 03 F0 5A 5A
					29 00 00 00 00 00 03 FC 5A 5A
					29 00 00 00 00 00 0A C5 0D 10 64 1F 1F 05 00 26 B0	/* Default : 1160 Mbps (580) */
					29 00 00 00 00 00 03 F0 A5 A5
					29 00 00 00 00 00 03 FC A5 A5

					/* ERR_FG Setting */
					29 00 00 00 00 00 03 F0 5A 5A
					29 00 00 00 00 00 03 FC 5A 5A
					29 00 00 00 00 00 02 E5 13
					29 00 00 00 00 00 03 ED 00 4C
					29 00 00 00 00 00 03 F0 A5 A5
					29 00 00 00 00 00 03 FC A5 A5

					/* Smooth dimming Setting */
					29 00 00 00 00 00 03 F0 5A 5A
					29 00 00 00 00 00 03 B0 04 B6
					29 00 00 00 00 00 02 B6 01	/* smooth dimming 1 step setting */
					29 00 00 00 00 00 03 F0 A5 A5

					/* Gamma Setting */
					29 00 00 00 00 00 03 F0 5A 5A
					29 00 00 00 00 00 03 B0 38 B7
					29 00 00 00 00 00 05 B7 00 8D BB 9B
					29 00 00 00 00 00 03 B0 0C B7
					29 00 00 00 00 00 05 B7 00 9A CC AC
					29 00 00 00 00 00 03 B0 DF B6
					29 00 00 00 00 00 05 B6 00 BB E6 C4
					29 00 00 00 00 00 03 B0 B3 B6
					29 00 00 00 00 00 05 B6 04 EA 0A EA
					29 00 00 00 00 00 03 B0 87 B6
					29 00 00 00 00 00 05 B6 04 EA 0A EA
					29 00 00 00 00 00 03 B0 5B B6
					29 00 00 00 00 00 05 B6 04 EA 0A EA
					29 00 00 00 00 00 02 F7 0F	/* Panel Update */
					29 00 00 00 00 00 03 F0 A5 A5

					/* Brightness */
					29 00 00 00 00 00 03 F0 5A 5A
					29 00 00 00 00 00 02 53 28	/* dimming speed: normal=20, smooth=28 */
					29 00 00 00 00 00 03 51 03 FF	/* 420 Nit */
					29 00 00 00 00 00 03 F0 A5 A5

					/* ACL Setting Value */
					29 00 00 00 00 00 03 F0 5A 5A
					29 00 00 00 00 00 05 B4 00 55 40 FF	/* 32 frame, acl start 50% */
					29 00 00 00 00 00 03 B0 51 B8
					29 00 00 00 00 00 03 B8 02 00		/* ACL dimming 32 frame */
					29 01 00 00 00 00 02 55 02		/* ACL 15% ON */
					29 00 00 00 00 00 03 F0 A5 A5

					/* TSP HSYNC Setting  */
					29 00 00 00 00 00 03 F0 5A 5A
					29 00 00 00 00 00 0A B9 00 80 E8 09 00 00 00 11 03
					29 00 00 00 00 00 03 F0 A5 A5

					/* DIA */
					29 00 00 00 00 00 03 F0 5A 5A
					29 00 00 00 00 00 02 C6 02	/* DIA off=01, DIA on=02 (default) */
					29 00 00 00 00 00 02 F7 03	/* gamma update */
					29 00 00 00 00 00 03 F0 A5 A5

					/* Memory Access */
					05 00 00 00 00 00 02 2C 00
					05 00 00 00 00 00 02 3C 00
				];

				qcom,mdss-dsi-off-command=[
					29 00 00 00 00 00 03 9F A5 A5	/* TEST KEY1 Enable */
					05 01 00 00 14 00 02 28 00	/* display off, dealy 20ms */
					05 01 00 00 00 00 02 10 00	/* sleep in */
					29 00 00 00 78 00 03 9F 5A 5A	/* TEST KEY1 Disable 120ms delay */
				];

				qcom,mdss-dsi-on-command-state = "dsi_lp_mode";
				qcom,mdss-dsi-off-command-state = "dsi_hs_mode";

			};
		};
	};
};
