## arch/arm64/Kconfig.bloom
```kconfig
#
# Samsung Bloom Projects
#
config MACH_BLOOMXQ_EUR_OPEN
	default n
	bool "Samsung BLOOMXQ EUR OPEN"
	help
	  Support for Samsung BLOOMXQ EUR OPEN device.

config MACH_BLOOMXQ_USA_SINGLE
	default n
	bool "Samsung BLOOMXQ USA SQ"
	help
	  Support for Samsung BLOOMXQ USA SQ device.

config MACH_BLOOMXQ_KOR_SINGLE
	default n
	bool "Samsung BLOOMXQ KOR SQ"
	help
	  Support for Samsung BLOOMXQ KOR SQ device.

config MACH_BLOOMXQ_CHN_OPEN
	default n
	bool "Samsung BLOOMXQ CHN OPEN"
	help
	  Support for Samsung BLOOMXQ CHN OPEN device.

config MACH_BLOOMXQ_CHN_HKX
	select MACH_BLOOMXQ_CHN_OPEN
	default n
	bool "Samsung BLOOMXQ CHN HKX"
	help
	  Support for Samsung BLOOMXQ CHN HKX device.

config MACH_BLOOMXQ_CAN_SINGLE
	select MACH_BLOOMXQ_USA_SINGLE
	default n
	bool "Samsung BLOOMXQ CAN SQ"
	help
	  Support for Samsung BLOOMXQ CAN SQ device.

config MACH_BLOOMXQ_JPN_SINGLE
	default n
	bool "Samsung BLOOMXQ JPN SQ"
	help
	  Support for Samsung BLOOMXQ JPN SQ device.
```

## arch/arm64/Kconfig.canvas
```kconfig
#
# Samsung Canvas Projects
#
config MACH_C1Q_USA_SINGLE
	default n
	bool "Samsung C1Q USA SQ"
	help
	  Support for Samsung C1Q USA SQ device.

config MACH_C1Q_CAN_SINGLE
	select MACH_C1Q_USA_SINGLE
	default n
	bool "Samsung C1Q CAN SQ"
	help
	  Support for Samsung C1Q CAN SQ device.

config MACH_C1Q_KOR_SINGLE
	default n
	bool "Samsung C1Q KOR SQ"
	help
	  Support for Samsung C1Q KOR SQ device.

config MACH_C1Q_CHN_OPEN
	default n
	bool "Samsung C1Q CHN OPEN"
	help
	  Support for Samsung C1Q CHN OPEN device.

config MACH_C1Q_CHN_HK
	select MACH_C1Q_CHN_OPEN
	default n
	bool "Samsung C1Q CHN HK"
	help
	  Support for Samsung C1Q CHN HK device.

config MACH_C2Q_USA_SINGLE
	default n
	bool "Samsung C2Q USA SQ"
	help
	  Support for Samsung C2Q USA SQ device.

config MACH_C2Q_KOR_SINGLE
	default n
	bool "Samsung C2Q KOR SQ"
	help
	  Support for Samsung C2Q KOR SQ device.

config MACH_C2Q_CAN_SINGLE
        select MACH_C2Q_USA_SINGLE
	default n
	bool "Samsung C2Q CAN SQ"
	help
	  Support for Samsung C2Q CAN SQ device.

config MACH_C2Q_JPN_SINGLE
	default n
	bool "Samsung C2Q JPN SQ"
	help
	  Support for Samsung C2Q JPN SQ device.

config MACH_C2Q_CHN_OPEN
	default n
	bool "Samsung C2Q CHN OPEN"
	help
	  Support for Samsung C2Q CHN OPEN device.

config MACH_C2Q_CHN_HK
	select MACH_C2Q_CHN_OPEN
	default n
	bool "Samsung C2Q CHN HK"
	help
	  Support for Samsung C2Q CHN HK device.
```

## arch/arm64/Kconfig.f2
```kconfig
#
# Samsung F2 Projects
#
config MACH_F2Q_EUR_OPEN
	default n
	bool "Samsung F2Q EUR OPEN"
	help
	  Support for Samsung F2Q EUR OPEN device.

config MACH_F2Q_USA_SINGLE
	default n
	bool "Samsung F2Q USA SINGLE"
	help
	  Support for Samsung F2Q USA SINGLE device.

config MACH_F2Q_KOR_SINGLE
	default n
	bool "Samsung F2Q KOR SINGLE"
	help
	  Support for Samsung F2Q KOR SINGLE device.

config MACH_F2Q_USA_OPEN
	select MACH_F2Q_USA_SINGLE
	default n
	bool "Samsung F2Q USA OPEN"
	help
	  Support for Samsung F2Q USA OPEN device.

config MACH_F2Q_CAN_SINGLE
	select MACH_F2Q_USA_SINGLE
	default n
	bool "Samsung F2Q CAN SINGLE"
	help
	  Support for Samsung F2Q CAN SINGLE device.

config MACH_F2Q_CHN_OPEN
	select MACH_F2Q_USA_SINGLE
	default n
	bool "Samsung F2Q CHN OPEN"
	help
	  Support for Samsung F2Q CHN OPEN device.

config MACH_F2Q_CHN_HKX
	select MACH_F2Q_CHN_OPEN
	default n
	bool "Samsung F2Q CHN HKX"
	help
	  Support for Samsung F2Q CHN HKX device.

config MACH_F2Q_JPN_SINGLE
	default n
	bool "Samsung F2Q JPN SINGLE"
	help
	  Support for Samsung F2Q JPN SINGLE device.
```

## arch/arm64/Kconfig.projects
```kconfig
config SEC_R8Q_PROJECT
	default n
	bool "Samsung R8Q Project"
	help
	  Support for Samsung R8Q Project

config MACH_R8Q_EUR_OPEN
	default n
	bool "Samsung R8Q EUR OPEN"
	help
	  Support for Samsung R8Q EUR OPEN device.
```

## arch/arm64/Kconfig.r8
```kconfig
#
# Samsung R8 Projects
#
config MACH_R8Q_USA_SINGLE
	depends on SEC_R8Q_PROJECT
	default n
	bool "Samsung R8Q USA SQ"
	help
	  Support for Samsung R8Q USA SQ device.

config MACH_R8Q_CAN_SINGLE
	depends on SEC_R8Q_PROJECT
	select MACH_R8Q_USA_SINGLE
	default n
	bool "Samsung R8Q CAN SINGLE"
	help
	  Support for Samsung R8Q CAN SINGLE device.

config MACH_R8Q_EUR_OPEN
	depends on SEC_R8Q_PROJECT
	default n
	bool "Samsung R8Q EUR OPEN"
	help
	  Support for Samsung R8Q EUR OPEN device.

config MACH_R8Q_KOR_SINGLE
	depends on SEC_R8Q_PROJECT
	default n
	bool "Samsung R8Q KOR SINGLE"
	help
	  Support for Samsung R8Q KOR SINGLE device.

config MACH_R8Q_CHN_OPEN
	depends on SEC_R8Q_PROJECT
	default n
	bool "Samsung R8Q CHN OPEN"
	help
	  Support for Samsung R8Q CHN OPEN device.

config MACH_R8Q_CHN_HKX
	depends on SEC_R8Q_PROJECT
	select MACH_R8Q_CHN_OPEN
	default n
	bool "Samsung R8Q CHN HKX"
	help
	  Support for Samsung R8Q CHN HKX device.
```

## arch/arm64/Kconfig.tabs7l
```kconfig
#
# Samsung Tabs7l Projects
#
config MACH_GTS7L_EUR_OPEN
	default n
	bool "Samsung GTS7L EUR OPEN"
	help
	  Support for Samsung GTS7L EUR OPEN device.

config MACH_GTS7LWIFI_EUR_OPEN
	default n
	bool "Samsung GTS7LWIFI EUR OPEN"
	help
	  Support for Samsung GTS7LWIFI EUR OPEN device.

config MACH_GTS7L_KOR_OPEN
	default n
	bool "Samsung GTS7L KOR OPEN"
	help
	  Support for Samsung GTS7L KOR OPEN device.

config MACH_GTS7L_USA_SINGLE
	default n
	bool "Samsung GTS7L USA SINGLE"
	help
	  Support for Samsung GTS7L USA SINGLE device.
```

## arch/arm64/Kconfig.tabs7xl
```kconfig
#
# Samsung Tabs7xl Projects
#
config MACH_GTS7XL_EUR_OPEN
	default n
	bool "Samsung GTS7XL EUR OPEN"
	help
	  Support for Samsung GTS7XL EUR OPEN device.

config MACH_GTS7XLWIFI_EUR_OPEN
	default n
	bool "Samsung GTS7XLWIFI EUR OPEN"
	help
	  Support for Samsung GTS7XLWIFI EUR OPEN device.

config MACH_GTS7XL_KOR_OPEN
	default n
	bool "Samsung GTS7XL KOR OPEN"
	help
	  Support for Samsung GTS7XL KOR OPEN device.

config MACH_GTS7XL_USA_SINGLE
	default n
	bool "Samsung GTS7XL USA SINGLE"
	help
	  Support for Samsung GTS7XL USA SINGLE device.
```

## arch/arm64/Kconfig.victory
```kconfig
#
# Samsung Victory Projects
#
config MACH_VICTORY_CHN_OPEN
	default n
	bool "Samsung VICTORY CHN SQ"
	help
	  Support for Samsung VICTORY CHN SQ device.
```

## arch/arm64/Kconfig.xyz
```kconfig
#
# Samsung X/Y/Z Projects
#
config MACH_X1Q_KOR_SINGLE
	depends on SEC_X1Q_PROJECT
	default n
	bool "Samsung X1Q KOR SQ"
	help
	  Support for Samsung X1Q KOR SQ device.

config MACH_Y2Q_KOR_SINGLE
	depends on SEC_Y2Q_PROJECT
	default n
	bool "Samsung Y2Q KOR SQ"
	help
	  Support for Samsung Y2Q KOR SQ device.

config MACH_Z3Q_KOR_SINGLE
	depends on SEC_Z3Q_PROJECT
	default n
	bool "Samsung Z3Q KOR SQ"
	help
	  Support for Samsung Z3Q KOR SQ device.


config MACH_X1Q_USA_SINGLE
	depends on SEC_X1Q_PROJECT
	default n
	bool "Samsung X1Q USA SQ"
	help
	  Support for Samsung X1Q USA SQ device.

config MACH_Y2Q_USA_SINGLE
	depends on SEC_Y2Q_PROJECT
	default n
	bool "Samsung Y2Q USA SQ"
	help
	  Support for Samsung Y2Q USA SQ device.

config MACH_Z3Q_USA_SINGLE
	depends on SEC_Z3Q_PROJECT
	default n
	bool "Samsung Z3Q USA SQ"
	help
	  Support for Samsung Z3Q USA SQ device.

config MACH_X1Q_CAN_SINGLE
	depends on SEC_X1Q_PROJECT
	select MACH_X1Q_USA_SINGLE
	default n
	bool "Samsung X1Q CAN SQ"
	help
	  Support for Samsung X1Q CAN SQ device.

config MACH_Y2Q_CAN_SINGLE
	depends on SEC_Y2Q_PROJECT
	select MACH_Y2Q_USA_SINGLE
	default n
	bool "Samsung Y2Q CAN SQ"
	help
	  Support for Samsung Y2Q CAN SQ device.

config MACH_Z3Q_CAN_SINGLE
	depends on SEC_Z3Q_PROJECT
	select MACH_Z3Q_USA_SINGLE
	default n
	bool "Samsung Z3Q CAN SQ"
	help
	  Support for Samsung Z3Q CAN SQ device.

config MACH_X1Q_CHN_OPEN
	depends on SEC_X1Q_PROJECT
	default n
	bool "Samsung X1Q CHN OPEN"
	help
	  Support for Samsung X1Q CHN OPEN device.

config MACH_Y2Q_CHN_OPEN
	depends on SEC_Y2Q_PROJECT
	default n
	bool "Samsung Y2Q CHN OPEN"
	help
	  Support for Samsung Y2Q CHN OPEN device.

config MACH_Z3Q_CHN_OPEN
	depends on SEC_Z3Q_PROJECT
	default n
	bool "Samsung Z3Q CHN OPEN"
	help
	  Support for Samsung Z3Q CHN OPEN device.

config MACH_X1Q_CHN_HKX
	select MACH_X1Q_CHN_OPEN
	default n
	bool "Samsung X1Q CHN HKX"
	help
	  Support for Samsung X1Q CHN HKX device.

config MACH_Y2Q_CHN_HKX
	select MACH_Y2Q_CHN_OPEN
	default n
	bool "Samsung Y2Q CHN HKX"
	help
	  Support for Samsung Y2Q CHN HKX device.

config MACH_Z3Q_CHN_HKX
	select MACH_Z3Q_CHN_OPEN
	default n
	bool "Samsung Z3Q CHN HKX"
	help
	  Support for Samsung Z3Q CHN HKX device.

config MACH_X1Q_JPN_SINGLE
	depends on SEC_X1Q_PROJECT
	default n
	bool "Samsung X1Q JPN SINGLE"
	help
	  Support for Samsung X1Q JPN SINGLE device.

config MACH_Y2Q_JPN_SINGLE
	depends on SEC_Y2Q_PROJECT
	default n
	bool "Samsung Y2Q JPN SINGLE"
	help
	  Support for Samsung Y2Q JPN SINGLE device.

config MACH_Y2Q_JPN_DCMOLY
	depends on SEC_Y2Q_PROJECT
	default n
	bool "Samsung Y2Q JPN OLY DCMOLY"
	help
	  Support for Samsung Y2Q JPN DCMOLY device.

config MACH_Z3Q_JPN_SINGLE
	depends on SEC_Z3Q_PROJECT
	default n
	bool "Samsung Z3Q JPN SINGLE"
	help
	  Support for Samsung Z3Q JPN SINGLE device.
```

## arch/arm64/configs/vendor/bloomxq/kona_sec_bloomxq_can_singlex_defconfig
```kconfig
# kona_sec_bloomxq_can_singlex_defconfig

CONFIG_SEC_BLOOMXQ_PROJECT=y
CONFIG_MACH_BLOOMXQ_CAN_SINGLE=y

# Sub PMIC
# CONFIG_REGULATOR_S2ABB01 is not set
# CONFIG_REGULATOR_S2DOS03 is not set
CONFIG_REGULATOR_S2DOS05=y
# CONFIG_REGULATOR_MAX77838 is not set
CONFIG_MFD_S2MPB02=y
CONFIG_REGULATOR_S2MPB02=y
# CONFIG_REGULATOR_S2MPB03 is not set

# input device
CONFIG_TOUCHSCREEN_FTS9CU80F_B=y
CONFIG_TOUCHSCREEN_ZINITIX_ZTW522=y
CONFIG_TOUCHSCREEN_DUAL_FOLDABLE=y

# Fingerprint sensor
CONFIG_SENSORS_FINGERPRINT=y
CONFIG_SENSORS_ET5XX=y
CONFIG_SENSORS_FP_SPI_NUMBER=7
CONFIG_SENSORS_FP_SPI_GPIO_START=20
CONFIG_SENSORS_FP_SPI_GPIO_END=23

#wlan
# Broadcom WiFi feature remove
# CONFIG_BROADCOM_WIFI is not set
# CONFIG_BCM4375 is not set
# CONFIG_BCMDHD_FW_PATH is not set
# CONFIG_BCMDHD_NVRAM_PATH is not set
# CONFIG_BROADCOM_WIFI_RESERVED_MEM is not set
# CONFIG_CFG80211_REG_NOT_UPDATED is not set
# CONFIG_WIFI_MULTICAST_LOG is not set
# CONFIG_BCMDHD_PCIE is not set
# CONFIG_BCMDHD_PREALLOC_MEMDUMP is not set
# CONFIG_BCMDHD_OOB_HOST_WAKE is not set
# CONFIG_BCM_DHD_WLAN is not set
# CONFIG_WLAN_TSQ_MULTIPLIER is not set
# CONFIG_WLAN_VENDOR_DUMP_ENABLE is not set
# Qcom WiFi
CONFIG_CNSS2=y
CONFIG_CNSS2_QMI=y
CONFIG_CNSS_ASYNC=y
CONFIG_BUS_AUTO_SUSPEND=y
CONFIG_CNSS_QCA6390=y
CONFIG_CNSS_GENL=y
CONFIG_QCA_CLD_WLAN=y
CONFIG_WCNSS_MEM_PRE_ALLOC=y
CONFIG_CLD_LL_CORE=y

# NFC ESE
CONFIG_SAMSUNG_NFC=y
CONFIG_NFC_PN547=y
CONFIG_NFC_PN547_ESE_SUPPORT=y
CONFIG_NFC_FEATURE_SN100U=y
CONFIG_ESE_SECURE_GPIO=6
# CONFIG_ESE_SECURE is not set
# CONFIG_ESE_SPI_GPIO_START is not set
# CONFIG_ESE_SPI_GPIO_END is not set
# CONFIG_ESE_SPI_NUMBER is not set
CONFIG_SEC_NFC_LOGGER=y

# Audio
CONFIG_SND_SOC_CS35L41=y
CONFIG_MFD_CS35L41_I2C=y
CONFIG_SND_SOC_SAMSUNG_AUDIO=y
CONFIG_DSP_SLEEP_RECOVERY=y

# Display
CONFIG_PANEL_S6E3HA9_AMF670UH01_FHD=y
CONFIG_PANEL_S6E36W3_AMB114EU09=y

# BATTERY
CONFIG_BATTERY_SAMSUNG=y
CONFIG_BATTERY_SAMSUNG_V2=y
CONFIG_BATTERY_NOTIFIER=y
CONFIG_BATTERY_SWELLING=y
CONFIG_WIRELESS_CHARGER_HIGH_VOLTAGE=y
CONFIG_ENABLE_FULL_BY_SOC=y

CONFIG_CALC_TIME_TO_FULL=y
CONFIG_BATTERY_AGE_FORECAST=y
CONFIG_AFC_CURR_CONTROL_BY_TEMP=y
CONFIG_LIMIT_CHARGING_DURING_CALL=y
CONFIG_ENABLE_100MA_CHARGING_BEFORE_USB_CONFIGURED=y
CONFIG_FUELGAUGE_MAX77705=y
CONFIG_CHARGER_MAX77705=y
CONFIG_MAX77705_CHECK_B2SOVRC=y
CONFIG_WIRELESS_CHARGER_MFC=y
CONFIG_WIRELESS_FIRMWARE_UPDATE=y
CONFIG_WIRELESS_AUTH=y
CONFIG_BATTERY_CISD=y
CONFIG_STEP_CHARGING=y
CONFIG_WIRELESS_TX_MODE=y
CONFIG_DUAL_BATTERY=y
CONFIG_SWITCHING_S2ASL01=y
CONFIG_WIRELESS_IC_PARAM=y
CONFIG_PREVENT_USB_CONN_OVERHEAT=y
CONFIG_TX_5V_DISABLE=y
CONFIG_DISABLE_MFC_IC=y
CONFIG_TX_GEAR_PHM_VOUT_CTRL=y

# MUIC configs
CONFIG_MFD_CORE=y
CONFIG_USE_MUIC=y
CONFIG_MUIC_NOTIFIER=y
CONFIG_AFC_CHARGER_MODE=y
CONFIG_MUIC_SUPPORT_RUSTPROOF=y
CONFIG_VBUS_NOTIFIER=y
CONFIG_VBUS_NOTIFIER_WORK=y
CONFIG_MUIC_MAX77705=y
CONFIG_MFD_MAX77705=y
CONFIG_MUIC_MAX77705_CCIC=y
CONFIG_HV_MUIC_MAX77705_AFC=y
CONFIG_MUIC_SUPPORT_CCIC=y
CONFIG_AFC_CHARGER_MODE=y
CONFIG_MUIC_HV=y
CONFIG_HICCUP_CHARGER=y
CONFIG_MUIC_SUPPORT_UART_SEL=y

# CCIC
CONFIG_CCIC_MAX77705=y
CONFIG_CCIC_NOTIFIER=y
CONFIG_USB_TYPEC_MANAGER_NOTIFIER=y
CONFIG_CCIC_TEMP_BLOCK=y
CONFIG_CCIC_ALTERNATE_MODE=y
CONFIG_SEC_EXT=y
CONFIG_CCIC_LPM_ENABLE=y
CONFIG_USB_STORAGE_DETECT=y
CONFIG_USB_HOST_NOTIFY=y
CONFIG_USB_NOTIFY_LAYER=y
CONFIG_USB_NOTIFIER=y
CONFIG_USB_EXTERNAL_NOTIFY=y
CONFIG_USB_NOTIFY_PROC_LOG=y
CONFIG_USB_DEBUG_DETAILED_LOG=y
CONFIG_USB_HW_PARAM=y
CONFIG_USB_HOST_SAMSUNG_FEATURE=y
CONFIG_USB_INTERFACE_LPM_LIST=y
CONFIG_USB_AUDIO_ENHANCED_DETECT_TIME=y
CONFIG_USB_HOST_CERTIFICATION=y
CONFIG_USB_CONN_GADGET_NDOP=y

# Displayport
# CONFIG_DRM_MSM_DP is not set
# CONFIG_SEC_DISPLAYPORT is not set
# CONFIG_SEC_DISPLAYPORT_LOGGER is not set
# CONFIG_SEC_DISPLAYPORT_BIGDATA is not set

# Motor
CONFIG_ANDROID_TIMED_OUTPUT=y
CONFIG_MOTOR_DRV_CS40L2X=y
CONFIG_MOTOR_DRV_CS40L2X_PMIC_RESET=y
CONFIG_CS40L2X_SAMSUNG_FEATURE=y
CONFIG_VIB_NOTIFIER=y
CONFIG_1030LRA_MOTOR=y

# Hall ic
# CONFIG_SENSORS_HALL is not set
CONFIG_CERTIFY_HALL=y
CONFIG_FOLDER_HALL=y

# BLUETOOTH
CONFIG_BT=y
CONFIG_MSM_BT_POWER=y
CONFIG_BTFM_SLIM=y
CONFIG_BT_SLIM_QCA6390=y
CONFIG_RFKILL=y

# Camera
CONFIG_LEDS_S2MPB02=y
CONFIG_SAMSUNG_OIS_RUMBA_S4=y
CONFIG_SAMSUNG_REAR_DUAL=y
CONFIG_CAMERA_SYSFS_V2=y
CONFIG_SAMSUNG_FRONT_EEPROM=y
# CONFIG_CAMERA_FRAME_CNT_DBG is not set
CONFIG_CAMERA_STREAMOFF_CHECK=y
CONFIG_SAMSUNG_REAR_TELE_TETRA=y
CONFIG_CAMERA_ADAPTIVE_MIPI=y
CONFIG_SENSOR_RETENTION=y
CONFIG_CAMERA_FRS_DRAM_TEST=y
CONFIG_CAMERA_SSM_I2C_ENV=y

# SENSOR
CONFIG_SUPPORT_DUAL_6AXIS=y
CONFIG_SUPPORT_AK0997X=y
CONFIG_SUPPORT_AMS_LIGHT_CALIBRATION=n
CONFIG_SUPPORT_AMS_PROX_CALIBRATION=n
CONFIG_SUPPORT_AMS_LIGHT_LCD_VERSION_DUALIZAION=n
CONFIG_SUPPORT_DEVICE_MODE=y
CONFIG_SUPPORT_SSC_AOD_RECT=y

# GRIP
CONFIG_SENSORS_A96T3X6=y
CONFIG_SENSORS_A96T3X6_SUB=y
CONFIG_SENSORS_FW_VENDOR=y
CONFIG_SENSORS_A96T3X6_CRC_CHECK=y
CONFIG_SENSORS_A96T365IF=y
CONFIG_SENSORS_A96T3X6_BLOCK_SAR_ONLY=y

# KERNEL CORE MEMORY
CONFIG_KZEROD=y
CONFIG_TRANSPARENT_HUGEPAGE=y
CONFIG_HUGEPAGE_POOL=y
CONFIG_HUGEPAGE_POOL_ALLOW_ALL=y
CONFIG_ION_RBIN_HEAP_EXCEPTION=y
```
