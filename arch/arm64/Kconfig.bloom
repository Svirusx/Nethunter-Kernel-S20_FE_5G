## arch/arm64/configs/vendor/f2q/kona_sec_f2q_eur_open_defconfig
```kconfig
# kona_sec_f2q_eur_open_defconfig

CONFIG_SEC_F2Q_PROJECT=y
CONFIG_MACH_F2Q_EUR_OPEN=y

# Sub PMIC
# CONFIG_REGULATOR_S2ABB01 is not set
# CONFIG_REGULATOR_S2DOS03 is not set
CONFIG_REGULATOR_S2DOS05=y
# CONFIG_REGULATOR_MAX77838 is not set
CONFIG_MFD_S2MPB02=y
CONFIG_REGULATOR_S2MPB02=y
CONFIG_REGULATOR_S2MPB03=y

# input device
CONFIG_TOUCHSCREEN_FTS9CU80F_B=y
CONFIG_TOUCHSCREEN_SEC_TS_Y771_SUB=y
CONFIG_TOUCHSCREEN_DUAL_FOLDABLE=y

# Fingerprint sensor
CONFIG_SENSORS_FINGERPRINT=y
CONFIG_SENSORS_ET5XX=y
CONFIG_SENSORS_FP_SPI_NUMBER=7
CONFIG_SENSORS_FP_SPI_GPIO_START=20
CONFIG_SENSORS_FP_SPI_GPIO_END=23

# NFC ESE
CONFIG_SAMSUNG_NFC=y
CONFIG_NFC_PN547=y
CONFIG_NFC_PN547_ESE_SUPPORT=y
CONFIG_NFC_FEATURE_SN100U=y
CONFIG_ESE_SECURE_GPIO=6
# CONFIG_ESE_SECURE is not set
# CONFIG_ESE_SPI_GPIO_START is not set
# CONFIG_ESE_SPI_GPIO_END is not set
# CONFIG_ESE_SPI_NUMBER is not set
CONFIG_SEC_NFC_LOGGER=y

# Audio
CONFIG_SND_SOC_CS35L41_3SPK=y
CONFIG_MFD_CS35L41_I2C=y
CONFIG_SND_SOC_SAMSUNG_AUDIO=y
CONFIG_DSP_SLEEP_RECOVERY=y

# Display
CONFIG_PANEL_S6E3XA0_AMB729WA01_QXGA=y
CONFIG_PANEL_S6E3XA1_AMF759VG01_QXGA=y
CONFIG_PANEL_S6E3FA7_AMB458WJ01_HD=y
CONFIG_PANEL_S6E3FA7_AMB623VH01_HD=y

# BATTERY
CONFIG_BATTERY_SAMSUNG=y
CONFIG_BATTERY_SAMSUNG_V2=y
CONFIG_BATTERY_NOTIFIER=y
CONFIG_BATTERY_SWELLING=y
CONFIG_WIRELESS_CHARGER_HIGH_VOLTAGE=y
CONFIG_ENABLE_FULL_BY_SOC=y

CONFIG_CALC_TIME_TO_FULL=y
CONFIG_BATTERY_AGE_FORECAST=y
CONFIG_AFC_CURR_CONTROL_BY_TEMP=y
CONFIG_LIMIT_CHARGING_DURING_CALL=y
CONFIG_ENABLE_100MA_CHARGING_BEFORE_USB_CONFIGURED=y
CONFIG_FUELGAUGE_MAX77705=y
CONFIG_CHARGER_MAX77705=y
CONFIG_MAX77705_CHECK_B2SOVRC=y
CONFIG_WIRELESS_CHARGER_MFC=y
# CONFIG_WIRELESS_CHARGER_MFC_S2MIW04 is not set
CONFIG_WIRELESS_FIRMWARE_UPDATE=y
CONFIG_WIRELESS_AUTH=y
CONFIG_BATTERY_CISD=y
CONFIG_STEP_CHARGING=y
CONFIG_DUAL_BATTERY=y
CONFIG_DUAL_BATTERY_CELL_SENSING=y
CONFIG_SWITCHING_S2ASL01=y
CONFIG_WIRELESS_TX_MODE=y
CONFIG_TX_5V_DISABLE=y
CONFIG_DIRECT_CHARGING=y
CONFIG_CHARGER_PCA9468=y
CONFIG_PDIC_PD30=y
CONFIG_PREVENT_USB_CONN_OVERHEAT=y
CONFIG_WIRELESS_IC_PARAM=y
CONFIG_WIRELESS_CHARGER_HAL_MFC=y
CONFIG_DISABLE_MFC_IC=y
CONFIG_TX_GEAR_PHM_VOUT_CTRL=y

# MUIC configs
CONFIG_MFD_CORE=y
CONFIG_USE_MUIC=y
CONFIG_MUIC_NOTIFIER=y
CONFIG_AFC_CHARGER_MODE=y
CONFIG_MUIC_SUPPORT_RUSTPROOF=y
CONFIG_VBUS_NOTIFIER=y
CONFIG_VBUS_NOTIFIER_WORK=y
CONFIG_MUIC_MAX77705=y
CONFIG_MFD_MAX77705=y
CONFIG_MUIC_MAX77705_CCIC=y
CONFIG_HV_MUIC_MAX77705_AFC=y
CONFIG_MUIC_SUPPORT_CCIC=y
CONFIG_AFC_CHARGER_MODE=y
CONFIG_MUIC_HV=y
CONFIG_HICCUP_CHARGER=y
CONFIG_MUIC_SUPPORT_UART_SEL=y

#GPIO_EXPANDER
CONFIG_GPIO_PCAL6524=y

# CCIC
CONFIG_CCIC_MAX77705=y
CONFIG_CCIC_NOTIFIER=y
CONFIG_USB_TYPEC_MANAGER_NOTIFIER=y
CONFIG_CCIC_TEMP_BLOCK=y
CONFIG_CCIC_ALTERNATE_MODE=y
CONFIG_SEC_EXT=y
CONFIG_CCIC_LPM_ENABLE=y
CONFIG_USB_STORAGE_DETECT=y
CONFIG_USB_HOST_NOTIFY=y
CONFIG_USB_NOTIFY_LAYER=y
CONFIG_USB_NOTIFIER=y
CONFIG_USB_EXTERNAL_NOTIFY=y
CONFIG_USB_NOTIFY_PROC_LOG=y
CONFIG_USB_DEBUG_DETAILED_LOG=y
CONFIG_USB_HW_PARAM=y
CONFIG_USB_HOST_SAMSUNG_FEATURE=y
CONFIG_USB_INTERFACE_LPM_LIST=y
CONFIG_USB_AUDIO_ENHANCED_DETECT_TIME=y
CONFIG_USB_HOST_CERTIFICATION=y

# USB
CONFIG_ENABLE_USB_SUSPEND_STATE=y

# redriver
CONFIG_REDRIVER=y
CONFIG_COMBO_REDRIVER_PTN36502=y

# Displayport
CONFIG_DRM_MSM_DP=y
CONFIG_SEC_DISPLAYPORT=y
CONFIG_SEC_DISPLAYPORT_LOGGER=y
CONFIG_SEC_DISPLAYPORT_BIGDATA=y

# Motor
CONFIG_ANDROID_TIMED_OUTPUT=y
CONFIG_MOTOR_DRV_CS40L2X=y
CONFIG_MOTOR_DRV_CS40L2X_PMIC_RESET=y
CONFIG_CS40L2X_SAMSUNG_FEATURE=y
CONFIG_VIB_NOTIFIER=y

# Hall ic
CONFIG_SENSORS_HALL=y
CONFIG_CERTIFY_HALL=y
CONFIG_FOLDER_HALL=y

# CONFIG_BROADCOM_WIFI is not set
# CONFIG_BCM4375 is not set
# CONFIG_BCMDHD_FW_PATH is not set
# CONFIG_BCMDHD_NVRAM_PATH is not set
# CONFIG_BROADCOM_WIFI_RESERVED_MEM is not set
# CONFIG_BCMDHD_PCIE is not set
# CONFIG_BCMDHD_PREALLOC_MEMDUMP is not set
# CONFIG_BCMDHD_OOB_HOST_WAKE is not set
# CONFIG_BCM_DHD_WLAN is not set
# CONFIG_CFG80211_REG_NOT_UPDATED is not set
# CONFIG_WLAN_TSQ_MULTIPLIER is not set
# CONFIG_WLAN_VENDOR_DUMP_ENABLE is not set

CONFIG_CNSS2=y
CONFIG_CNSS2_QMI=y
CONFIG_CNSS2_DEBUG=y
CONFIG_CNSS_ASYNC=y
CONFIG_BUS_AUTO_SUSPEND=y
CONFIG_CNSS_QCA6490=y
CONFIG_CNSS_GENL=y
CONFIG_QCA_CLD_WLAN=y
CONFIG_WCNSS_MEM_PRE_ALLOC=y
CONFIG_CLD_LL_CORE=y

# BLUETOOTH
CONFIG_BT=y
CONFIG_BT_BCM4361=y
CONFIG_BT_BLUESLEEP=y
CONFIG_RFKILL=y
CONFIG_MSM_BT_POWER=y
CONFIG_BTFM_SLIM=y
CONFIG_BT_SLIM_QCA6490=y

# Camera
CONFIG_LEDS_S2MPB02=y
CONFIG_SAMSUNG_OIS_MCU_STM32=y
CONFIG_CAMERA_SYSFS_V2=y
CONFIG_SAMSUNG_REAR_TRIPLE=y
CONFIG_SAMSUNG_FRONT_EEPROM=y
CONFIG_CAMERA_STREAMOFF_CHECK=y
CONFIG_SAMSUNG_REAR_TELE_TETRA=y
CONFIG_CAMERA_ADAPTIVE_MIPI=y
CONFIG_SAMSUNG_SBI=y
CONFIG_SAMSUNG_FRONT_TOP=y
CONFIG_SAMSUNG_FRONT_TOP_EEPROM=y

# SENSOR
CONFIG_SUPPORT_DUAL_6AXIS=y
CONFIG_SUPPORT_AK0997X=y
CONFIG_SUPPORT_DEVICE_MODE=y
CONFIG_SUPPORT_VIRTUAL_OPTIC=y
CONFIG_SUPPORT_BRIGHT_COMPENSATION_LUX=y
CONFIG_SUPPORT_DUAL_OPTIC=y
CONFIG_SUPPORT_DUAL_DDI_COPR_FOR_LIGHT_SENSOR=y
CONFIG_SUPPORT_LIGHT_MAIN2_SENSOR=y
CONFIG_SUPPORT_TMD4907_STK33610_FACTORY=y
CONFIG_TMD490X_FACTORY=n
CONFIG_SUPPORT_TMD4907_FACTORY=n
CONFIG_SUPPORT_LIGHT_MAIN2_SENSOR=y
CONFIG_SUPPORT_PROX_INIT_CAL=y

# GRIP
CONFIG_SENSORS_SX9330_SUB2=y
CONFIG_SENSORS_SX9360_SUB3=y

# KERNEL CORE MEMORY
CONFIG_KZEROD=y
CONFIG_TRANSPARENT_HUGEPAGE=y
CONFIG_HUGEPAGE_POOL=y
CONFIG_HUGEPAGE_POOL_ALLOW_ALL=y
CONFIG_ION_RBIN_HEAP_EXCEPTION=y

# UWB
CONFIG_SAMSUNG_UWB=y
CONFIG_UWB_SR100=y
CONFIG_SEC_UWB_LOGGER=y

#MPTCP
CONFIG_MPTCP=y
CONFIG_SAMSUNG_MPTCP=y
CONFIG_TCP_CONG_LIA=y
CONFIG_TCP_CONG_OLIA=y
CONFIG_TCP_CONG_WVEGAS=y
CONFIG_MPTCP_FULLMESH=y
CONFIG_MPTCP_NDIFFPORTS=y
CONFIG_MPTCP_BINDER=y
CONFIG_MPTCP_ROUNDROBIN=y
```

## arch/arm64/configs/vendor/gts7l/kona_sec_gts7l_eur_open_defconfig
```kconfig
# kona_sec_gts7l_eur_open_defconfig

CONFIG_SEC_GTS7L_PROJECT=y
CONFIG_MACH_GTS7L_EUR_OPEN=y

# Sub PMIC
# CONFIG_REGULATOR_S2ABB01 is not set
# CONFIG_REGULATOR_S2DOS03 is not set
CONFIG_REGULATOR_S2DOS05=y
# CONFIG_REGULATOR_MAX77838 is not set
CONFIG_MFD_S2MPB02=y
CONFIG_REGULATOR_S2MPB02=y
CONFIG_REGULATOR_S2MPB03=y

# input device
CONFIG_TOUCHSCREEN_NOVATEK_NT36523=y
# CONFIG_INPUT_SEC_SECURE_TOUCH is not set
CONFIG_INPUT_WACOM=y
CONFIG_EPEN_WACOM_W9021=y
CONFIG_KEYBOARD_STM32_POGO=y

# Fingerprint sensor
CONFIG_SENSORS_FINGERPRINT=y
CONFIG_SENSORS_GW3X=y
CONFIG_SENSORS_FP_SPI_NUMBER=7
CONFIG_SENSORS_FP_SPI_GPIO_START=20
CONFIG_SENSORS_FP_SPI_GPIO_END=23



#wlan

# Broadcom WiFi feature remove
# CONFIG_BROADCOM_WIFI is not set
# CONFIG_BCM4375 is not set
# CONFIG_BCMDHD_FW_PATH is not set
# CONFIG_BCMDHD_NVRAM_PATH is not set
# CONFIG_BROADCOM_WIFI_RESERVED_MEM is not set
# CONFIG_CFG80211_REG_NOT_UPDATED is not set
# CONFIG_WIFI_MULTICAST_LOG is not set
# CONFIG_BCMDHD_PCIE is not set
# CONFIG_BCMDHD_PREALLOC_MEMDUMP is not set
# CONFIG_BCMDHD_OOB_HOST_WAKE is not set
# CONFIG_BCM_DHD_WLAN is not set
# CONFIG_WLAN_TSQ_MULTIPLIER is not set
# CONFIG_WLAN_VENDOR_DUMP_ENABLE is not set
# Qcom WiFi
CONFIG_CNSS2=y
CONFIG_CNSS2_QMI=y
CONFIG_CNSS2_DEBUG=y
CONFIG_CNSS_ASYNC=y
CONFIG_BUS_AUTO_SUSPEND=y
CONFIG_CNSS_QCA6390=y
CONFIG_CNSS_GENL=y
CONFIG_QCA_CLD_WLAN=y
CONFIG_WCNSS_MEM_PRE_ALLOC=y
CONFIG_CLD_LL_CORE=y

CONFIG_SEC_SEPARATE_BDFILE=y



# NFC ESE
# CONFIG_SAMSUNG_NFC is not set
# CONFIG_NFC_PN547 is not set
# CONFIG_NFC_PN547_ESE_SUPPORT is not set
# CONFIG_NFC_FEATURE_SN100U is not set
# CONFIG_ESE_SECURE_GPIO is not set
# CONFIG_ESE_SECURE is not set
# CONFIG_ESE_SPI_GPIO_START is not set
# CONFIG_ESE_SPI_GPIO_END is not set
# CONFIG_ESE_SPI_NUMBER is not set
# CONFIG_SEC_NFC_LOGGER is not set

# Audio
CONFIG_SND_SOC_CS35L41_4SPK=y
CONFIG_MFD_CS35L41_I2C=y
CONFIG_SND_SOC_SAMSUNG_AUDIO=y
CONFIG_DSP_SLEEP_RECOVERY=y

# Display
CONFIG_PANEL_NT36523_PPA957DB1_WQXGA=y

# BATTERY
CONFIG_BATTERY_SAMSUNG=y
CONFIG_BATTERY_SAMSUNG_V2=y
CONFIG_BATTERY_NOTIFIER=y
CONFIG_BATTERY_SWELLING=y
CONFIG_WIRELESS_CHARGER_HIGH_VOLTAGE=y
CONFIG_ENABLE_FULL_BY_SOC=y

CONFIG_CALC_TIME_TO_FULL=y
CONFIG_BATTERY_AGE_FORECAST=y
CONFIG_AFC_CURR_CONTROL_BY_TEMP=y
CONFIG_LIMIT_CHARGING_DURING_CALL=y
CONFIG_ENABLE_100MA_CHARGING_BEFORE_USB_CONFIGURED=y
CONFIG_FUELGAUGE_MAX77705=y
CONFIG_CHARGER_MAX77705=y
CONFIG_MAX77705_CHECK_B2SOVRC=y
CONFIG_BATTERY_CISD=y
CONFIG_STEP_CHARGING=y
CONFIG_DIRECT_CHARGING=y
CONFIG_CHARGER_PCA9468=y
CONFIG_PDIC_PD30=y
CONFIG_PREVENT_USB_CONN_OVERHEAT=y
CONFIG_TABLET_MODEL_CONCEPT=y

# MUIC configs
CONFIG_MFD_CORE=y
CONFIG_USE_MUIC=y
CONFIG_MUIC_NOTIFIER=y
CONFIG_AFC_CHARGER_MODE=y
CONFIG_MUIC_SUPPORT_RUSTPROOF=y
CONFIG_VBUS_NOTIFIER=y
CONFIG_VBUS_NOTIFIER_WORK=y
CONFIG_MUIC_MAX77705=y
CONFIG_MFD_MAX77705=y
CONFIG_MUIC_MAX77705_CCIC=y
CONFIG_HV_MUIC_MAX77705_AFC=y
CONFIG_MUIC_SUPPORT_CCIC=y
CONFIG_AFC_CHARGER_MODE=y
CONFIG_MUIC_HV=y
CONFIG_HICCUP_CHARGER=y
CONFIG_MUIC_SUPPORT_UART_SEL=y

# CCIC
CONFIG_CCIC_MAX77705=y
CONFIG_CCIC_NOTIFIER=y
CONFIG_USB_TYPEC_MANAGER_NOTIFIER=y
CONFIG_CCIC_TEMP_BLOCK=y
CONFIG_CCIC_ALTERNATE_MODE=y
CONFIG_SEC_EXT=y
CONFIG_CCIC_LPM_ENABLE=y
CONFIG_USB_STORAGE_DETECT=y
CONFIG_USB_HOST_NOTIFY=y
CONFIG_USB_NOTIFY_LAYER=y
CONFIG_USB_NOTIFIER=y
CONFIG_USB_EXTERNAL_NOTIFY=y
CONFIG_USB_NOTIFY_PROC_LOG=y
CONFIG_USB_DEBUG_DETAILED_LOG=y
CONFIG_USB_HW_PARAM=y
CONFIG_USB_HOST_SAMSUNG_FEATURE=y
CONFIG_USB_INTERFACE_LPM_LIST=y
CONFIG_USB_AUDIO_ENHANCED_DETECT_TIME=y
CONFIG_USB_HOST_CERTIFICATION=y

# USB
CONFIG_ENABLE_USB_SUSPEND_STATE=y

# redriver
CONFIG_REDRIVER=y
CONFIG_COMBO_REDRIVER_PS5169=y

# Displayport
CONFIG_DRM_MSM_DP=y
CONFIG_SEC_DISPLAYPORT=y
CONFIG_SEC_DISPLAYPORT_LOGGER=y
CONFIG_SEC_DISPLAYPORT_BIGDATA=y

# Motor
CONFIG_MSM_VIBRATOR=y
CONFIG_VIB_NOTIFIER=y

# Camera
# CONFIG_LEDS_S2MPB02 is not set
# CONFIG_SENSORS_TCS3407 is not set
CONFIG_LEDS_PMIC_QPNP=y
CONFIG_CAMERA_SYSFS_V2=y
CONFIG_SAMSUNG_REAR_DUAL=y
CONFIG_SAMSUNG_FRONT_EEPROM=y
# CONFIG_CAMERA_FRAME_CNT_DBG is not set
CONFIG_CAMERA_STREAMOFF_CHECK=y
CONFIG_SAMSUNG_REAR_TELE_BINNING=y
# CONFIG_CAMERA_ADAPTIVE_MIPI=y
CONFIG_SAMSUNG_ACTUATOR_SOFTLANDING=y

# Hall ic
CONFIG_SENSORS_HALL=y
# CONFIG_CERTIFY_HALL is not set
CONFIG_WACOM_HALL=y
CONFIG_WACOM_HALL_SUPPORT_COVER_DETECT=y
CONFIG_LOGICAL_HALL=y
# CONFIG_FOLDER_HALL is not set

# BLUETOOTH
CONFIG_BT=y
CONFIG_MSM_BT_POWER=y
CONFIG_BTFM_SLIM=y
CONFIG_BT_SLIM_QCA6390=y
CONFIG_RFKILL=y

# sensor
CONFIG_LPS22HH_FACTORY=n
CONFIG_TMD490X_FACTORY=n
CONFIG_SUPPORT_AMS_LIGHT_LCD_VERSION_DUALIZAION=n
CONFIG_SUPPORT_AMS_LIGHT_CALIBRATION=n
CONFIG_SUPPORT_AMS_PROX_CALIBRATION=n
CONFIG_SUPPORT_BRIGHTNESS_NOTIFY_FOR_LIGHT_SENSOR=n
CONFIG_SUPPORT_UNDER_PANEL_WITH_LIGHT_SENSOR=n
CONFIG_SUPPORT_DDI_COPR_FOR_LIGHT_SENSOR=n
CONFIG_SUPPORT_PROX_AUTO_CAL=n
CONFIG_SUPPORT_TMD4907_FACTORY=n
CONFIG_VEML3235_FACTORY=y
CONFIG_VEML3235_SUB_FACTORY=y
CONFIG_SUPPORT_DUAL_OPTIC=y
CONFIG_SUPPORT_VIRTUAL_OPTIC=y

# GRIP
CONFIG_SENSORS_A96T3X6=y
CONFIG_SENSORS_A96T3X6_2CH=y
#CONFIG_SENSORS_A96T3X6_SUB=y
#CONFIG_SENSORS_A96T3X6_SUB_2CH=y
CONFIG_SENSORS_A96T3X6_WIFI=y
CONFIG_SENSORS_A96T3X6_WIFI_2CH=y
CONFIG_SENSORS_A96T3X6_UNSUPPORT_OTG=y
CONFIG_SENSORS_A96T3X6_BLOCK_SAR_ONLY=y

# KERNEL CORE MEMORY
CONFIG_ION_RBIN_HEAP_EXCEPTION=y
CONFIG_MMAP_READAROUND_LIMIT=16
```
