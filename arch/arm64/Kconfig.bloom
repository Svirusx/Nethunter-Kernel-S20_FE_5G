## arch/arm64/configs/vendor/kona_sec_eng_defconfig
```kconfig
# kona_sec_eng_defconfig

CONFIG_DEBUG_BLK_CGROUP=y
CONFIG_CGROUP_DEBUG=y
# CONFIG_BLK_DEV_BSG is not set
# CONFIG_IOSCHED_DEADLINE is not set
CONFIG_CLEANCACHE=y
CONFIG_PM_DEBUG=y
CONFIG_L2TP_DEBUGFS=y
CONFIG_DNS_RESOLVER=y
# CONFIG_CFG80211_CRDA_SUPPORT is not set
CONFIG_SCSI_UFSHCD_CMD_LOGGING=y
# CONFIG_SERIAL_DEV_BUS is not set
CONFIG_TTY_PRINTK=y
CONFIG_BACKLIGHT_LCD_SUPPORT=y
CONFIG_BACKLIGHT_CLASS_DEVICE=y
CONFIG_EDAC_QCOM_LLCC=y
CONFIG_EDAC_QCOM_LLCC_PANIC_ON_CE=y
CONFIG_EDAC_QCOM_LLCC_PANIC_ON_UE=y
CONFIG_EDAC_KRYO_ARM64_PANIC_ON_CE=y
CONFIG_EDAC_QCOM=y
CONFIG_QCOM_GPI_DMA_DEBUG=y
CONFIG_DEBUG_DMA_BUF_REF=y
CONFIG_QCOM_WDOG_IPI_ENABLE=y
CONFIG_MSM_CORE_HANG_DETECT=y
CONFIG_MSM_GLADIATOR_HANG_DETECT=y
# CONFIG_ICNSS_DEBUG is not set
CONFIG_MSM_SPSS_UTILS=y
CONFIG_PHY_XGENE=y
CONFIG_ESOC_DEBUG=y
CONFIG_EFIVAR_FS=y
# CONFIG_NETWORK_FILESYSTEMS is not set
CONFIG_KPROBES=y
CONFIG_DYNAMIC_DEBUG=y
CONFIG_DEBUG_MODULE_LOAD_INFO=y
CONFIG_PAGE_OWNER=y
CONFIG_PAGE_OWNER_ENABLE_DEFAULT=y
CONFIG_DEBUG_SECTION_MISMATCH=y
# CONFIG_SECTION_MISMATCH_WARN_ONLY is not set
CONFIG_DEBUG_RODATA_TEST=y
CONFIG_DEBUG_PAGEALLOC=y
CONFIG_SLUB_DEBUG=y
CONFIG_SLUB_DEBUG_PANIC_ON=y
CONFIG_DEBUG_PAGEALLOC_ENABLE_DEFAULT=y
CONFIG_PAGE_POISONING=y
CONFIG_PAGE_POISONING_ENABLE_DEFAULT=y
CONFIG_DEBUG_OBJECTS=y
CONFIG_DEBUG_OBJECTS_FREE=y
CONFIG_DEBUG_OBJECTS_TIMERS=y
CONFIG_DEBUG_OBJECTS_WORK=y
CONFIG_DEBUG_OBJECTS_PERCPU_COUNTER=y
CONFIG_SLUB_DEBUG_ON=y
CONFIG_DEBUG_KMEMLEAK=y
CONFIG_DEBUG_KMEMLEAK_EARLY_LOG_SIZE=4000
CONFIG_DEBUG_KMEMLEAK_DEFAULT_OFF=y
CONFIG_DEBUG_STACK_USAGE=y
CONFIG_DEBUG_MEMORY_INIT=y
CONFIG_SOFTLOCKUP_DETECTOR=y
CONFIG_WQ_WATCHDOG=y
CONFIG_PANIC_ON_SCHED_BUG=y
CONFIG_PANIC_ON_RT_THROTTLING=y
CONFIG_SCHED_STACK_END_CHECK=y
CONFIG_DEBUG_SPINLOCK=y
CONFIG_DEBUG_MUTEXES=y
CONFIG_DEBUG_ATOMIC_SLEEP=y
CONFIG_LOCK_TORTURE_TEST=m
CONFIG_DEBUG_SG=y
CONFIG_DEBUG_NOTIFIERS=y
CONFIG_DEBUG_CREDENTIALS=y
CONFIG_RCU_TORTURE_TEST=m
CONFIG_FAULT_INJECTION=y
CONFIG_FAIL_PAGE_ALLOC=y
CONFIG_UFS_FAULT_INJECTION=y
CONFIG_FAULT_INJECTION_DEBUG_FS=y
CONFIG_FAULT_INJECTION_STACKTRACE_FILTER=y
CONFIG_FUNCTION_TRACER=y
CONFIG_IRQSOFF_TRACER=y
CONFIG_PREEMPT_TRACER=y
CONFIG_BLK_DEV_IO_TRACE=y
CONFIG_LKDTM=m
CONFIG_ATOMIC64_SELFTEST=m
CONFIG_TEST_USER_COPY=m
CONFIG_MEMTEST=y
CONFIG_BUG_ON_DATA_CORRUPTION=y
CONFIG_PID_IN_CONTEXTIDR=y
CONFIG_ARM64_STRICT_BREAK_BEFORE_MAKE=y
CONFIG_HARDENED_USERCOPY_PAGESPAN=y
CONFIG_XZ_DEC=y
CONFIG_CORESIGHT_SOURCE_ETM4X=y
CONFIG_CMA_DEBUGFS=y
CONFIG_PRINT_VMEMLAYOUT=y
CONFIG_MHI_DEBUG=y
CONFIG_PREEMPTIRQ_EVENTS=y
CONFIG_SERIAL_MSM_GENI_CONSOLE=y
CONFIG_ENG_BATTERY_CONCEPT=y
CONFIG_SEC_GPIO_DVS=y

# Displayport debugging
CONFIG_SEC_DISPLAYPORT_ENG=y

# Samsung Eng Debugging Feature
CONFIG_SEC_DEBUG_FORCE_ERROR=y
CONFIG_SEC_DEBUG_SEC_WDOG_BITE=y
CONFIG_SEC_USER_RESET_DEBUG_TEST=y

# Samsung Eng PCIe PHY Tune
CONFIG_SEC_PCIE_DEV=y

# Samsung Eng SI CDSP Crash
CONFIG_SEC_CDSP_NOT_CRASH_ENG=y

# UH
# CONFIG_UH_LKM_BLOCK is not set
# CONFIG_KDP_CRED is not set
# CONFIG_KDP_NS is not set
# CONFIG_KDP_DMAP is not set
# CONFIG_KDP_TEST is not set

# SDP KeyManagement Test for MDFPP evaluation
CONFIG_SDP_KEY_DUMP=y

# HDM
CONFIG_HDM_DEBUG=y

# ABC Hub bootc eng mode
CONFIG_SEC_ABC_HUB_BOOTC_ENG=y

# USB phy tune
CONFIG_USB_MSM_SSPHY_QMP_TUNING=y
```

## arch/arm64/configs/vendor/kona_sec_kasan_defconfig
```kconfig
#
# KASAN Kernel Address SANitizer
#
CONFIG_KASAN=y
CONFIG_KASAN_INLINE=y
CONFIG_LOG_BUF_SHIFT=21
CONFIG_CC_OPTIMIZE_FOR_SIZE=y

CONFIG_SLUB_DEBUG=y

# Increase by 12kB because we increased KASAN_THREAD_SHIFT
# Required because of  https://bugs.llvm.org/show_bug.cgi?id=38809
#
#CONFIG_FRAME_WARN=14336
# With qcom llvm 8.0.12 or 10.0.2 warning->error can't be disabled, so just disable this warning:
CONFIG_FRAME_WARN=0

#
# Enable multishot mode
# https://github.sec.samsung.net/SRPOL-SRUK-SEC/syzkaller/issues/23
#
CONFIG_CMDLINE="kasan_multi_shot"
# CONFIG_CMDLINE_FROM_BOOTLOADER is not set
CONFIG_CMDLINE_EXTEND=y

#
# Undefined config for Kernel SANitizers
#
# CONFIG_SLUB_DEBUG_PANIC_ON is not set
# CONFIG_UH is not set
# CONFIG_UH_RKP is not set
# CONFIG_RKP_TEST is not set
# CONFIG_KDP_CRED is not set
# CONFIG_KDP_TEST is not set
# CONFIG_KDP_NS is not set
# CONFIG_KDP_DMAP is not set

# CONFIG_CFP_JOPP is not set
# CONFIG_CFP_ROPP is not set
# CONFIG_CFP_ROPP_SYSREGKEY is not set
# CONFIG_RANDOMIZE_BASE is not set

#
# DO NOT REMOVE THE LAST BLANK LINE
#
```

## arch/arm64/configs/vendor/kona_sec_userdebug_defconfig
```kconfig
# kona_sec_userdebug_defconfig
CONFIG_HPB_DEBUG_SYSFS=y

# KDP
# CONFIG_KDP_CRED is not set
# CONFIG_KDP_NS is not set
# CONFIG_KDP_DMAP is not set
# CONFIG_KDP_TEST is not set

# SDP KeyManagement Test for MDFPP evaluation
CONFIG_SDP_KEY_DUMP=y

# streamline
CONFIG_PROFILING=y
CONFIG_PERF_EVENTS=y
CONFIG_HIGH_RES_TIMERS=y
CONFIG_HW_PERF_EVENTS=y
CONFIG_LOCAL_TIMERS=y

CONFIG_GATOR=y
```

## arch/arm64/configs/vendor/y2q/kona_sec_y2q_chn_openx_defconfig
```kconfig
# kona_sec_y2q_chn_openx_defconfig

CONFIG_SEC_Y2Q_PROJECT=y
CONFIG_MACH_Y2Q_CHN_OPEN=y

# Sub PMIC
# CONFIG_REGULATOR_S2ABB01 is not set
# CONFIG_REGULATOR_S2DOS03 is not set
CONFIG_REGULATOR_S2DOS05=y
# CONFIG_REGULATOR_MAX77838 is not set
CONFIG_MFD_S2MPB02=y
CONFIG_REGULATOR_S2MPB02=y
CONFIG_REGULATOR_S2MPB03=y

# input device
CONFIG_TOUCHSCREEN_SEC_TS_Y79A=y
CONFIG_KEYBOARD_STM_FSR=y

# Fingerprint sensor
CONFIG_SENSORS_FINGERPRINT=y
CONFIG_SENSORS_QBT2000=y
CONFIG_SENSORS_FP_SPI_NUMBER=7
CONFIG_SENSORS_FP_SPI_GPIO_START=20
CONFIG_SENSORS_FP_SPI_GPIO_END=23

# NFC ESE
CONFIG_SAMSUNG_NFC=y
CONFIG_NFC_PN547=y
CONFIG_NFC_PN547_ESE_SUPPORT=y
CONFIG_NFC_FEATURE_SN100U=y
CONFIG_ESE_SECURE_GPIO=6
# CONFIG_ESE_SECURE is not set
# CONFIG_ESE_SPI_GPIO_START is not set
# CONFIG_ESE_SPI_GPIO_END is not set
# CONFIG_ESE_SPI_NUMBER is not set
CONFIG_SEC_NFC_LOGGER=y

# Audio
CONFIG_SND_SOC_CS35L41=y
CONFIG_MFD_CS35L41_I2C=y
CONFIG_SND_SOC_SAMSUNG_AUDIO=y
CONFIG_DSP_SLEEP_RECOVERY=y

# Display
CONFIG_PANEL_S6E3HA9_AMB644WF01_WQHD=y
CONFIG_PANEL_S6E3HA9_AMB611WE01_WQHD=y
CONFIG_PANEL_S6E3HAB_AMB677TY01_WQHD=y

# BATTERY
CONFIG_BATTERY_SAMSUNG=y
CONFIG_BATTERY_SAMSUNG_V2=y
CONFIG_BATTERY_NOTIFIER=y
CONFIG_BATTERY_SWELLING=y
CONFIG_WIRELESS_CHARGER_HIGH_VOLTAGE=y
CONFIG_PD_CHARGER_HV_DISABLE=y
CONFIG_ENABLE_FULL_BY_SOC=y

CONFIG_CALC_TIME_TO_FULL=y
CONFIG_BATTERY_AGE_FORECAST=y
CONFIG_AFC_CURR_CONTROL_BY_TEMP=y
CONFIG_LIMIT_CHARGING_DURING_CALL=y
CONFIG_ENABLE_100MA_CHARGING_BEFORE_USB_CONFIGURED=y
CONFIG_FUELGAUGE_MAX77705=y
CONFIG_CHARGER_MAX77705=y
CONFIG_MAX77705_CHECK_B2SOVRC=y
CONFIG_WIRELESS_CHARGER_MFC=y
# CONFIG_WIRELESS_CHARGER_MFC_S2MIW04 is not set
CONFIG_WIRELESS_FIRMWARE_UPDATE=y
CONFIG_WIRELESS_AUTH=y
CONFIG_BATTERY_CISD=y
CONFIG_STEP_CHARGING=y
CONFIG_WIRELESS_TX_MODE=y
CONFIG_DIRECT_CHARGING=y
CONFIG_CHARGER_PCA9468=y
CONFIG_PDIC_PD30=y
CONFIG_PREVENT_USB_CONN_OVERHEAT=y
CONFIG_WIRELESS_IC_PARAM=y
CONFIG_WIRELESS_CHARGER_HAL_MFC=y
CONFIG_DISABLE_MFC_IC=y

# MUIC configs
CONFIG_MFD_CORE=y
CONFIG_USE_MUIC=y
CONFIG_MUIC_NOTIFIER=y
CONFIG_AFC_CHARGER_MODE=y
CONFIG_MUIC_SUPPORT_RUSTPROOF=y
CONFIG_VBUS_NOTIFIER=y
CONFIG_VBUS_NOTIFIER_WORK=y
CONFIG_MUIC_MAX77705=y
CONFIG_MFD_MAX77705=y
CONFIG_MUIC_MAX77705_CCIC=y
CONFIG_HV_MUIC_MAX77705_AFC=y
CONFIG_MUIC_SUPPORT_CCIC=y
CONFIG_AFC_CHARGER_MODE=y
CONFIG_MUIC_HV=y
CONFIG_HICCUP_CHARGER=y
CONFIG_MUIC_SUPPORT_UART_SEL=y

# CCIC
CONFIG_CCIC_MAX77705=y
CONFIG_CCIC_NOTIFIER=y
CONFIG_USB_TYPEC_MANAGER_NOTIFIER=y
CONFIG_CCIC_TEMP_BLOCK=y
CONFIG_CCIC_ALTERNATE_MODE=y
CONFIG_SEC_EXT=y
CONFIG_CCIC_LPM_ENABLE=y
CONFIG_USB_STORAGE_DETECT=y
CONFIG_USB_HOST_NOTIFY=y
CONFIG_USB_NOTIFY_LAYER=y
CONFIG_USB_NOTIFIER=y
CONFIG_USB_EXTERNAL_NOTIFY=y
CONFIG_USB_NOTIFY_PROC_LOG=y
CONFIG_USB_DEBUG_DETAILED_LOG=y
CONFIG_USB_HW_PARAM=y
CONFIG_USB_HOST_SAMSUNG_FEATURE=y
CONFIG_USB_INTERFACE_LPM_LIST=y
CONFIG_USB_AUDIO_ENHANCED_DETECT_TIME=y
CONFIG_USB_HOST_CERTIFICATION=y

# USB
CONFIG_ENABLE_USB_SUSPEND_STATE=y

# Displayport
CONFIG_DRM_MSM_DP=y
CONFIG_SEC_DISPLAYPORT=y
CONFIG_SEC_DISPLAYPORT_LOGGER=y
CONFIG_SEC_DISPLAYPORT_BIGDATA=y

# BLUETOOTH
CONFIG_BT=y
CONFIG_BT_BCM4361=y
CONFIG_BT_BLUESLEEP=y
CONFIG_RFKILL=y
CONFIG_MSM_BT_POWER=y
CONFIG_BT_SLIM_QCA6390=y
CONFIG_BTFM_SLIM=y

#wlan
CONFIG_WLAN_REGION_CODE=300

# Motor
CONFIG_ANDROID_TIMED_OUTPUT=y
CONFIG_MOTOR_DRV_CS40L2X=y
CONFIG_MOTOR_DRV_CS40L2X_PMIC_RESET=y
CONFIG_CS40L2X_SAMSUNG_FEATURE=y
CONFIG_VIB_NOTIFIER=y

# Camera
CONFIG_LEDS_S2MPB02=y
CONFIG_SAMSUNG_OIS_MCU_STM32=y
CONFIG_CAMERA_SYSFS_V2=y
CONFIG_SAMSUNG_REAR_TRIPLE=y
CONFIG_SAMSUNG_REAR_TOF=y
CONFIG_SAMSUNG_FRONT_EEPROM=y
# CONFIG_CAMERA_FRAME_CNT_DBG is not set
CONFIG_CAMERA_STREAMOFF_CHECK=y
CONFIG_SAMSUNG_SBI=y
CONFIG_CAMERA_ADAPTIVE_MIPI=y
CONFIG_SAMSUNG_REAR_TELE_BINNING=y
CONFIG_CAMERA_SSM_I2C_ENV=y
CONFIG_USE_CAMERA_HW_BIG_DATA=y

# Hall ic
CONFIG_SENSORS_HALL=y
CONFIG_CERTIFY_HALL=y
# CONFIG_FOLDER_HALL is not set

# GRIP
CONFIG_SENSORS_SX9360=y

# KERNEL CORE MEMORY
CONFIG_KZEROD=y
CONFIG_TRANSPARENT_HUGEPAGE=y
CONFIG_HUGEPAGE_POOL=y
CONFIG_HUGEPAGE_POOL_ALLOW_ALL=y
```
