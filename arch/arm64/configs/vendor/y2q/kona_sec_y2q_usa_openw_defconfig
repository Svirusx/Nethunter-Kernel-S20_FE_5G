## drivers/adsp_factory/Kconfig
```kconfig
#
# factory sensor drivers configuration
#
config ADSP_FACTORY
	tristate "MSM ADSP factory driver"
	default n
	help
	  This driver communicate with SSC DAEMON.
	  register each sensor device.
	  send selftest request using netlink.
	  receive test result using netlink.

config LSM6DSO_FACTORY
	tristate "factory test for SSC - LSM6DSO"
	default n
	help
	  lsm6dso factory driver.
	  provide sysfs for factory test.
	  request selftest to adsp_factory.
	  receive test result from adsp_factory.

config LSM6DSL_FACTORY
	tristate "factory test for SSC - LSM6DSL"
	default n
	help
	  lsm6dsl factory driver.
	  provide sysfs for factory test.
	  request selftest to adsp_factory.
	  receive test result from adsp_factory.

config AK09918_FACTORY
	tristate "factory test for SSC - ak09918"
	default n
	help
	  ak09918 factory driver.
	  provide sysfs for factory test.
	  request selftest to adsp_factory.
	  receive test result from adsp_factory.

config SUPPORT_MAG_ABS_SUM
	tristate "mag abs sum for SSC"
	depends on AK09918_FACTORY
	default n
	help
	  Support the mag abs sum check
	  check the mag abs sum value.

config LPS22HH_FACTORY
	tristate "factory test for SSC - lps22hh"
	default n
	help
	  lps22hh factory driver.
	  provide sysfs for factory test.
	  request selftest to adsp_factory.
	  receive test result from adsp_factory.

config TMD490X_FACTORY
	tristate "factory test for SSC - tmd490x"
	default n
	help
	  tmd490x factory driver.
	  provide sysfs for factory test.
	  request selftest to adsp_factory.
	  receive test result from adsp_factory.

config SUPPORT_TMD4906_FACTORY
	tristate "factory test for SSC - tmd4906"
	depends on TMD490X_FACTORY
	default n
	help
	  tmd4906 factory driver
	  provide sysfs for factory test.
	  request selftest to adsp_factory.
	  receive test result from adsp_factory.

config SUPPORT_TMD4907_FACTORY
	tristate "factory test for SSC - tmd4907"
	depends on TMD490X_FACTORY
	default n
	help
	  tmd4907 factory driver
	  provide sysfs for factory test.
	  request selftest to adsp_factory.
	  receive test result from adsp_factory.

config SUPPORT_AMS_LIGHT_LCD_VERSION_DUALIZAION
	tristate "ams light lcd version for SSC"
	depends on TMD490X_FACTORY
	default n
	help
	  receive lcd type from lcd sysfs.
	  send lcd rev to light driver.

config SUPPORT_AMS_LIGHT_CALIBRATION
	tristate "ams light cal for SSC"
	depends on TMD490X_FACTORY
	default n
	help
	  AMS light calibration feature.
	  provide sysfs for light calibration.
	  request light cal to adsp_factory.
	  receive cal value from adsp_factory.

config SUPPORT_AMS_PROX_CALIBRATION
	tristate "ams prox cal for SSC"
	depends on TMD490X_FACTORY
	default n
	help
	  AMS prox calibration feature.
	  provide sysfs for prox calibration.
	  request prox cal to adsp_factory.
	  receive cal value from adsp_factory.

config TCS3701_FACTORY
	tristate "factory test for SSC - TCS3701"
	default n
	help
	  tcs3701 factory driver.
	  provide sysfs for factory test.
	  request selftest to adsp_factory.
	  receive test result from adsp_factory.

config STK3331_FACTORY
	tristate "factory test for SSC - STK3331"
	default n
	help
	  stk3331 factory driver.
	  provide sysfs for factory test.
	  request selftest to adsp_factory.
	  receive test result from adsp_factory.

config SUPPORT_STK33610_FACTORY
	tristate "factory test for SSC - STK33610"
	default n
	help
	  stk33610 factory driver.
	  provide sysfs for factory test.
	  request selftest through factory daemon to slpi.
	  receive test result through factory daemon from slpi.

config SUPPORT_PROX_AUTO_CAL
	tristate "Support Auto Calibration for proximity sensor - tmd490x"
	default n
	depends on TMD490X_FACTORY
	help
	  Support the Auto Calibration function in tmd490x.
	  provide sysfs for factory test.
	  request selftest to adsp_factory.
	  receive test result from adsp_factory.

config SUPPORT_PROX_INIT_CAL
	tristate "Support Init Calibration for proximity sensor - tmd490x"
	default n
	depends on TMD490X_FACTORY
	help
	  Support the Init Calibration function in tmd490x.
	  provide sysfs for factory test.
	  request selftest to adsp_factory.
	  receive test result from adsp_factory.

config SUPPORT_HIDDEN_HOLE
	tristate "Support Hidden Hole function for proximity sensor"
	default n
	depends on ADSP_FACTORY
	help
	  Support the Hidden Hole function.
	  provide sysfs for factory test.
	  request selftest to adsp_factory.
	  receive test result from adsp_factory.

config SUPPORT_HIDDEN_HOLE_SUB
	tristate "Support Hidden Hole Sub function for proximity sensor"
	default n
	depends on ADSP_FACTORY
	help
	  Support the Hidden Hole Sub function.
	  provide sysfs for factory test.
	  request selftest to adsp_factory.
	  receive test result from adsp_factory.

config SLPI_MOTOR
	tristate "Sensors support motor"
	default n
	help
	  Support the motor state function
	  provide sysfs for factory test.
	  request selftest to adsp_factory.
	  receive test result from adsp_factory.

config SUPPORT_MOTOR_NOTIFIER
	tristate "Sensors support motor notifier"
	depends on SLPI_MOTOR
	default n
	help
	  Support the motor notifier function
	  receive motor start setting.

config SUPPORT_MOBEAM
	tristate "Sensors support mobeam"
	default n
	help
	  Support the mobeam
	  provide sysfs for factory test.
	  request selftest to adsp_factory.
	  receive test result from adsp_factory.

config SUPPORT_SUB_MOBEAM
	tristate "Sensors support sub mobeam"
	depends on SUPPORT_MOBEAM
	help
	  Support the sub mobeam
	  provide sysfs for factory test.
	  request selftest to adsp_factory.
	  receive test result from adsp_factory.

config SUPPORT_PROX_POWER_ON_CAL
	tristate "Sensors support proximity sensor power on cal"
	default n
	help
	  Support power on calibration for proximity sensor
	  make calibration process done as the device power up.

config SUPPORT_BRIGHTNESS_NOTIFY_FOR_LIGHT_SENSOR
	tristate "Sensors support brightness notify"
	default n
	help
	  Support brightness notify for light sensor.
	  receive aor and brightness level from lcd driver.

config SUPPORT_DDI_COPR_FOR_LIGHT_SENSOR
	tristate "Sensors support ddi copr"
	default n
	help
	  Support ddi copr for light sensor.
	  provide copr sysfs for factory and afc service.
	  DDI must be connected with sensor core

config SUPPORT_DUAL_DDI_COPR_FOR_LIGHT_SENSOR
	tristate "Sensors support dual ddi copr"
	default n
	help
	  Support dual ddi copr for light sensor.
	  provide copr sysfs for factory and afc service.
	  DDI must be connected with sensor core

config SUPPORT_UNDER_PANEL_WITH_LIGHT_SENSOR
	tristate "Sensors support under panel with light sensor"
	default n
	help
	  Support under panel with light sensor.
	  provide sysfs for lux compensation.

config SUPPORT_BRIGHT_COMPENSATION_LUX
	tristate "Sensors support lux compensation based on brightness"
	default n
	help
	  Support lux compensation based on brightness
	  provide sysfs for LCD service.
	  receive aor and brightness level from lcd driver.

config SUPPORT_DUAL_6AXIS
	tristate "Sensors support dual 6axis"
	default n
	help
	  Support the dual accel and gyro function. 
	  provide sysfs for factory test.
	  request selftest to adsp_factory.
	  receive test result from adsp_factory.

config SUPPORT_DUAL_OPTIC
	tristate "Sensors support dual optic"
	default n
	help
	  Support the dual prox and light function. 
	  provide sysfs for factory test.
	  request selftest to adsp_factory.
	  receive test result from adsp_factory.

config SUPPORT_VIRTUAL_OPTIC
	tristate "Sensors support virtual optic"
	default n
	help
	  Support the virtual prox and light function. 
	  provide sysfs for factory test.
	  request selftest to adsp_factory.
	  receive test result from adsp_factory.

config SUPPORT_AK0997X
	tristate "Support ak0997x"
	default n
	help
	  Support ak0997x.

config SUPPORT_DEVICE_MODE
	tristate "Support device mode"
	default n
	help
	  Support device mode.

config VEML3328_FACTORY
	tristate "factory test for SSC - veml3328"
	default n
	help
	  veml3328 factory driver.
	  provide sysfs for factory test.
	  request selftest to adsp_factory.
	  receive test result from adsp_factory.
	  
config VEML3328_SUB_FACTORY
	tristate "factory test for SSC - veml3328_sub"
	default n
	help
	  veml3328_sub factory driver.
	  provide sysfs for factory test.
	  request selftest to adsp_factory.
	  receive test result from adsp_factory.

config VEML3235_FACTORY
	tristate "factory test for SSC - veml3235"
	default n
	help
	  veml3328 factory driver.
	  provide sysfs for factory test.
	  request selftest to adsp_factory.
	  receive test result from adsp_factory.
	  
config VEML3235_SUB_FACTORY
	tristate "factory test for SSC - veml3235_sub"
	default n
	help
	  veml3328_sub factory driver.
	  provide sysfs for factory test.
	  request selftest to adsp_factory.
	  receive test result from adsp_factory.

config SUPPORT_TMD4907_STK33610_FACTORY
	tristate "factory test for SSC - tmd4907 and stk31610"
	select SUPPORT_AMS_LIGHT_CALIBRATION
	select SUPPORT_AMS_PROX_CALIBRATION
	select SUPPORT_PROX_AUTO_CAL
	select SUPPORT_PROX_INIT_CAL
	default n
	help
	  tmd4907 and stk31610 factory driver
	  provide sysfs for factory test.
	  request selftest to adsp_factory.
	  receive test result from adsp_factory.

config SUPPORT_LIGHT_MAIN2_SENSOR
	tristate "Sensors support light main2"
	depends on SUPPORT_TMD4907_STK33610_FACTORY
	default n
	help
	  Support light sensor main2.
	  provide sysfs for factory test.
	  receive test result from adsp_factory.

config SUPPORT_SSC_AOD_RECT
	tristate "Support getting AOD rect"
	default n
	help
	  Support getting AOD rec.

config SUPPORT_LIGHT_DUALIZATION
	tristate "Support dual light sensors"
	default n
	help
	  Select y to support light sensor dualization.
	  Select n not to support light sensor dualization
```
