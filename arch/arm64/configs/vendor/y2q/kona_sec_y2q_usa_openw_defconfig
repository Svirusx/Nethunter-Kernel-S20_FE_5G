## drivers/fingerprint/Kconfig
```kconfig
#
# Sensor  drivers configuration
#
menuconfig SENSORS_FINGERPRINT
	bool "Finger Print Sensor devices"
	help
	  Say Y here, and a list of sensors drivers will be displayed.
	  Everything that didn't fit into the other categories is here. This option
	  doesn't affect the kernel.

if SENSORS_FINGERPRINT

config SENSORS_ET7XX
	tristate "ET7XX fingerprint sensor support"
	default n
	help
	  If you say yes here you get support for Egistec's
	  fingerprint sensor ET7XX.

config SENSORS_ET5XX
	tristate "ET5XX fingerprint sensor support"
	default n
	help
	  If you say yes here you get support for Egistec's
	  fingerprint sensor ET5XX.

config SENSORS_QBT2000
	tristate "QBT2000 fingerprint sensor support"
	default n
	help
	  If you say yes here you get support for Qualcomm's
	  fingerprint sensor QBT2000.

config SENSORS_GW3X
	tristate "generic goodix fingerprint driver"
	default n
	help
	  If you say yes here you get support for Goodix's
	  fingerprint sensor GW36X.

config SENSORS_GW9558X
	tristate "generic goodix fingerprint driver"
	default n
	help
	  If you say yes here you get support for Goodix's
	  fingerprint sensor GW9558X.

endif # SENSORS_FINGERPRINT
```

## drivers/gps/Kconfig
```kconfig
config GPS_BCMxxxxx
    tristate "Common Broadcom GNSS chipset support"
	default n
	help
	  Say yes here to support for Broadcom GNSS chipset.

config GPS_BCM4752
    tristate "GPS_BCM4752 Broadcom GNSS chipset support"
	default n
	help
	  Say yes here to support for Broadcom GPS_BCM4752 chipset.

config GPS_BCM47521
    tristate "GPS_BCM47521 Broadcom GNSS chipset support"
	default n
        help
	  Say yes here to support for Broadcom GPS_BCM47521 chipset.

config GPS_BCM4753
    tristate "GPS_BCM4753 Broadcom GNSS chipset support"
	default n
        help
	  Say yes here to support for Broadcom GPS_BCM4753 chipset.

config GPS_BCM47531
    tristate "GPS_BCM47531 Broadcom GNSS chipset support"
	default n
        help
	  Say yes here to support for Broadcom GPS_BCM47531 chipset.

config GPS_BCM4773
    tristate "GPS_BCM4773 Broadcom GNSS chipset support"
	default n
        help
	  Say yes here to support for Broadcom GPS_BCM4773 chipset.
```

## drivers/input/keyboard/stm/stm32l0/Kconfig
```kconfig
#
# STM32 Keyboard driver configuration
#

config KEYBOARD_STM32_POGO
        tristate "STM32 Keyboard driver"
        depends on I2C
        select INPUT_MATRIXKMAP
        help
          Say Y here if you want support for STM32 keyboard controllers.
          If unsure, say N.
```

## drivers/input/sec_input/Kconfig
```kconfig
#
# SEC Input device configuration
#

config INPUT_SEC_INPUT
	tristate "Support for SEC input layer"
	default y

config SEC_DEBUG_TSP_LOG
	tristate "Support for tsp_msg"
	default n

config INPUT_TOUCHSCREEN_TCLMV2
	bool "touchscreen tclmv2"
	depends on I2C
	help
	  Say Y here if you need to use tclm.

	  If unsure, say N.

config INPUT_SEC_SECURE_TOUCH
	bool "input sec secure touch"
	depends on INPUT
	help
	  Say Y here if you need to use sec secure touch.

	  If unsure, say N.

config TOUCHSCREEN_DUMP_MODE
	bool "touchscreen dump mode"
	depends on I2C
	help
	  Say Y here if you need to get raw data.
	  
	  If unsure, say N.

source "drivers/input/sec_input/slsi/Kconfig"
```

## drivers/input/sec_input/slsi/Kconfig
```kconfig
#
# SLSI TOUCH driver configuration
#

config TOUCHSCREEN_SLSI_Y79A
        tristate "SLSI Touchscreen"
        depends on I2C
        help
          Say Y here if you want support for SLSI touchscreen controllers.
          If unsure, say N.

          To compile this driver as a module, choose M here: the
          module will be called sec_ts.

config TOUCHSCREEN_SEC_TS_GLOVEMODE
        tristate "Samsung Electronics Touchscreen"
        depends on I2C
        help
          Say Y here if you have a Samsung Electronics Touchscreen and want to enable
          support for the built-in touchscreen.

          If unsure, say N.
```

## drivers/input/touchscreen/novatek/nt36523/Kconfig
```kconfig
#
# Novatek NT36xxx touchscreen driver configuration
#
config TOUCHSCREEN_NOVATEK_NT36523
	bool "Novatek NT36523"
	depends on I2C
	help
	  Say Y here if you have a Novatek NT36523 touchscreen connected
	  to your system.

	  If unsure, say N.
```

## drivers/input/touchscreen/zinitix/zt7650/Kconfig
```kconfig
#
# Zinitix Touchscreen driver configuration
#

config TOUCHSCREEN_ZINITIX_ZT7650
	bool "ZINITIX ZT7650 touchscreen driver"
	depends on I2C
	default n
	help
	  Say Y here if you have a ZINITIX ZT7650 touchscreen.
	  If unsure, say N.
```

## drivers/input/touchscreen/zinitix/ztw522/Kconfig
```kconfig
#
# Zinitix Touchscreen driver configuration
#

config TOUCHSCREEN_ZINITIX_ZTW522
	bool "ZINITIX ZTW522 touchscreen driver"
	depends on I2C
	default n
	help
	  Say Y here if you have a ZINITIX ZTW522 touchscreen.
	  If unsure, say N.
```

## drivers/kunit/Kconfig
```kconfig
#
# KUnit base configuration
#

menu "KUnit support"

config KUNIT
	bool "Enable support for unit tests (KUnit)"
	select HAS_IOMEM
	help
	  Enables support for kernel unit tests (KUnit), a lightweight unit
	  testing and mocking framework for the Linux kernel. These tests are
	  able to be run locally on a developer's workstation without a VM or
	  special hardware. For more information, please see Documentation/test/

if KUNIT

config KUNIT_TEST
	bool "KUnit test for KUnit"
	depends on KUNIT
	default n
	help
	  Enables KUnit test to test KUnit.

config KUNIT_DEATH_TEST
	bool "(Expert) KUnit death test for KUnit"
	depends on KUNIT
	default n
	help
	  Enables KUnit test to test KUnit death test feature. This test is not
	  hermetic and can cause other tests to misbehave.

config KUNIT_EXAMPLE_TEST
	bool "Example test for KUnit"
	depends on KUNIT
	default n
	help
	  Enables example KUnit test to demo features of KUnit.

config KUNIT_MANAGER
	bool "Manager for KUnit"
	depends on KUNIT
	default y
	help
	  Enables KUnit Manager.

endif # KUNIT

endmenu
```

## drivers/motor/Kconfig
```kconfig
#
# Motor devices configuration
#

comment "Motor configs"

config SS_VIBRATOR
	tristate "SS_VIBRATOR"
	default n
	help
	  Say Y to enable SAMSUNG VIBRATOR support
	  SS Vibrator
	  You will get supprot for that.

	  If unsure, say N.

config BOOST_POWER_SHARE
	bool "Boost Power Share"
	default n
	help
	  Say Y to enable Boost Power(5V) share.

config MOTOR_DRV_MAX77705
	tristate "Maxim MAX77705 motor"
	default n
	depends on MFD_MAX77705
	help
	  If you say yes here you will get support for the
	  motor of Maxim MAX77705 PMIC.
	  To enable this driver, MFD_MAX77705 should be enabled and
	  MFD_MAX77705 calls this driver.

config ANDROID_TIMED_OUTPUT
	bool "Timed output class driver"

config MOTOR_DRV_CS40L2X
	tristate "Cirrus CS40L2X motor"
	depends on I2C
	depends on ANDROID_TIMED_OUTPUT
	default n
	help
	  Say Y to enable MOTOR_CS40L2X

config MOTOR_DRV_CS40L2X_PMIC_RESET
	tristate "Cirrus CS40L2X motor using reset pin with PMIC LDO"
	depends on I2C
	depends on MOTOR_DRV_CS40L2X
	default n
	help
	  Say Y to enable MOTOR_DRV_CS40L2X_PMIC_RESET

config CS40L2X_SAMSUNG_FEATURE
	tristate "Cirrus CS40L2X motor and Samsung feature"
	depends on MOTOR_DRV_CS40L2X
	default n
	help
	  Say Y to enable CS40L2X_SAMSUNG_FEATURE

config MSM_VIBRATOR
	tristate "MSM_VIBRATOR"
	default n
	help
	  Say Y to enable MSM_VIBRATOR support

config VIB_NOTIFIER
	bool "VIB notifier support"
	default n
	help
	  If you say yes here you will get support for
	  the VBUS status change notification.

config MOTOR_DRV_ISA1000A
	tristate "ISA1000A motor"
	default n
	help
	  Say Y to enable MOTOR_CS40L2X

config 1030LRA_MOTOR
	tristate "feature to distinguish haptic engine support"
	default n
	depends on MOTOR_DRV_CS40L2X
	help
	 Say Y to include support for haptic engine node
	 in cs40l2x driver.
	 If you use 1030LRA motor, this can't support multi frequency
	 so you should enable this.
```

## drivers/muic/Kconfig
```kconfig
#
# MUIC devices
#

comment "MUIC configs"

config USE_MUIC
	bool "Using MUIC device driver"
	default n
	help
	  If you say yes here you will get support for
	  the MUIC device driver.

config USE_SAFEOUT
	bool "Using SAFEOUT device driver"
	default n
	help
	  If you say yes here you will get support for
	  the SAFEOUT device driver.

config MUIC_NOTIFIER
	bool "MUIC notifier support"
	depends on USE_MUIC
	default n
	help
	  If you say yes here you will get support for
	  the MUIC attached device status change notification.

config USE_SECOND_MUIC
	bool "SECOND MUIC support"
	depends on USE_MUIC
	default n
	help
	   If you say yes here you will get support for 
	   the USE SECOND MUIC device driver.

config MUIC_MAX77833
        bool "Using MAX77833 MUIC"
        depends on MFD_MAX77833 && USE_MUIC
        default n
        help
          If you say yes here you will get support for 
          for the MAX77833 MUIC chip.

config HV_MUIC_MAX77833_AFC
        bool "Using MAX77833 AFC MUIC"
        depends on MUIC_MAX77833
        default n
        help
          If you say yes here you will get support for the MAX77833 AFC MUIC.

config MUIC_MAX77833_SHAKEID_WA
        bool "Using MAX77833 MUIC SHAKE ID WA"
        depends on MUIC_MAX77833
        default n
        help
          If you say yes here you will get support for the MAX77833 MUIC SHAKE ID WA.

config MUIC_MAX77833_IGNORE_ADCERR_WA
        bool "Using MAX77833 MUIC ignore ADCERR WA"
        depends on MUIC_MAX77833
        default n
        help
          If you say yes here you will get support for the MAX77833 MUIC RESET WA. 

config MUIC_MAX77833_RESET_WA
        bool "Using MAX77833 MUIC RESET WA"
        depends on MUIC_MAX77833
        default n
        help
          If you say yes here you will get support for the MAX77833 MUIC RESET WA.

config MUIC_MAX77705
        bool "Using MAX77705 MUIC"
        depends on USE_MUIC
        default n
        help
          If you say yes here
	  you will get support
          for the MAX77705
	  MUIC chip.

config HV_MUIC_MAX77705_AFC
        bool "Using MAX77705 AFC MUIC"
        depends on MUIC_MAX77705
        default n
        help
	  If you say yes here
	  you will get support
	  for the MAX77705
	  AFC MUIC.

config MUIC_MAX77888
	bool "Using MAX77888 MUIC"
	depends on MFD_MAX77888 && USE_MUIC
	default n
	help
	  If you say yes here you will get support for
	  for the MAX77888 MUIC chip.

config MUIC_UNIVERSAL
	bool "UNIVERSAL MUIC"
	depends on USE_MUIC
	default n
	help
	  If you say yes here you will get support for various MUIC chips.

config MUIC_UNIVERSAL_MAX77854
	bool "MAX77854 MUIC"
	depends on MUIC_UNIVERSAL
	default n
	help
	  If you say yes here you will get support for the MAX77854 MUIC chip.

config MUIC_HV
	bool "MUIC_HV"
	depends on USE_MUIC
	default n
	help
	  If you say yes here you will get support for the AFC.

config MUIC_HV_12V
	bool "MUIC_HV_12V"
	depends on MUIC_HV
	default n
	help
	  If you say yes here you will get support for the AFC.

config SUPPORT_QC30
	bool "SUPPORT_QC30"
	default n
	help
	  If you say yes here you will get support for the QC3.0 charger.

config MUIC_SUPPORT_CCIC
	bool "MUIC supports CCIC chip interface"
	depends on USE_MUIC
	default n
	help
	  If you say yes here you will get support for the CCIC chip.

config MUIC_MAX77705_CCIC
        bool "Using MAX77705 MUIC supports CCIC chip interface"
        depends on MUIC_MAX77705
        default n
        help
          If you say yes here
	  you will get support
	  for the CCIC chip
	  with MAX77705 MUIC.

config MUIC_SUPPORT_RUSTPROOF
	bool "MUIC Disable UART"
	depends on !SEC_FACTORY
	default n
	help
	 This option will disable the UART to prevent the rusting of the
	 IF Connector in the case of Kmini Devices.

config MUIC_SUPPORT_VZW_ACC
	bool "MUIC supports VZW ACC"
	depends on MUIC_UNIVERSAL
	default n
	help
	 If you say yes here you will get support for the VZW Accessory & Incompatible.

config MUIC_SUPPORT_LANHUB
	bool "MUIC supports LANHUB"
	depends on MUIC_UNIVERSAL
	default n
	help
	 If you say yes here you will get support for the LANHUB.

config MUIC_SUPPORT_EARJACK
	bool "MUIC supports EARJACK"
	depends on MUIC_UNIVERSAL
	default n
	help
	 If you say yes here you will get support for the mUSB Earjack.

config MUIC_HV_FORCE_LIMIT
        bool "Force limit AFC QC MAX CHG VOLTAGE"
        depends on MUIC_UNIVERSAL_MAX77854
        default n
        help
          If you say yes here you will add function of limit afc charging volatage.

config MUIC_UNIVERSAL_SM5703
	bool "SM5703 MUIC"
	depends on USE_MUIC
	default n
	help
	  If you say yes here you will get support for the SM5703 MUIC chip.

config MUIC_UNIVERSAL_SM5720
	bool "SM5720 MUIC"
	depends on USE_MUIC
	default n
	help
	  If you say yes here you will get support for the SM5720 MUIC chip.

config MUIC_UNIVERSAL_SM5720_AFC
	bool "SM5720 MUIC AFC"
	depends on USE_MUIC
	default n
	help
	  If you say yes here you will get support for the SM5720 MUIC

config HICCUP_CHARGER
	bool "Using HICCUP charger"
	depends on USE_MUIC
	default n
	help
		If you say yes here you will get support for
		for the hiccup charger feature.

config MUIC_SM5508
        bool "Using SM5508 MUIC"
        depends on USE_MUIC
        default n
        help
          If you say yes here you will get support for the SM5508 MUIC chip.

config MUIC_SUPPORT_UART_SEL
	bool "MUIC supports uart selection"
	depends on USE_MUIC
	default n
	help
	  If you say yes here you will get support for the uart selection.

config MUIC_SUPPORT_KEYBOARDDOCK
	bool "MUIC supports KEYBOARDDOCK"
	depends on MUIC_UNIVERSAL
	default n
	help
	 If you say yes here you will get support for the pogo KEYBOARD.
```

## drivers/net/ethernet/qualcomm/rmnet/Kconfig
```kconfig
#
# RMNET MAP driver
#

menuconfig RMNET
	tristate "RmNet MAP driver"
	default n
	select GRO_CELLS
	---help---
	  If you select this, you will enable the RMNET module which is used
	  for handling data in the multiplexing and aggregation protocol (MAP)
	  format in the embedded data path. RMNET devices can be attached to
	  any IP mode physical device.

menuconfig RMNET_ARGOS
	tristate "RmNet Argos extension"
	default n
	depends on RMNET
	---help---
	  argos for rmnet driver

source "drivers/net/ethernet/qualcomm/rmnet/shs/Kconfig"
source "drivers/net/ethernet/qualcomm/rmnet/perf/Kconfig"
```

## drivers/net/wireless/broadcom/Kconfig
```kconfig
config BCM_DHD_WLAN
	bool "Broadcom devices"
	default y
	---help---
	  If you have a wireless card belonging to this class, say Y.

	  Note that the answer to this question doesn't directly affect the
	  kernel: saying N will just cause the configurator to skip all the
	  questions about these cards. If you say Y, you will be asked for
	  your specific card in the following questions.

if BCM_DHD_WLAN

source "drivers/net/wireless/broadcom/b43/Kconfig"
source "drivers/net/wireless/broadcom/b43legacy/Kconfig"
source "drivers/net/wireless/broadcom/brcm80211/Kconfig"
source "drivers/net/wireless/broadcom/bcmdhd_101_10/Kconfig"
source "drivers/net/wireless/broadcom/bcmdhd_101_16/Kconfig"

endif # BCM_DHD_WLAN
```

## drivers/net/wireless/realtek/rtl88x2bu/Kconfig
```kconfig
config RTL8822BU
	tristate "Realtek 88X2B USB WiFi"
	depends on USB
	select WIRELESS_EXT
	help
	  Help message of RTL88X2BU
```
