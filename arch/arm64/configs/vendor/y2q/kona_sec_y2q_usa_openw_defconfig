## drivers/battery_v2/Kconfig
```kconfig
config BATTERY_SAMSUNG
	tristate "samsung battery driver"
	help
	 Say Y to include support for samsung battery driver
	 This battery driver integrated all battery-related functions
	 To see battery-related functions,
	 refer to sec_charging_common.h

config BATTERY_SAMSUNG_V2
	tristate "samsung battery driver version 2"
	default n
	depends on BATTERY_SAMSUNG
	help
	 Say Y to include support for samsung battery driver
	 This battery driver integrated all battery-related functions
	 To see battery-related functions,
	 refer to sec_charging_common.h

config BATTERY_SAMSUNG_MHS
	tristate "samsung battery driver for mhs model"
	default n
	depends on BATTERY_SAMSUNG_V2
	help
	 Say Y to include support for samsung battery driver
	 This battery driver integrated all battery-related functions
	 To see battery-related functions,
	 refer to sec_charging_common.h

config BATTERY_SAMSUNG_DATA_FILE
	depends on BATTERY_SAMSUNG
	string "samsung battery data file"
	default "default_battery_data.h"
	help
	 Path to the battery data file.

config SLOW_CHARGING_CURRENT_STANDARD
	int "slow charging"
	depends on BATTERY_SAMSUNG
	default "1000"
	help
	 Value for standard of slow-charging.

config CHARGING_VZWCONCEPT
	tristate "VZW concept about the charging"
	default n
	depends on BATTERY_SAMSUNG
	help
	 Say Y to include support for the VZW concepts.

config BATTERY_SWELLING
	bool "prevent battery swelling"
	help
	 Say Y to include support for prevent battery swelling

config BATTERY_SWELLING_SELF_DISCHARGING
	bool "prevent battery swelling with self discharging"
	help
	 Say Y to include support for prevent battery swelling with self discharging

config CALC_TIME_TO_FULL
	tristate "calculate time to full"
	default n
	depends on BATTERY_SAMSUNG
	help
	 Say Y to use calc time to full function.

config MULTI_CHARGING
	bool "support for multi charger ICs"
	help
	 Say Y to include support for multi charger ICs

config STEP_CHARGING
	bool "support for step charging"
	help
	 Say Y to include support for step charging

config ENABLE_FULL_BY_SOC
	bool "make full by soc 100%"
	help
	default n
	 Say Y to include support to make full by soc 100%

config DIRECT_CHARGING
	bool "support for direct charging"
	help
	 Say Y to include support for direct charging

config UPDATE_BATTERY_DATA
	bool "support for updating battery data"
	default n
	depends on BATTERY_SAMSUNG && OF
	help
	 Say Y to include support for step charging

config AFC_CURR_CONTROL_BY_TEMP
	tristate "fast charging current control by temp"
	default n
	depends on BATTERY_SAMSUNG
	help
	 Say Y to set afc current control by temp

config BATTERY_CISD
	 bool "support for cisd"
	 help
	 Say Y to include support for cisd
	 cisd means cell internal short detection

config WIRELESS_AUTH
	 bool "support for samsung wireless authentication massage"
	 help
	 Say Y to include support for swam
	 samsung wireless authentication massage 

# Fuel Gauge
config FUELGAUGE_RT5033
	tristate "RT5033 fuel gauge driver"
	depends on BATTERY_SAMSUNG
	help
	 Say Y to include support
	 for Richtek RT5033 fuel gauge driver.
	 This driver source code implemented
	 all functions for RT5033 fuel gauge.

config FUELGAUGE_SM5703
	tristate "SM5703 fuel gauge driver"
	depends on BATTERY_SAMSUNG
	help
	 Say Y to include support
	 for SiliconMitus SM5703 fuel gauge driver.
	 This driver source code implemented
	 all functions for SM5703 fuel gauge.

config FUELGAUGE_SM5720
	tristate "SM5720 fuel gauge driver"
	depends on BATTERY_SAMSUNG
	help
	 Say Y to include support
	 for SiliconMitus SM5720 fuel gauge driver.
	 This driver source code implemented
	 all functions for SM5720 fuel gauge.

config FUELGAUGE_MAX77705
	tristate "MAX77705 fuel gauge driver"
	default n
	depends on BATTERY_SAMSUNG
	help
	 Say Y to include support
	 for MAXIM MAX77705 fuel gauge driver.
	 This fuel-gauge can be used in coulomb-counting mode.

config CHARGER_MAX77705_OTG_LIMIT
	bool "enable for controlling limitation"
	default n
	depends on CHARGER_MAX77705
	help
	  Say Y to control limitation

config MAX77705_CHECK_B2SOVRC
	bool "enable for check B2SOVRC"
	default n
	depends on CHARGER_MAX77705
	help
	  Say Y to check B2SOVRC

config FUELGAUGE_DUMMY
	tristate "dummy fuel gauge driver"
	default n
	depends on BATTERY_SAMSUNG
	help
	 Say Y to include support
	 for dummy fuel gauge driver.
	 This driver source code implemented
	 skeleton source code for fuel gauge functions.

config FUELGAUGE_STC3117
	tristate "STC3117 fuel gauge driver"
	default n
	depends on BATTERY_SAMSUNG
	help
	 Say Y to include support
	 for STC3117 fuel gauge driver.
	 This driver source code implemented
	 all functions for STC3117 fuel gauge.

config FUELGAUGE_MAX17042
	tristate "MAX17042 fuel gauge driver"
	default n
	depends on BATTERY_SAMSUNG
	help
	 Say Y to include support
	 for MAXIM MAX17042 fuel gauge driver.
	 This fuel-gauge can be used in voltage-tracking mode
	 or coulomb-counting mode.

config FUELGAUGE_MAX17042_VOLTAGE_TRACKING
	tristate "use MAX17042 fuel gauge only as voltage tracking"
	default n
	depends on FUELGAUGE_MAX17042
	help
	 Say Y to use MAX17042 fuel gauge
	 only as voltage tracking.
	 This mode is for target that consumes low current
	 like smart-phone.

config FUELGAUGE_MAX17042_COULOMB_COUNTING
	tristate "use MAX17042 fuel gauge as coulomb counting (including voltage tracking)"
	default n
	depends on FUELGAUGE_MAX17042
	help
	 Say Y to use MAX17042 fuel gauge
	 as coulomb counting (including voltage tracking).
	 This mode is for target that consumes high current
	 like tablet.

config FUELGAUGE_MAX17048
	tristate "MAX17048 fuel gauge driver"
	default n
	depends on BATTERY_SAMSUNG
	help
	 Say Y to include support
	 for MAXIM MAX17048 fuel gauge driver.
	 This fuel-gauge can be used
	 only in voltage-tracking mode.

config FUELGAUGE_MAX17050
	tristate "MAX17050 fuel gauge driver"
	default n
	depends on BATTERY_SAMSUNG
	help
	 Say Y to include support
	 for MAXIM MAX17047 or MAX17050 fuel gauge driver.
	 This fuel-gauge can be used in voltage-tracking mode
	 or coulomb-counting mode.

config FUELGAUGE_MAX17050_VOLTAGE_TRACKING
	tristate "use MAX17050 fuel gauge only as voltage tracking"
	default n
	depends on FUELGAUGE_MAX17050
	help
	 Say Y to use MAX17050 fuel gauge
	 only as voltage tracking.
	 This mode is for target that consumes low current
	 like smart-phone.

config FUELGAUGE_MAX17050_COULOMB_COUNTING
	tristate "use MAX17050 fuel gauge as coulomb counting (including voltage tracking)"
	default n
	depends on FUELGAUGE_MAX17050
	help
	 Say Y to use MAX17050 fuel gauge
	 as coulomb counting (including voltage tracking).
	 This mode is for target that consumes high current
	 like tablet.

config FUELGAUGE_MAX77823
	tristate "MAX77823 fuel gauge driver"
	default n
	depends on BATTERY_SAMSUNG
	help
	 Say Y to include support
	 for MAXIM MAX17047 or MAX17050 fuel gauge driver.
	 This fuel-gauge can be used in voltage-tracking mode
	 or coulomb-counting mode.

config FUELGAUGE_MAX77833
	tristate "MAX77833 fuel gauge driver"
	default n
	depends on BATTERY_SAMSUNG
	help
	 Say Y to include support
	 for MAXIM MAX77833 fuel gauge driver.
	 This fuel-gauge can be used in coulomb-counting mode.

config FUELGAUGE_MAX77854
	tristate "MAX77854 fuel gauge driver"
	default n
	depends on BATTERY_SAMSUNG
	help
	 Say Y to include support
	 for MAXIM MAX77854 fuel gauge driver.
	 This fuel-gauge can be used in coulomb-counting mode.

config FUELGAUGE_MAX77823_VOLTAGE_TRACKING
	tristate "use MAX77823 fuel gauge only as voltage tracking"
	default n
	depends on FUELGAUGE_MAX77823
	help
	 Say Y to use MAX17050 fuel gauge
	 only as voltage tracking.
	 This mode is for target that consumes low current
	 like smart-phone.

config FUELGAUGE_MAX77823_COULOMB_COUNTING
	tristate "use MAX77823 fuel gauge as coulomb counting (including voltage tracking)"
	default n
	depends on FUELGAUGE_MAX77823
	help
	 Say Y to use MAX77823 fuel gauge
	 as coulomb counting (including voltage tracking).
	 This mode is for target that consumes high current
	 like tablet.

config FUELGAUGE_MAX77843
	tristate "MAX77843 fuel gauge driver"
	default n
	depends on BATTERY_SAMSUNG
	help
	 Say Y to include support
	 It is based on the MAX17050 fuel gauge driver.
	 This fuel-gauge can be used in voltage-tracking mode
	 or coulomb-counting mode.

config FUELGAUGE_MAX77843_COULOMB_COUNTING
	tristate "use MAX77843 fuel gauge as coulomb counting (including voltage tracking)"
	default n
	depends on FUELGAUGE_MAX77843
	help
	 Say Y to use MAX77843 fuel gauge
	 as coulomb counting (including voltage tracking).
	 This mode is for target that consumes high current
	 like tablet.

config FUELGAUGE_MAX77849
	tristate "MAX77849 fuel gauge driver"
	default n
	depends on BATTERY_SAMSUNG
	help
	 Say Y to include support
	 It is based on the MAX17050 fuel gauge driver.
	 This fuel-gauge can be used in voltage-tracking mode
	 or coulomb-counting mode.

config FUELGAUGE_MAX77849_VOLTAGE_TRACKING
	tristate "use MAX77849 fuel gauge only as voltage tracking"
	default n
	depends on FUELGAUGE_MAX77849
	help
	 Say Y to use MAX77849 fuel gauge
	 only as voltage tracking.
	 This mode is for target that consumes low current
	 like smart-phone.

config FUELGAUGE_MAX77849_COULOMB_COUNTING
	tristate "use MAX77849 fuel gauge as coulomb counting (including voltage tracking)"
	default n
	depends on FUELGAUGE_MAX77849
	help
	 Say Y to use MAX77849 fuel gauge
	 as coulomb counting (including voltage tracking).
	 This mode is for target that consumes high current
	 like tablet.

config FUELGAUGE_S2MU003
	tristate "S2MU003 fuel gauge driver"
	default n
	depends on BATTERY_SAMSUNG
	help
	 Say Y to include support
	 for S.LSI S2MU003 fuel gauge driver.

config PREVENT_SOC_JUMP
	tristate "prevent soc jump at full-charged"
	default n
	depends on BATTERY_SAMSUNG
	help
		Say Y to prevent soc jump
config FUELGAUGE_SM5705
	tristate "Siliconmitus SM5705 Fuel Gauge"
	default n
	depends on I2C
	help
	  SM5705 is fuel-gauge systems for lithium-ion (Li+) batteries
	  in handheld and portable equipment. The SM5705 is configured
	  to operate with a single lithium cell

# Charger

config CHARGER_DUMMY
	tristate "dummy charger driver"
	default n
	depends on BATTERY_SAMSUNG
	help
	 Say Y to include support
	 for dummy charger driver.
	 This driver source code implemented
	 skeleton source code for charger functions.

config CHARGER_MAX8903
	tristate "MAX8903 charger driver"
	default n
	depends on BATTERY_SAMSUNG
	help
	 Say Y to include support
	 for MAXIM MAX8903 charger driver.
	 This driver source code implemented
	 all functions for MAX8903 charger.

config CHARGER_SMB328
	tristate "SMB328 charger driver"
	default n
	depends on BATTERY_SAMSUNG
	help
	 Say Y to include support
	 for Summit SMB328 charger driver.
	 This driver source code implemented
	 all functions for SMB328 charger.

config CHARGER_SMB347
	tristate "SMB347 charger driver"
	default n
	depends on BATTERY_SAMSUNG
	help
	 Say Y to include support
	 for Summit SMB347 charger driver.
	 This driver source code implemented
	 all functions for SMB347 charger.

config CHARGER_SMB358
	tristate "SMB358 charger driver"
	default n
	depends on BATTERY_SAMSUNG
	help
	 Say Y to include support
	 for Summit SMB358 charger driver.
	 This driver source code implemented
	 all functions for SMB358 charger.

config CHARGER_BQ24157
	tristate "BQ24157 charger driver"
	default n
	depends on BATTERY_SAMSUNG
	help
	 Say Y to include support
	 for TI BQ24157 charger driver.
	 This driver source code implemented
	 all functions for BQ24157 charger.

config CHARGER_BQ24190
	tristate "BQ24190 charger driver"
	default n
	depends on BATTERY_SAMSUNG
	help
	 Say Y to include support
	 for TI BQ24190 charger driver.
	 This driver source code implemented
	 all functions for BQ24190 charger.

config CHARGER_BQ24191
	tristate "BQ24191 charger driver"
	default n
	depends on BATTERY_SAMSUNG
	help
	 Say Y to include support
	 for TI BQ24191 charger driver.
	 This driver source code implemented
	 all functions for BQ24191 charger.

config CHARGER_BQ24260
	tristate "BQ24260 charger driver"
	default n
	depends on BATTERY_SAMSUNG
	help
	 Say Y to include support
	 for TI BQ24260 charger driver.
	 This driver source code implemented
	 all functions for BQ24260 charger.

config CHARGER_BQ25898S
	tristate "BQ25898S charger driver"
	default n
	depends on BATTERY_SAMSUNG
	help
	 Say Y to include support
	 for TI BQ25898S charger driver.
	 This driver source code implemented
	 all functions for BQ25898S charger.

config CHARGER_SM5701
	tristate "SM5701 charger driver"
	depends on MFD_SM5701 && I2C
	default n
	help
	 Say Y to include support
	 for SiliconMitus SM5701 charger driver..

config CHARGER_MAX77693
	tristate "MAX77693 battery charger support"
	depends on MFD_MAX77693 && I2C
	help
	  Say Y here to enable support for the MAX77693 charger
	  MAX77693 incluse muic, pmic, haptic, led,
	  flash driver.
	  You have to define MFD_MAX77693

config CHARGER_MAX77823
	tristate "MAX77823 battery charger support"
	depends on BATTERY_SAMSUNG
	help
	 Say Y here to enable support for the MAX77823 charger

config CHARGER_MAX77833
	tristate "MAX77833 battery charger support"
	depends on BATTERY_SAMSUNG
	help
	  Say Y here to enable support for the MAX77833 charger

config CHARGER_MAX77803
	tristate "MAX77803 battery charger support"
	depends on MFD_MAX77803 && I2C
	help
	  Say Y here to enable support for the MAX77803 charger
	  MAX77803 incluse muic, pmic, haptic, led,
	  flash driver.
	  You have to define MFD_MAX77803

config CHARGER_MAX77804K
	tristate "MAX77804K battery charger support"
	depends on MFD_MAX77804K && I2C
	help
	  Say Y here to enable support for the MAX77804K charger
	  MAX77804K incluse muic, pmic, haptic, led,
	  flash driver.
	  You have to define MFD_MAX77804K

config CHARGER_MAX77843
        tristate "MAX77843 battery charger support"
        depends on MFD_MAX77843 && I2C
        help
          Say Y here to enable support for the MAX77843 charger
          MAX77843 incluse muic, pmic, haptic, led,
          flash driver.
          You have to define MFD_MAX77843

config CHARGER_MAX77849
        tristate "MAX77849 battery charger support"
        depends on MFD_MAX77849 && I2C
        help
          Say Y here to enable support for the MAX77849 charger
          MAX77849 incluse muic, pmic, haptic, led,
          flash driver.
          You have to define MFD_MAX77849

config CHARGER_MAX77854
        tristate "MAX77854 battery charger support"
        depends on MFD_MAX77854 && I2C
        help
          Say Y here to enable support for the MAX77854 charger
          MAX77854 incluse muic, pmic, haptic, led,
          flash driver.
          You have to define MFD_MAX77854

config CHARGER_MAX77888
        tristate "MAX77888 battery charger support"
        depends on MFD_MAX77888 && I2C
        help
          Say Y here to enable support for the MAX77888 charger
          MAX77888 incluse muic, pmic, haptic, led,
          flash driver.
          You have to define MFD_MAX77888

config CHARGER_S2MU003
	tristate "S2MU003 charger support"
	depends on (MFD_S2MU003) && I2C
	help
	  Say Y here to enable support for the S2MU003 charger
	  S2MU003 incluse pmic, led driver.
	  You have to define MFD_S2MU003

config CHARGER_RT5033
	tristate "RT5033 charger driver"
	default n
	help
	 Say Y to include support
	 for RT5033 charger driver.
	 This driver source code implemented
	 all functions for RT5033 charger.

config CHARGER_SM5418
	tristate "SM5418 charger driver"
	default n
	help
	 Say Y to include support
	 for SM5418 charger driver.
	 This driver source code implemented
	 all functions for SMB5418 charger.

config CHARGER_SM5703
	tristate "SM5703 charger driver"
	default n
	help
	 Say Y to include support
	 for SM5703 charger driver.
	 This driver source code implemented
	 all functions for SM5703 charger.

config CHARGER_SM5720
        tristate "SM5720 battery charger support"
        depends on MFD_SM5720 && I2C
        help
          Say Y here to enable support for the SM5720 charger
          You have to define MFD_SM5720

config CHARGER_MAX77705
	tristate "MAX77705 battery charger support"
	depends on BATTERY_SAMSUNG
	help
	  Say Y here to enable support for the MAX77705 charger

config CHARGER_DA9155
	tristate "DA9155 charger driver"
	default n
	help
	 Say Y here to support for the da9155 charger
	 The DA9155 is a slave charger that extends
	 the current capability of an existing charging solution.

config CHARGER_SMB1351
        tristate "SMB1351 charger driver"
        default n
        help
         Say Y here to support for the smb1351 charger
         The SMB1351 is a slave charger that extends
         the current capability of an existing charging solution.

config CHARGER_PCA9468
	tristate "PCA9468 charger driver"
	default n
	depends on DIRECT_CHARGING
	help
	  Say Y here to enable support for the PCA9468 charger

config WIRELESS_CHARGER_HIGH_VOLTAGE
	tristate "high voltage wireless charger"
	depends on BATTERY_SAMSUNG && I2C
	help
	  Say Y here to enable support for the wireless charger charger
	  driver.

config PD_CHARGER_HV_DISABLE
	tristate "high voltage pd charger"
	depends on BATTERY_SAMSUNG && I2C
	help
	  Say Y here to enable support for the wireless charger charger
	  driver.

config CHARGER_SM5705
	tristate "SM5705 battery charger support"
	depends on BATTERY_SAMSUNG
	help
	  Say Y here to enable support for the SM5705 charger

config WIRELESS_NO_HV
	tristate "wireless no hv"
	depends on BATTERY_SAMSUNG && I2C
	help
	  Say Y here to disable HV wireless charging
	  driver.

config CS100_JPNCONCEPT
	tristate "cs100 command support"
	depends on BATTERY_SAMSUNG && I2C
	help
	 Say Y here to support for CS100 command to stop when full-charged
	 on wireless charging for JPN models

config WIRELESS_CHARGER_BQ51221
	tristate "bq51221 battery charger support"
	depends on BATTERY_SAMSUNG && I2C
	help
	 Say Y here to enable support for the bq51221 charger
	 bq51221 wireless charger driver.
config WIRELESS_CHARGER_P9220
	tristate "p9220 battery charger support"
	depends on BATTERY_SAMSUNG && I2C
	help
	  Say Y here to enable support for the p9220 charger
	  p9220 wireless charger driver.

config WIRELESS_CHARGER_S2MIW03
	tristate "s2miw03 wireless battery charger support"
	depends on BATTERY_SAMSUNG && I2C
	help
	  Say Y here to enable support for the S2MIW03 charger
	  S2MIW03 wireless charger driver.

config WIRELESS_CHARGER_MFC_S2MIW04
	tristate "s2miw04 wireless battery charger support"
	depends on BATTERY_SAMSUNG && I2C && !SEC_FACTORY_INTERPOSER
	help
	  Say Y here to enable support for the S2MIW04 charger
	  S2MIW04 wireless charger driver.

config WIRELESS_CHARGER_MFC
	tristate "MFC IC charger support"
	depends on BATTERY_SAMSUNG && I2C
	help
	  Say Y here to enable support for the MFC IC
	  MFC wireless charger driver.

config WIRELESS_CHARGER_HAL_MFC
	tristate "MFC IC charger support"
	depends on BATTERY_SAMSUNG && I2C
	help
	  Say Y here to enable support for the MFC IC
	  MFC wireless charger driver.	  

config WIRELESS_IC_PARAM
	tristate "WIRELESS IC info param support"
	depends on BATTERY_SAMSUNG && I2C
	help
	  Say Y here to enable support for the WIRELESS IC info param

config WIRELESS_FIRMWARE_UPDATE
	tristate "p9220 battery charger support"
	depends on BATTERY_SAMSUNG
	help
	  Say Y here to enable support for the wireless charger firmware update
	  wireless charger IC firmware update.

config AFC_CHARGER_MODE
	bool "afc charging support in sec battery driver"
	default n
	help
	  Say Y to include support for sec afc charging support

config SAMSUNG_LPM_MODE
	bool "Off charging mode support in sec battery driver"
	default n
	help
	  Say Y to include support for sec off charging support
	  This value defined at bootloader.
	  Before enable this feature,
	  implemet power off charging in the bootloader.

config WIRELESS_TX_MODE
	bool "wireless power sharing support in sec battery driver"
	default n
	depends on BATTERY_SAMSUNG
	help
	  Say Y to include support for sec afc charging support

config SAMSUNG_BATTERY_ENG_TEST
	bool "enable ENG mode for battery test"
	default n
	help
	  Say Y to include support for battery test
	  enable this feature only ENG mode
	  this featuren must disabled user binary
	  stability test etc..

config SAMSUNG_BATTERY_FACTORY
	bool "enable for factory test"
	default n
	help
	  Say Y to include support for factory test
	  enable this feature only factory mode
	  this featuren must disabled user binary
	  stability test etc..

config SAMSUNG_BATTERY_DISALLOW_DEEP_SLEEP
	bool "Disallow deep sleep during charging"
	default n
	depends on BATTERY_SAMSUNG && (ARCH_MSM8974 || ARCH_APQ8084)
	help
	  Say Y to include support
	  Disallow deep sleep during charging for stablity.

config DISABLE_SAVE_CAPACITY_MAX
	bool "Disable to save capacity max in efs"
	default n
	depends on BATTERY_SAMSUNG
	help
		Say Y to include support to disable it
		capacity_max is saved in /efs/Battery/batt_capacity_max
		capacity_max is restored after boot up
		You can find the code in healthd

config SIOP_CHARGING_LIMIT_CURRENT
	int "Siop charging limit current"
	default 0
	help
	  set SIOP charging limit current.

config EN_OOPS
	bool "enable oops filter"
	default n
	help
	  Say Y to enable oops filter

config USE_POGO
	bool "enable pogo charging"
	default n
	help
	  Say Y to enable CONFIG_USE_POGO

config MACH_KOR_EARJACK_WR
	bool "enable earjack-noise workaround"
	default n
	depends on BATTERY_SAMSUNG
	help
	  Say Y to enable earjack-noise workaround at charging

config STORE_MODE
	bool "enable store mode"
	default n
	help
	  Say Y to enable CONFIG_STORE_MODE

config SW_SELF_DISCHARGING
	bool "enable sw_self_discharging"
	default n
	help
	  Say Y to enable CONFIG_SW_SELF_DISCHARGING

config BATTERY_AGE_FORECAST
	tristate "battery age forecast"
	default n
	depends on BATTERY_SWELLING
	help
	  Say Y to use calc time to full function.

config ENG_BATTERY_CONCEPT
       bool "enable temp block"
       default n
       help
	 Say Y to enable CONFIG_ENG_BATTERY_CONCEPT

config QH_ALGORITHM
	bool "enable QH algorithm"
	default n
	help
		Say Y to enable CONFIG_QH_ALGORITHM to measure leakges of the battery
		using raw coulomb count generated by the device

config BATTERY_NOTIFIER
	bool "battery notifier"
	default n
	help
	  Say Y to enable battery notifier

config LIMIT_CHARGING_DURING_CALL
	bool "limit charging during call"
	default n
	help
	  Say Y to limit charging during call

config ENABLE_100MA_CHARGING_BEFORE_USB_CONFIGURED
	bool "enable 100mA before usb configured"
	default n
	help
	  Say Y to enable 100mA before usb configured

config TABLET_MODEL_CONCEPT
	bool "tablet model concept"
	default n
	help
	  Say Y to enable tablet model concept

config WIRELESS_FIRMWARE_65
	tristate "p9220 battery charger support"
	depends on BATTERY_SAMSUNG
	help
	  Say Y here to enable support for the wireless charger firmware update
	  wireless charger IC firmware update.

config OTG_OVERCURRENT_BY_CHGIN
	bool "enable otg overcurrent detection by chgin workaround"
	default n
	help
	  Say Y to enable otg overcurrent detection by chgin workaround
	  for charger ICs have otg retrying issues from OVP IC specification

config SWITCHING_S2ASL01
    tristate "S2ASL01 SWITCHING IC support"
    depends on I2C
    help
	  Say Y here to enable support for S2ASL01 switching driver.

config DUAL_BATTERY
    tristate "DUAL BATTERY support"
    depends on I2C
    help
	  Say Y here to enable support for dual battery

config DUAL_BATTERY_CELL_SENSING
    tristate "DUAL BATTERY CELLSENSING support"
    depends on I2C
    help
	  Say Y here to enable support for cell sensing of dual battery

config ISDB_CHARGING_CONTROL
    tristate "ISDB CHARGING CONTROL support"
    depends on I2C
    help
	  Say Y here to enable support for isdb

config PREVENT_USB_CONN_OVERHEAT
    bool "enable prevent usb conn overheat"
    default n
    help
	  Say Y to enable CONFIG_PREVENT_USB_CONN_OVERHEAT

config TX_5V_DISABLE
    bool "disable TX in case of 5V"
    default n
    help
	  Say Y to enable CONFIG_TX_5V_DISABLE
	  Disable tx during 5V wired charging.
	  Tx power efficiency is bad in projects that have small coil.
	  apply this concept since bloom.

config DISABLE_MFC_IC
    bool "disable mfc ic because of unknown pad"
    default n
    help
	  Say Y to enable
	  CONFIG_DISABLE_MFC_IC
	  for unknown pad.
	  disable mfc ic in this case.

config CHECK_UNAUTH_PAD
    bool "check unauthenticated pad"
    default n
    help
	  Say Y to enable CONFIG_CHECK_UNAUTH_PAD
	  do not charge rapidly
	  when put device
	  on the unauthenticated pad.

config TX_GEAR_PHM_VOUT_CTRL
    bool "control vout when gear`s phm"
    default n
    help
	  Say Y to enable CONFIG_TX_GEAR_PHM_VOUT_CTRL
	  Control vout 5v when enter gear`s phm with high voltage wired charging
	  Recover vout when escape gear`s phm
	  This is considered only if high vout with gear.

config SEC_BATTERY_TEST
    bool "KUnit test for sec_battery_test"
    default n
    depends on KUNIT
    help
        Say Y to enable CONFIG_SEC_BATTERY_TEST
        This kunit test code is related to sec_battery.c.
        Test the functions of sec_battery.c
```
