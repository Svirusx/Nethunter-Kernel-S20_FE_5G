/* Copyright (c) 2019, The Linux Foundation. All rights reserved.
 *
 * This program is free software; you can redistribute it and/or modify
 * it under the terms of the GNU General Public License version 2 and
 * only version 2 as published by the Free Software Foundation.
 *
 * This program is distributed in the hope that it will be useful,
 * but WITHOUT ANY WARRANTY; without even the implied warranty of
 * MERCHANTABILITY or FITNESS FOR A PARTICULAR PURPOSE.  See the
 * GNU General Public License for more details.
 */

/dts-v1/;
/plugin/;

/*
 * CAUTION:
 * Do NOT inherit from previous revision of dtsi files
 * since it is only used for bring-up
 */
#include "../common/kona-sec-common.dtsi"
#include "kona-sec-y2q-r02.dtsi"

/ {
	model = "Samsung Y2Q PROJECT - SM8250+SDX55M Rev0.0 (board-id,02)";
	compatible = "qcom,kona-mtp", "qcom,kona", "qcom,mtp";
	qcom,board-id = <8 2>;
	dtbo-version = <0>;
};
