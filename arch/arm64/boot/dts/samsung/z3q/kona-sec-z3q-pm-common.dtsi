/* Copyright (c) 2014, The Linux Foundation. All rights reserved.
 *
 * This program is free software; you can redistribute it and/or modify
 * it under the terms of the GNU General Public License version 2 and
 * only version 2 as published by the Free Software Foundation.
 *
 * This program is distributed in the hope that it will be useful,
 * but WITHOUT ANY WARRANTY; without even the implied warranty of
 * MERCHANTABILITY or FITNESS FOR A PARTICULAR PURPOSE.  See the
 * GNU General Public License for more details.
 */

#include <dt-bindings/regulator/qcom,rpmh-regulator-levels.h>
#include "../y2q/kona-sec-picassoq-pm-common.dtsi"

&soc {
	/* AP Thermistor table */
	sec_thermistor@0 {
		adc_array = <109775 114900 120026 125151 130277 135402 140527 145653 150778 155904
				161029 166479 171929 177378 182828 188278 195986 203693 211401 219108
				226816 235302 243788 252275 260761 269247 279083 288918 298754 308589
				318425 329571 340717 351864 363010 374156 387703 401250 414796 428343
				441890 454139 466388 478637 490886 503135 522690 542244 561799 581353
				600908 618555 636202 653849 671496 689143 709775 730406 751038 771669
				792301 813996 835692 857387 879083 900778 923031 945285 967538 989792
				1012045 1032041 1052037 1072032 1092028 1112024 1136678 1161332 1185986 1210640
				1235294 1255757 1276220 1296682 1317145 1337608 1357046 1376483 1395921 1415358
				1434796
				1451729 1468663 1485596 1502530 1519463 1532945 1546427 1559908 1573390 1586872
				1600782 1614692 1628603 1642513 1656423 1666609 1676795 1686980 1697166 1707352>;

		temp_array = <900 890 880 870 860 850 840 830 820 810
				800 790 780 770 760 750 740 730 720 710
				700 690 680 670 660 650 640 630 620 610
				600 590 580 570 560 550 540 530 520 510
				500 490 480 470 460 450 440 430 420 410
				400 390 380 370 360 350 340 330 320 310
				300 290 280 270 260 250 240 230 220 210
				200 190 180 170 160 150 140 130 120 110
				100 90 80 70 60 50 40 30 20 10
				0
				(-10) (-20) (-30) (-40) (-50) (-60) (-70) (-80) (-90) (-100)
				(-110)(-120)(-130)(-140)(-150)(-160)(-170)(-180)(-190) (-200)>;
	};

	/* CP Thermistor table */
	sec_thermistor@1 {
		adc_array = <114380 119583 124787 129990 135194 140397 145600 150804 156007 161211
				166414 172175 177936 183698 189459 195220 202785 210350 217914 225479
				233044 241569 250094 258620 267145 275670 285635 295601 305566 315532
				325497 336903 348308 359714 371119 382525 396046 409567 423087 436608
				450129 464493 478857 493222 507586 521950 539636 557322 575008 592694
				610380 628287 646193 664100 682006 699913 720441 740968 761496 782023
				802551 824169 845787 867404 889022 910640 932829 955017 977206 999394
				1021583 1042318 1063053 1083789 1104524 1125259 1149186 1173114 1197041 1220969
				1244896 1264788 1284680 1304571 1324463 1344355 1363689 1383023 1402357 1421691
				1441025
				1457829 1474632 1491436 1508239 1525043 1538823 1552603 1566384 1580164 1593944
				1607257 1620570 1633884 1647197 1660510 1670566 1680622 1690679 1700735 1710791>;

		temp_array = <900 890 880 870 860 850 840 830 820 810
				800 790 780 770 760 750 740 730 720 710
				700 690 680 670 660 650 640 630 620 610
				600 590 580 570 560 550 540 530 520 510
				500 490 480 470 460 450 440 430 420 410
				400 390 380 370 360 350 340 330 320 310
				300 290 280 270 260 250 240 230 220 210
				200 190 180 170 160 150 140 130 120 110
				100 90 80 70 60 50 40 30 20 10
				0
				(-10) (-20) (-30) (-40) (-50) (-60) (-70) (-80) (-90) (-100)
				(-110)(-120)(-130)(-140)(-150)(-160)(-170)(-180)(-190) (-200)>;
	};

	/* WiFi Thermistor table */
	sec_thermistor@2 {
		adc_array = <116262 121452 126643 131833 137024 142214 147404 152595 157785 162976
				168166 174161 180156 186150 192145 198140 205393 212647 219900 227154
				234407 242984 251561 260138 268715 277292 287180 297067 306955 316842
				326730 338136 349541 360947 372352 383758 397214 410670 424126 437582
				451038 465830 480623 495415 510208 525000 542245 559490 576734 593979
				611224 629221 647219 665216 683214 701211 721752 742292 762833 783373
				803914 825545 847175 868806 890436 912067 934269 956470 978672 1000873
				1023075 1044135 1065194 1086254 1107313 1128373 1151911 1175449 1198988 1222526
				1246064 1266501 1286938 1307374 1327811 1348248 1367543 1386838 1406133 1425428
				1444723
				1461410 1478097 1494783 1511470 1528157 1542677 1557197 1571716 1586236 1600756
				1613226 1625696 1638165 1650635 1663105 1673109 1683114 1693118 1703123 1713127>;

		temp_array = <900 890 880 870 860 850 840 830 820 810
				800 790 780 770 760 750 740 730 720 710
				700 690 680 670 660 650 640 630 620 610
				600 590 580 570 560 550 540 530 520 510
				500 490 480 470 460 450 440 430 420 410
				400 390 380 370 360 350 340 330 320 310
				300 290 280 270 260 250 240 230 220 210
				200 190 180 170 160 150 140 130 120 110
				100 90 80 70 60 50 40 30 20 10
				0
				(-10) (-20) (-30) (-40) (-50) (-60) (-70) (-80) (-90) (-100)
				(-110)(-120)(-130)(-140)(-150)(-160)(-170)(-180)(-190) (-200)>;
	};
};
