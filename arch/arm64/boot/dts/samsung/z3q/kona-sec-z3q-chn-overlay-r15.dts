/* Copyright (c) 2019, The Linux Foundation. All rights reserved.
 *
 * This program is free software; you can redistribute it and/or modify
 * it under the terms of the GNU General Public License version 2 and
 * only version 2 as published by the Free Software Foundation.
 *
 * This program is distributed in the hope that it will be useful,
 * but WITHOUT ANY WARRANTY; without even the implied warranty of
 * MERCHANTABILITY or FITNESS FOR A PARTICULAR PURPOSE.  See the
 * GNU General Public License for more details.
 */

/dts-v1/;
/plugin/;

#include "../common/kona-sec-common.dtsi"
#include "kona-sec-z3q-r15.dtsi"

#include "../common/kona-sec-laa-chn-jpn.dtsi"

/*
 * FIXME:
 * This file(z3q r15) is to support HM1 EVT1(0xA1) sensor.
 * All the changes regarding to HM1 EVT1 should be described in z3q/kona-sec-z3q-r15.dtsi file.
 */

/ {
	model = "Samsung Z3Q CHN PROJECT - PV4 Rev05 (board-id,15) for HM1 EVT1";
	compatible = "qcom,kona-mtp", "qcom,kona", "qcom,mtp";
	qcom,board-id = <8 15>;
	dtbo-version = <0>;
};
