/* Copyright (c) 2020, The Linux Foundation. All rights reserved.
 *
 * This program is free software; you can redistribute it and/or modify
 * it under the terms of the GNU General Public License version 2 and
 * only version 2 as published by the Free Software Foundation.
 *
 * This program is distributed in the hope that it will be useful,
 * but WITHOUT ANY WARRANTY; without even the implied warranty of
 * MERCHANTABILITY or FITNESS FOR A PARTICULAR PURPOSE.  See the
 * GNU General Public License for more details.
 */

#include "kona-sec-z3q-r14.dtsi"
#include "kona-sec-z3q-pinctrl-r16.dtsi"

/*
 * FIXME: 
 * z3q r15 is to support HM1 EVT1(0xA1) sensor.
 * So this file(z3q r16) overrides r14 dtsi file.
 */

&soc {

};
