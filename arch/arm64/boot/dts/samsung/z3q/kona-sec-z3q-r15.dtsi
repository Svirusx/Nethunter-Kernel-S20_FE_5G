/* Copyright (c) 2019, The Linux Foundation. All rights reserved.
 *
 * This program is free software; you can redistribute it and/or modify
 * it under the terms of the GNU General Public License version 2 and
 * only version 2 as published by the Free Software Foundation.
 *
 * This program is distributed in the hope that it will be useful,
 * but WITHOUT ANY WARRANTY; without even the implied warranty of
 * MERCHANTABILITY or FITNESS FOR A PARTICULAR PURPOSE.  See the
 * GNU General Public License for more details.
 */

#include "kona-sec-z3q-r14.dtsi"
#include "kona-sec-z3q-pinctrl-r14.dtsi"

/*
 * FIXME:
 * This file(z3q r15) is to support HM1 EVT1(0xA1) sensor.
 * do NOT make kona-sec-z3q-pinctrl-r15.dtsi file.
 * All the changes regarding to HM1 EV1 should be described in this file.
 */

&soc {

};

&tlmm {

};
