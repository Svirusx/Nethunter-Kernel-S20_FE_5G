/* Copyright (c) 2020, The Linux Foundation. All rights reserved.
 *
 * This program is free software; you can redistribute it and/or modify
 * it under the terms of the GNU General Public License version 2 and
 * only version 2 as published by the Free Software Foundation.
 *
 * This program is distributed in the hope that it will be useful,
 * but WITHOUT ANY WARRANTY; without even the implied warranty of
 * MERCHANTABILITY or FITNESS FOR A PARTICULAR PURPOSE.  See the
 * GNU General Public License for more details.
 */

#include "kona-sec-r8q-r02.dtsi"
#include "kona-sec-r8q-pinctrl-r03.dtsi"
#include "../drivers/optics_r8q_r03.dtsi"

&soc {

};

&sdhc_2 {
	cd-gpios = <&tlmm 77 GPIO_ACTIVE_HIGH>;

	status = "ok";
};
