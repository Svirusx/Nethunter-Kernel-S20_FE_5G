/* Copyright (c) 2020, The Linux Foundation. All rights reserved.
 *
 * This program is free software; you can redistribute it and/or modify
 * it under the terms of the GNU General Public License version 2 and
 * only version 2 as published by the Free Software Foundation.
 *
 * This program is distributed in the hope that it will be useful,
 * but WITHOUT ANY WARRANTY; without even the implied warranty of
 * MERCHANTABILITY or FITNESS FOR A PARTICULAR PURPOSE.  See the
 * GNU General Public License for more details.
 */

#include "kona-sec-gts7l-r04.dtsi"
#include "kona-sec-gts7l-pinctrl-r05.dtsi"

&soc {
    
};

&qupv3_se17_i2c {
	wacom@56 {
		wacom,bringup = <3>;
	};
};
