/* Copyright (c) 2020, The Linux Foundation. All rights reserved.
 *
 * This program is free software; you can redistribute it and/or modify
 * it under the terms of the GNU General Public License version 2 and
 * only version 2 as published by the Free Software Foundation.
 *
 * This program is distributed in the hope that it will be useful,
 * but WITHOUT ANY WARRANTY; without even the implied warranty of
 * MERCHANTABILITY or FITNESS FOR A PARTICULAR PURPOSE.  See the
 * GNU General Public License for more details.
 */

#include "kona-sec-c1q-r07.dtsi"
#include "kona-sec-c1q-pinctrl-r08.dtsi"
#include "../drivers/input_c1q_r08.dtsi"
#include "../drivers/fingerprint-sensor_c1q_r08.dtsi"

&soc {

};

&s2mpb02_l15 {
	regulator-min-microvolt = <3300000>;
	regulator-max-microvolt = <3300000>;
	regulator-boot-on;
};

/delete-node/ &vdd_spen_3p3;
/delete-node/ &epen_ldo_en;
&wacom {
	pinctrl-0 = <&epen_int_active &epen_pdct_active>;
	wacom,regulator_avdd = "s2mpb02-ldo15";
};
