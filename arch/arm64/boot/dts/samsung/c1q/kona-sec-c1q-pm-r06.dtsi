/* Copyright (c) 2014, The Linux Foundation. All rights reserved.
 *
 * This program is free software; you can redistribute it and/or modify
 * it under the terms of the GNU General Public License version 2 and
 * only version 2 as published by the Free Software Foundation.
 *
 * This program is distributed in the hope that it will be useful,
 * but WITHOUT ANY WARRANTY; without even the implied warranty of
 * MERCHANTABILITY or FITNESS FOR A PARTICULAR PURPOSE.  See the
 * GNU General Public License for more details.
 */

#include <dt-bindings/regulator/qcom,rpmh-regulator-levels.h>

/* remove display pmic(s2dos05/sm3080) */
/delete-node/ &i2c21;

&tlmm {
	/delete-node/ s2dos05_i2c_sda;
	/delete-node/ s2dos05_i2c_scl;
	/delete-node/ s2dos05_irq;
};

&qupv3_se10_i2c {
	status = "disabled";
};
