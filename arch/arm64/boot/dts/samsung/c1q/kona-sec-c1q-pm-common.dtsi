/* Copyright (c) 2014, The Linux Foundation. All rights reserved.
 *
 * This program is free software; you can redistribute it and/or modify
 * it under the terms of the GNU General Public License version 2 and
 * only version 2 as published by the Free Software Foundation.
 *
 * This program is distributed in the hope that it will be useful,
 * but WITHOUT ANY WARRANTY; without even the implied warranty of
 * MERCHANTABILITY or FITNESS FOR A PARTICULAR PURPOSE.  See the
 * GNU General Public License for more details.
 */

#include "../c2q/kona-sec-c2q-pm-common.dtsi"
#include "../c2q/kona-sec-c2q-pm-r01.dtsi"

&soc {
	/* AP Thermistor table */
	sec_thermistor@0 {
		adc_array = <112792 117100 121408 125715 130023 134331 139963 145594 151226 156857
				162489 168464 174440 180415 186391 192366 198458 204550 210642 216734
				222826 232143 241459 250776 260092 269409 279167 288925 298682 308440
				318198 329286 340374 351461 362549 373637 386853 400069 413284 426500
				439716 454658 469600 484541 499483 514425 531391 548357 565322 582288
				599254 617718 636183 654647 673112 691576 712019 732463 752906 773350
				793793 811849 829905 847960 866016 884072 909492 934911 960331 985750
				1011170 1033540 1055910 1078281 1100651 1123021 1145644 1168267 1190891 1213514
				1236137 1257132 1278127 1299121 1320116 1341111 1360147 1379182 1398218 1417253
				1436289
				1452943 1469598 1486252 1502907 1519561 1534048 1548536 1563023 1577511 1591998
				1605292 1618585 1631879 1645172 1658466 1668710 1678955 1689199 1699444 1709688>;

		temp_array = <900 890 880 870 860 850 840 830 820 810
				800 790 780 770 760 750 740 730 720 710
				700 690 680 670 660 650 640 630 620 610
				600 590 580 570 560 550 540 530 520 510
				500 490 480 470 460 450 440 430 420 410
				400 390 380 370 360 350 340 330 320 310
				300 290 280 270 260 250 240 230 220 210
				200 190 180 170 160 150 140 130 120 110
				100 90 80 70 60 50 40 30 20 10
				0
				(-10) (-20) (-30) (-40) (-50) (-60) (-70) (-80) (-90) (-100)
				(-110)(-120)(-130)(-140)(-150)(-160)(-170)(-180)(-190) (-200)>;
	};

	/* CP Thermistor table */
	sec_thermistor@1 {
		adc_array = <121291 125800 130309 134818 139327 143836 149221 154606 159991 165376
				170761 176970 183179 189388 195597 201806 208826 215846 222865 229885
				236905 245657 254409 263162 271914 280666 290690 300714 310737 320761
				330785 342275 353765 365255 376745 388235 401665 415095 428524 441954
				455384 470566 485748 500929 516111 531293 548505 565718 582930 600143
				617355 636196 655037 673877 692718 711559 731963 752368 772772 793177
				813581 835043 856505 877967 899429 920891 943313 965735 988157 1010579
				1033001 1055534 1078066 1100599 1123131 1145664 1167794 1189924 1212055 1234185
				1256315 1276992 1297669 1318345 1339022 1359699 1378378 1397056 1415735 1434413
				1453092
				1469604 1486116 1502627 1519139 1535651 1549795 1563938 1578082 1592225 1606369
				1618806 1631243 1643681 1656118 1668555 1678430 1688304 1698179 1708053 1717928>;

		temp_array = <900 890 880 870 860 850 840 830 820 810
				800 790 780 770 760 750 740 730 720 710
				700 690 680 670 660 650 640 630 620 610
				600 590 580 570 560 550 540 530 520 510
				500 490 480 470 460 450 440 430 420 410
				400 390 380 370 360 350 340 330 320 310
				300 290 280 270 260 250 240 230 220 210
				200 190 180 170 160 150 140 130 120 110
				100 90 80 70 60 50 40 30 20 10
				0
				(-10) (-20) (-30) (-40) (-50) (-60) (-70) (-80) (-90) (-100)
				(-110)(-120)(-130)(-140)(-150)(-160)(-170)(-180)(-190) (-200)>;
	};

	/* WiFi Thermistor table */
	sec_thermistor@2 {
		adc_array = <122361 126896 131431 135966 140501 145036 150298 155560 160821 166083
				171345 177502 183659 189816 195973 202130 209189 216248 223306 230365
				237424 246053 254682 263311 271940 280569 290495 300422 310348 320275
				330201 341749 353298 364846 376395 387943 401217 414491 427766 441040
				454314 469418 484522 499625 514729 529833 547071 564310 581548 598787
				616025 634846 653668 672489 691311 710132 730355 750577 770800 791022
				811245 832856 854467 876079 897690 919301 941587 963873 986159 1008445
				1030731 1053244 1075757 1098269 1120782 1143295 1165477 1187659 1209842 1232024
				1254206 1274922 1295638 1316353 1337069 1357785 1376535 1395285 1414035 1432785
				1451535
				1468170 1484805 1501440 1518075 1534710 1548931 1563153 1577374 1591596 1605817
				1618261 1630705 1643148 1655592 1668036 1677988 1687941 1697893 1707846 1717798>;

		temp_array = <900 890 880 870 860 850 840 830 820 810
				800 790 780 770 760 750 740 730 720 710
				700 690 680 670 660 650 640 630 620 610
				600 590 580 570 560 550 540 530 520 510
				500 490 480 470 460 450 440 430 420 410
				400 390 380 370 360 350 340 330 320 310
				300 290 280 270 260 250 240 230 220 210
				200 190 180 170 160 150 140 130 120 110
				100 90 80 70 60 50 40 30 20 10
				0
				(-10) (-20) (-30) (-40) (-50) (-60) (-70) (-80) (-90) (-100)
				(-110)(-120)(-130)(-140)(-150)(-160)(-170)(-180)(-190) (-200)>;
	};
};
