/* Copyright (c) 2020, The Linux Foundation. All rights reserved.
 *
 * This program is free software; you can redistribute it and/or modify
 * it under the terms of the GNU General Public License version 2 and
 * only version 2 as published by the Free Software Foundation.
 *
 * This program is distributed in the hope that it will be useful,
 * but WITHOUT ANY WARRANTY; without even the implied warranty of
 * MERCHANTABILITY or FITNESS FOR A PARTICULAR PURPOSE.  See the
 * GNU General Public License for more details.
 */

/dts-v1/;
/plugin/;

#include "../common/kona-sec-common.dtsi"
#include "kona-sec-c2q-r06.dtsi"
#include "../drivers/camera_sensor_c2q_r03.dtsi"
#include "../drivers/kona-sec-c2q-camera-sensor-pinctrl-r01.dtsi"

/ {
	model = "Samsung C2Q KOR PROJECT - SM-N986N_REV04 (board-id,6)";
	compatible = "qcom,kona-mtp", "qcom,kona", "qcom,mtp";
	qcom,board-id = <8 6>;
	dtbo-version = <0>;
};

&soc {
	i2c@17 { /* SW I2C */
		status = "ok";
		sx9360-i2c@28 {
			sx9360,proxthresh_mcc = <0x49>; /* threshold : 2664 */
		};
	};
};
