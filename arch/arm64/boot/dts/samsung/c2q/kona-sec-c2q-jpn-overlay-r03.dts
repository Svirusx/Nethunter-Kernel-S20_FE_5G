/* Copyright (c) 2020, The Linux Foundation. All rights reserved.
 *
 * This program is free software; you can redistribute it and/or modify
 * it under the terms of the GNU General Public License version 2 and
 * only version 2 as published by the Free Software Foundation.
 *
 * This program is distributed in the hope that it will be useful,
 * but WITHOUT ANY WARRANTY; without even the implied warranty of
 * MERCHANTABILITY or FITNESS FOR A PARTICULAR PURPOSE.  See the
 * GNU General Public License for more details.
 */

/dts-v1/;
/plugin/;

#include "../common/kona-sec-common.dtsi"
#include "kona-sec-c2q-r03.dtsi"
#include "../drivers/camera_sensor_c2q_r03.dtsi"
#include "../drivers/kona-sec-c2q-camera-sensor-pinctrl-r01.dtsi"

/ {
	model = "Samsung C2Q PROJECT - SM-N986J_REV02 (board-id,3)";
	compatible = "qcom,kona-mtp", "qcom,kona", "qcom,mtp";
	qcom,board-id = <8 3>;
	dtbo-version = <0>;
};
