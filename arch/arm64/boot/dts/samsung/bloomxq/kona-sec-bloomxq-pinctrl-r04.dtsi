/* Copyright (c) 2020, The Linux Foundation. All rights reserved.
 *
 * This program is free software; you can redistribute it and/or modify
 * it under the terms of the GNU General Public License version 2 and
 * only version 2 as published by the Free Software Foundation.
 *
 * This program is distributed in the hope that it will be useful,
 * but WITHOUT ANY WARRANTY; without even the implied warranty of
 * MERCHANTABILITY or FITNESS FOR A PARTICULAR PURPOSE.  See the
 * GNU General Public License for more details.
 */

&tlmm {
	wakeup-disabled-gpios = <
		4	/* I2C : PM3003A_SDA_1P8 */
		11	/* NC : NC */
		23	/* SPI : BTP_SPI_CS_N */
		24	/* NC : NC */
		27	/* NC : NC */
		28	/* I2C : IF_PMIC_SDA_1P8 */
		39	/* NC : NC */
		40	/* NC : NC */
		45	/* I2C : NFC_FLICKER_SCL_1P8 */
		47	/* NC : NC */
		51	/* SPI : ESE_SPI_CS_N */
		55	/* NC : NC */
		59	/* NC : NC */
		63	/* I2C : DISP_PMIC_SCL_1P8 */
		83	/* NC : NC */
		103	/* I2C : VT10M_SDA_1P8 */
		104	/* I2C : VT10M_SCL_1P8 */
		108	/* I2C : CAM_AF_EEP_SCL_1P8 */
		112	/* NC : NC */
		121	/* SPI : F_SPI_SCLK */
		122	/* SPI : F_SPI_CSN */
		126	/* I2C : BATT_SCL_1P8 */
		129	/* I2C : MOTOR_SDA_1P8 */
		142	/* SLIMBUS : BT_SLIMBUS_CLK */
		143	/* SLIMBUS : BT_SLIMBUS_DATA */
		147	/* NC : NC */
		150	/* NC : NC */
		160	/* I2C : 6AXIS_I3C_SDA_1P8 */
		162	/* I2C : MAGNETIC_SDA_1P8 */
		164	/* SPI : COPR_MISO */
		166	/* SPI : COPR_SCLK */
		167	/* SPI : COPR_SS */
		175	/* NC : NC */
		177	/* I2C : PROXY_SCL_1P8 */
		179	/* NC : NC */
	>;
};
