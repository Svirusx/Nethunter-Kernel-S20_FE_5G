/* Copyright (c) 2016-2017, The Linux Foundation. All rights reserved.
 *
 * This program is free software; you can redistribute it and/or modify
 * it under the terms of the GNU General Public License version 2 and
 * only version 2 as published by the Free Software Foundation.
 *
 * This program is distributed in the hope that it will be useful,
 * but WITHOUT ANY WARRANTY; without even the implied warranty of
 * MERCHANTABILITY or FITNESS FOR A PARTICULAR PURPOSE.  See the
 * GNU General Public License for more details.
 */

&tsp_lsi {
	sec,firmware_name = "tsp_sec/y771_c1_pv1.bin";
	sec,bringup = <0>;
	support_fp_intr2_call;
};

&wacom {
	status = "ok";
	/delete-property/ wacom,bringup;
	/delete-property/ wacom,donotusethislcdmodule;
	wacom,fw_path = "epen/w9020_c1.bin";
	wacom,support_garage_open_test = <1>;

	/delete-node/ wacom_elec0;
	/delete-node/ wacom_elec1;
	/* for main spec */
	wacom_elec0 {
		spec_ver = <4 1>;
		max_channel = <24 11>; /* x y */
		shift_value = <4>;

		xx_ref = /bits/ 64 <4352 4379 3943 3963 3966 4014 4151 4143 4200 4242 4237 4197 4307 4430 4516 4514 4708 4734 4710 4653 4742 4928 5716 5695>;
		xy_ref = /bits/ 64 <572 764 534 502 490 476 464 473 491 497 499 499 488 477 463 457 463 464 471 494 554 615 904 797>;
		yx_ref = /bits/ 64 <682 917 450 518 430 762 570 530 565 883 692>;
		yy_ref = /bits/ 64 <4780 4788 2807 2958 2952 2915 2800 2850 2930 4694 4750>;

		xx_spec = /bits/ 64 <5875 5912 5322 5351 5354 5419 5603 5593 5670 5727 5720 5666 5815 5980 6096 6094 6356 6391 6358 6282 6402 6652 7717 7688>;
		xy_spec = /bits/ 64 <772 1032 721 678 661 643 627 639 662 671 674 674 659 644 625 617 625 627 635 667 749 831 1221 1075>;
		yx_spec = /bits/ 64 <920 1238 608 700 581 1028 769 716 763 1192 935>;
		yy_spec = /bits/ 64 <6453 6464 3790 3993 3985 3935 3780 3847 3956 6337 6413>;

		rxx_ref = /bits/ 64 <10000 10000 10000 10000 10000 10000 10000 10000 10000 10000 10000 10000 10000 10000 10000 10000 10000 10000 10000 10000 10000 10000 10000 10000>;
		rxy_ref = /bits/ 64 <10000 10000 10000 10000 10000 10000 10000 10000 10000 10000 10000 10000 10000 10000 10000 10000 10000 10000 10000 10000 10000 10000 10000 10000>;
		ryx_ref = /bits/ 64 <10000 10000 10000 10000 10000 10000 10000 10000 10000 10000 10000>;
		ryy_ref = /bits/ 64 <10000 10000 10000 10000 10000 10000 10000 10000 10000 10000 10000>;

		drxx_spec = /bits/ 64 <1400 1400 1400 1400 1400 1400 1400 1400 1400 1400 1400 1400 1400 1400 1400 1400 1400 1400 1400 1400 1400 1400 1500 1500>;
		drxy_spec = /bits/ 64 <1500 1500 1500 1500 1500 1500 1500 1500 1500 1500 1500 1500 1500 1500 1500 1500 1500 1500 1500 1500 1500 1500 1800 1800>;
		dryx_spec = /bits/ 64 <1500 1500 1500 1500 1500 1500 1500 1500 1500 1800 1800>;
		dryy_spec = /bits/ 64 <1800 1800 1400 1400 1400 1400 1400 1400 1400 1800 1800>;
	};

	/* for unit spec */
	wacom_elec1 {
		spec_ver = <5 2>;
		max_channel = <24 11>; /* x y */
		shift_value = <4>;

		xx_ref = /bits/ 64 <4879 4931 4422 4390 4438 4425 4501 4548 4558 4605 4565 4515 4605 4742 4887 4853 5041 5175 5068 5119 5176 5288 6241 6095>;
		xy_ref = /bits/ 64 <730 922 707 678 675 676 688 723 665 574 519 512 610 678 754 800 741 705 692 680 684 731 1024 1092>;
		yx_ref = /bits/ 64 <782 1027 653 676 730 1113 873 805 800 1039 826>;
		yy_ref = /bits/ 64 <5088 5117 3399 3558 3576 3329 3349 3288 3164 5348 5370>;

		xx_spec = /bits/ 64 <6343 6411 5749 5707 5769 5752 5851 5913 5925 5987 5934 5869 5986 6164 6353 6309 6554 6728 6588 6654 6729 6874 8114 7924>;
		xy_spec = /bits/ 64 <949 1199 919 881 878 878 894 940 865 746 674 665 793 881 980 1041 963 917 900 884 889 950 1332 1419>;
		yx_spec = /bits/ 64 <1017 1336 850 879 948 1447 1135 1047 1040 1351 1074>;
		yy_spec = /bits/ 64 <6614 6652 4419 4625 4649 4327 4354 4275 4113 6952 6981>;

		rxx_ref = /bits/ 64 <10000 10000 10000 10000 10000 10000 10000 10000 10000 10000 10000 10000 10000 10000 10000 10000 10000 10000 10000 10000 10000 10000 10000 10000>;
		rxy_ref = /bits/ 64 <10000 10000 10000 10000 10000 10000 10000 10000 10000 10000 10000 10000 10000 10000 10000 10000 10000 10000 10000 10000 10000 10000 10000 10000>;
		ryx_ref = /bits/ 64 <10000 10000 10000 10000 10000 10000 10000 10000 10000 10000 10000>;
		ryy_ref = /bits/ 64 <10000 10000 10000 10000 10000 10000 10000 10000 10000 10000 10000>;

		drxx_spec = /bits/ 64 <1100 1100 1100 1100 1100 1100 1100 1100 1100 1100 1100 1100 1100 1100 1100 1100 1100 1100 1100 1100 1100 1100 1200 1200>;
		drxy_spec = /bits/ 64 <1200 1200 1200 1200 1200 1200 1200 1200 1200 1200 1200 1200 1200 1200 1200 1200 1200 1200 1200 1200 1200 1200 1500 1500>;
		dryx_spec = /bits/ 64 <1200 1200 1200 1200 1200 1200 1200 1200 1200 1500 1500>;
		dryy_spec = /bits/ 64 <1500 1500 1100 1100 1100 1100 1100 1100 1100 1500 1500>;
	};

};
