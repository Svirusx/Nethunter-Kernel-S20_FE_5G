#include "camera_sensor_x1q_r04.dtsi"

&sensor_rear_wide {
	cam_vana-supply = <&s2mpb03_l5>;
};

&sensor_rear_tele {
	cam_vana-supply = <&s2mpb03_l6>;
};

&sensor_rear_binning_tele {
	cam_vana-supply = <&s2mpb03_l6>;
};

&actuator_rear_tele {
	cam_vaf-supply = <&s2mpb02_l13>;
};