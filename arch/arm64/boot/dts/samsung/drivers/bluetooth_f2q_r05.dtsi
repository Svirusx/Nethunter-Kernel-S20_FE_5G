/* Copyright (c) 2019, The Linux Foundation. All rights reserved.
 *
 * This program is free software; you can redistribute it and/or modify
 * it under the terms of the GNU General Public License version 2 and
 * only version 2 as published by the Free Software Foundation.
 *
 * This program is distributed in the hope that it will be useful,
 * but WITHOUT ANY WARRANTY; without even the implied warranty of
 * MERCHANTABILITY or FITNESS FOR A PARTICULAR PURPOSE.  See the
 * GNU General Public License for more details.
 */

&bluetooth {
	qca,bt-reset-gpio = <&tlmm 76 0>; /* BT_EN */
	qca,bt-vdd-rfa1-voltage-level = <2040000 2040000>;
	qca,bt-vdd-dig-supply = <&pm8150_s6>;
	/delete-property/ qca,bt-vdd-asd-supply;
	/delete-property/ qca,bt-vdd-asd-voltage-level;
	status = "ok";
};

&qupv3_se6_4uart {
	pinctrl-names = "default", "active", "sleep";
	pinctrl-0 = <&qupv3_se6_default_cts>,
				<&qupv3_se6_default_rtsrx>, <&qupv3_se6_default_tx>;
	pinctrl-1 = <&qupv3_se6_ctsrx>, <&qupv3_se6_rts>,<&qupv3_se6_tx>;
	pinctrl-2 = <&qupv3_se6_ctsrx>, <&qupv3_se6_rts>,<&qupv3_se6_tx>;
	interrupts-extended = <&intc GIC_SPI 607 IRQ_TYPE_LEVEL_HIGH>,
						<&tlmm 19 0>;
	status = "ok";
};
