/* Copyright (c) 2016-2017, The Linux Foundation. All rights reserved.
 *
 * This program is free software; you can redistribute it and/or modify
 * it under the terms of the GNU General Public License version 2 and
 * only version 2 as published by the Free Software Foundation.
 *
 * This program is distributed in the hope that it will be useful,
 * but WITHOUT ANY WARRANTY; without even the implied warranty of
 * MERCHANTABILITY or FITNESS FOR A PARTICULAR PURPOSE.  See the
 * GNU General Public License for more details.
 */

&tsp_lsi {
	sec,tclm_level = <1>;
//	sec,afe_base = <0x0000>;
};


&wacom {
	//wacom,max_coords = <15811 7373>; /* x y */
	wacom,fw_path = "epen/w9020_c1_x1ub.bin";
	//wacom,fw_fac_path = "", "epen/w9020_d2_unit.fw";

	/* for main spec */
	wacom_elec0 {
		spec_ver = <0 0>; /* major minor */
		max_channel = <23 10>; /* x y */
		shift_value = <4>;

		xx_ref = /bits/ 64 <3977 3990 3777 3776 3767 3868 3948 3959 3993 4041 4023 4002 4091 4216 4324 4304 4263 4291 4258 4206 4294 4432 5342>;
		xy_ref = /bits/ 64 <438 708 482 457 449 437 439 440 449 451 451 451 451 453 455 456 466 461 454 443 478 794 742>;
		yx_ref = /bits/ 64 <791 659 499 464 561 578 523 511 809 748>;
		yy_ref = /bits/ 64 <4593 4580 2694 2732 2721 2647 2690 2492 4747 4790>;

		xx_spec = /bits/ 64 <15000 15000 15000 15000 15000 15000 15000 15000 15000 15000 15000 15000 15000 15000 15000 15000 15000 15000 15000 15000 15000 15000 15000>;
		xy_spec = /bits/ 64 <5000 5000 5000 5000 5000 5000 5000 5000 5000 5000 5000 5000 5000 5000 5000 5000 5000 5000 5000 5000 5000 5000 5000>;
		yx_spec = /bits/ 64 <5000 5000 5000 5000 5000 5000 5000 5000 5000 5000>;
		yy_spec = /bits/ 64 <15000 15000 15000 15000 15000 15000 15000 15000 15000 15000>;

		rxx_ref = /bits/ 64 <10000 10000 10000 10000 10000 10000 10000 10000 10000 10000 10000 10000 10000 10000 10000 10000 10000 10000 10000 10000 10000 10000 10000>;
		rxy_ref = /bits/ 64 <10000 10000 10000 10000 10000 10000 10000 10000 10000 10000 10000 10000 10000 10000 10000 10000 10000 10000 10000 10000 10000 10000 10000>;
		ryx_ref = /bits/ 64 <10000 10000 10000 10000 10000 10000 10000 10000 10000 10000>;
		ryy_ref = /bits/ 64 <10000 10000 10000 10000 10000 10000 10000 10000 10000 10000>;

		drxx_spec = /bits/ 64 <10000 10000 10000 10000 10000 10000 10000 10000 10000 10000 10000 10000 10000 10000 10000 10000 10000 10000 10000 10000 10000 10000 10000>;
		drxy_spec = /bits/ 64 <10000 10000 10000 10000 10000 10000 10000 10000 10000 10000 10000 10000 10000 10000 10000 10000 10000 10000 10000 10000 10000 10000 10000>;
		dryx_spec = /bits/ 64 <10000 10000 10000 10000 10000 10000 10000 10000 10000 10000>;
		dryy_spec = /bits/ 64 <10000 10000 10000 10000 10000 10000 10000 10000 10000 10000>;
	};

	/* for unit spec */
	wacom_elec1 {
		spec_ver = <0 0>; /* major minor */
		max_channel = <23 10>; /* x y */
		shift_value = <4>;

		xx_ref = /bits/ 64 <3977 3990 3777 3776 3767 3868 3948 3959 3993 4041 4023 4002 4091 4216 4324 4304 4263 4291 4258 4206 4294 4432 5342>;
		xy_ref = /bits/ 64 <438 708 482 457 449 437 439 440 449 451 451 451 451 453 455 456 466 461 454 443 478 794 742>;
		yx_ref = /bits/ 64 <791 659 499 464 561 578 523 511 809 748>;
		yy_ref = /bits/ 64 <4593 4580 2694 2732 2721 2647 2690 2492 4747 4790>;

		xx_spec = /bits/ 64 <15000 15000 15000 15000 15000 15000 15000 15000 15000 15000 15000 15000 15000 15000 15000 15000 15000 15000 15000 15000 15000 15000 15000>;
		xy_spec = /bits/ 64 <5000 5000 5000 5000 5000 5000 5000 5000 5000 5000 5000 5000 5000 5000 5000 5000 5000 5000 5000 5000 5000 5000 5000>;
		yx_spec = /bits/ 64 <5000 5000 5000 5000 5000 5000 5000 5000 5000 5000>;
		yy_spec = /bits/ 64 <15000 15000 15000 15000 15000 15000 15000 15000 15000 15000>;

		rxx_ref = /bits/ 64 <10000 10000 10000 10000 10000 10000 10000 10000 10000 10000 10000 10000 10000 10000 10000 10000 10000 10000 10000 10000 10000 10000 10000>;
		rxy_ref = /bits/ 64 <10000 10000 10000 10000 10000 10000 10000 10000 10000 10000 10000 10000 10000 10000 10000 10000 10000 10000 10000 10000 10000 10000 10000>;
		ryx_ref = /bits/ 64 <10000 10000 10000 10000 10000 10000 10000 10000 10000 10000>;
		ryy_ref = /bits/ 64 <10000 10000 10000 10000 10000 10000 10000 10000 10000 10000>;

		drxx_spec = /bits/ 64 <10000 10000 10000 10000 10000 10000 10000 10000 10000 10000 10000 10000 10000 10000 10000 10000 10000 10000 10000 10000 10000 10000 10000>;
		drxy_spec = /bits/ 64 <10000 10000 10000 10000 10000 10000 10000 10000 10000 10000 10000 10000 10000 10000 10000 10000 10000 10000 10000 10000 10000 10000 10000>;
		dryx_spec = /bits/ 64 <10000 10000 10000 10000 10000 10000 10000 10000 10000 10000>;
		dryy_spec = /bits/ 64 <10000 10000 10000 10000 10000 10000 10000 10000 10000 10000>;
	};

};
