/* Copyright (c) 2016-2017, The Linux Foundation. All rights reserved.
 *
 * This program is free software; you can redistribute it and/or modify
 * it under the terms of the GNU General Public License version 2 and
 * only version 2 as published by the Free Software Foundation.
 *
 * This program is distributed in the hope that it will be useful,
 * but WITHOUT ANY WARRANTY; without even the implied warranty of
 * MERCHANTABILITY or FITNESS FOR A PARTICULAR PURPOSE.  See the
 * GNU General Public License for more details.
 */

#include "input_canvas_common.dtsi"

&tsp_lsi {
	sec,tclm_level = <2>;
	sec,afe_base = <0x0215>;
	support_multi_calibration;
};

&wacom {
	//wacom,max_coords = <15811 7373>; /* x y */
	wacom,fw_path = "epen/w9020_c2.bin";
	//wacom,fw_fac_path = "", "epen/w9020_d2_unit.fw";

	/* for main spec */
	wacom_elec0 {
		spec_ver = <0 0>; /* major minor */
		max_channel = <24 11>; /* x y */
		shift_value = <4>;

		xx_ref = /bits/ 64 <4700 4722 4312 4265 4340 4296 4459 4479 4486 4552 4472 4407 4584 4666 4781 4770 4797 4878 4784 4789 4801 4944 5997 5874>;
		xy_ref = /bits/ 64 <699 976 727 678 681 676 673 663 701 700 693 694 671 672 678 692 678 686 691 700 691 709 1021 874>;
		yx_ref = /bits/ 64 <798 912 673 639 599 829 737 695 707 1018 822>;
		yy_ref = /bits/ 64 <5654 5650 3283 3474 3510 3168 3165 3159 3197 5892 5957>;

		xx_spec = /bits/ 64 <15000 15000 15000 15000 15000 15000 15000 15000 15000 15000 15000 15000 15000 15000 15000 15000 15000 15000 15000 15000 15000 15000 15000 15000>;
		xy_spec = /bits/ 64 <5000 5000 5000 5000 5000 5000 5000 5000 5000 5000 5000 5000 5000 5000 5000 5000 5000 5000 5000 5000 5000 5000 5000 5000>;
		yx_spec = /bits/ 64 <5000 5000 5000 5000 5000 5000 5000 5000 5000 5000 5000>;
		yy_spec = /bits/ 64 <15000 15000 15000 15000 15000 15000 15000 15000 15000 15000 15000>;

		rxx_ref = /bits/ 64 <10000 10000 10000 10000 10000 10000 10000 10000 10000 10000 10000 10000 10000 10000 10000 10000 10000 10000 10000 10000 10000 10000 10000 10000>;
		rxy_ref = /bits/ 64 <10000 10000 10000 10000 10000 10000 10000 10000 10000 10000 10000 10000 10000 10000 10000 10000 10000 10000 10000 10000 10000 10000 10000 10000>;
		ryx_ref = /bits/ 64 <10000 10000 10000 10000 10000 10000 10000 10000 10000 10000 10000>;
		ryy_ref = /bits/ 64 <10000 10000 10000 10000 10000 10000 10000 10000 10000 10000 10000>;

		drxx_spec = /bits/ 64 <10000 10000 10000 10000 10000 10000 10000 10000 10000 10000 10000 10000 10000 10000 10000 10000 10000 10000 10000 10000 10000 10000 10000 10000>;
		drxy_spec = /bits/ 64 <10000 10000 10000 10000 10000 10000 10000 10000 10000 10000 10000 10000 10000 10000 10000 10000 10000 10000 10000 10000 10000 10000 10000 10000>;
		dryx_spec = /bits/ 64 <10000 10000 10000 10000 10000 10000 10000 10000 10000 10000 10000>;
		dryy_spec = /bits/ 64 <10000 10000 10000 10000 10000 10000 10000 10000 10000 10000 10000>;
	};

	/* for unit spec */
	wacom_elec1 {
		spec_ver = <0 0>; /* major minor */
		max_channel = <24 11>; /* x y */
		shift_value = <4>;

		xx_ref = /bits/ 64 <4700 4722 4312 4265 4340 4296 4459 4479 4486 4552 4472 4407 4584 4666 4781 4770 4797 4878 4784 4789 4801 4944 5997 5874>;
		xy_ref = /bits/ 64 <699 976 727 678 681 676 673 663 701 700 693 694 671 672 678 692 678 686 691 700 691 709 1021 874>;
		yx_ref = /bits/ 64 <798 912 673 639 599 829 737 695 707 1018 822>;
		yy_ref = /bits/ 64 <5654 5650 3283 3474 3510 3168 3165 3159 3197 5892 5957>;

		xx_spec = /bits/ 64 <15000 15000 15000 15000 15000 15000 15000 15000 15000 15000 15000 15000 15000 15000 15000 15000 15000 15000 15000 15000 15000 15000 15000 15000>;
		xy_spec = /bits/ 64 <5000 5000 5000 5000 5000 5000 5000 5000 5000 5000 5000 5000 5000 5000 5000 5000 5000 5000 5000 5000 5000 5000 5000 5000>;
		yx_spec = /bits/ 64 <5000 5000 5000 5000 5000 5000 5000 5000 5000 5000 5000>;
		yy_spec = /bits/ 64 <15000 15000 15000 15000 15000 15000 15000 15000 15000 15000 15000>;

		rxx_ref = /bits/ 64 <10000 10000 10000 10000 10000 10000 10000 10000 10000 10000 10000 10000 10000 10000 10000 10000 10000 10000 10000 10000 10000 10000 10000 10000>;
		rxy_ref = /bits/ 64 <10000 10000 10000 10000 10000 10000 10000 10000 10000 10000 10000 10000 10000 10000 10000 10000 10000 10000 10000 10000 10000 10000 10000 10000>;
		ryx_ref = /bits/ 64 <10000 10000 10000 10000 10000 10000 10000 10000 10000 10000 10000>;
		ryy_ref = /bits/ 64 <10000 10000 10000 10000 10000 10000 10000 10000 10000 10000 10000>;

		drxx_spec = /bits/ 64 <10000 10000 10000 10000 10000 10000 10000 10000 10000 10000 10000 10000 10000 10000 10000 10000 10000 10000 10000 10000 10000 10000 10000 10000>;
		drxy_spec = /bits/ 64 <10000 10000 10000 10000 10000 10000 10000 10000 10000 10000 10000 10000 10000 10000 10000 10000 10000 10000 10000 10000 10000 10000 10000 10000>;
		dryx_spec = /bits/ 64 <10000 10000 10000 10000 10000 10000 10000 10000 10000 10000 10000>;
		dryy_spec = /bits/ 64 <10000 10000 10000 10000 10000 10000 10000 10000 10000 10000 10000>;
	};
};
