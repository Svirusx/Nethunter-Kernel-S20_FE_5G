/* Copyright (c) 2019, The Linux Foundation. All rights reserved.
 *
 * This program is free software; you can redistribute it and/or modify
 * it under the terms of the GNU General Public License version 2 and
 * only version 2 as published by the Free Software Foundation.
 *
 * This program is distributed in the hope that it will be useful,
 * but WITHOUT ANY WARRANTY; without even the implied warranty of
 * MERCHANTABILITY or FITNESS FOR A PARTICULAR PURPOSE.  See the
 * GNU General Public License for more details.
 */
&soc {
	sec_detect_conn {
		compatible = "samsung,sec_detect_conn";
		sec,det_conn_gpios = <&tlmm 135 0 /* CAM_DETECT */
					&tlmm 9 0 /* MAIN_BAT_DETECT */
					&tlmm 77 0 /* SUB_BAT_DETECT */
					&tlmm 38 0 /* UPPER_C2C_DETECT */
					&tlmm 151 0>; /* LOWER_C2C_DETECT */

		sec,det_conn_name = "CAM_CONNECT", "MAIN_BAT_DETECT", "SUB_BAT_DETECT", "UPPER_C2C_DETECT", "LOWER_C2C_DETECT";

		sec,det_conn_irq_type = <3>, /* CAM_DETECT FALLING, RIGING EDGE*/
					<3>, /* MAIN_BAT_DETECT FALLING, RIGING EDGE*/
					<3>, /* SUB_BAT_DETECT FALLING, RIGING EDGE*/
					<3>, /* UPPER_C2C_DETECT FALLING, RIGING EDGE*/
					<3>; /* LOWER_C2C_DETECT FALLING, RIGING EDGE*/

		pinctrl-names = "det_ap_connect";
		pinctrl-0 = <&detect_conn_setting>;
	};
};
