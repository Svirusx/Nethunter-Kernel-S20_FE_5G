/* Copyright (c) 2019, The Linux Foundation. All rights reserved.
 *
 * This program is free software; you can redistribute it and/or modify
 * it under the terms of the GNU General Public License version 2 and
 * only version 2 as published by the Free Software Foundation.
 *
 * This program is distributed in the hope that it will be useful,
 * but WITHOUT ANY WARRANTY; without even the implied warranty of
 * MERCHANTABILITY or FITNESS FOR A PARTICULAR PURPOSE.  See the
 * GNU General Public License for more details.
 */

&soc {
        i2c@17 { /* SW I2C */
                status = "ok";
                a96t3x6@20 {
                        a96t3x6,fw_path = "a96t365_z3_kor.bin";
                        a96t3x6,thd_mcc = <650>;
                };
        };
};

