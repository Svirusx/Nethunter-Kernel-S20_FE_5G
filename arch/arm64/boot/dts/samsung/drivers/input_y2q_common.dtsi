/* Copyright (c) 2016-2017, The Linux Foundation. All rights reserved.
 *
 * This program is free software; you can redistribute it and/or modify
 * it under the terms of the GNU General Public License version 2 and
 * only version 2 as published by the Free Software Foundation.
 *
 * This program is distributed in the hope that it will be useful,
 * but WITHOUT ANY WARRANTY; without even the implied warranty of
 * MERCHANTABILITY or FITNESS FOR A PARTICULAR PURPOSE.  See the
 * GNU General Public License for more details.
 */

#include "input_hubble_common.dtsi"

&qupv3_se5_i2c {
	touchscreen@48 {
		sec,tclm_level = <2>;
		sec,afe_base = <0x0117>;
		sec,firmware_name = "tsp_sec/y79a_y2.bin";
	};
};
