/*
 * This program is free software; you can redistribute it and/or modify
 * it under the terms of the GNU General Public License version 2 and
 * only version 2 as published by the Free Software Foundation.
 *
 * This program is distributed in the hope that it will be useful,
 * but WITHOUT ANY WARRANTY; without even the implied warranty of
 * MERCHANTABILITY or FITNESS FOR A PARTICULAR PURPOSE.  See the
 * GNU General Public License for more details.
 */
/* eSE is not supported on jpn model. so, disabled spi bus driver */
&qupv3_se16_spi {
	status = "disabled";
	/delete-node/ ese_spi@0;
};

&qupv3_se15_i2c {
	/* nfc ic doesn't exist */
	/delete-node/ pn547@2B;
};
