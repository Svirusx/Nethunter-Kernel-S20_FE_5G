/* Copyright (c) 2014, The Linux Foundation. All rights reserved.
 *
 * This program is free software; you can redistribute it and/or modify
 * it under the terms of the GNU General Public License version 2 and
 * only version 2 as published by the Free Software Foundation.
 *
 * This program is distributed in the hope that it will be useful,
 * but WITHOUT ANY WARRANTY; without even the implied warranty of
 * MERCHANTABILITY or FITNESS FOR A PARTICULAR PURPOSE.  See the
 * GNU General Public License for more details.
 */

&soc {
	sec-cisd {
		ovp_power = <&tlmm 118 0>;
		ovp_signal = <&tlmm 113 0>;
	};
	battery {
		pinctrl-0 = <&wpc_det_default &wpc_thm_default &sub_bat_thm_default &wpc_en_default &ovp_slg_flag_default &ovp_pwr_flagb_default>;
	};
};
