/* Copyright (c) 2019, The Linux Foundation. All rights reserved.
 *
 * This program is free software; you can redistribute it and/or modify
 * it under the terms of the GNU General Public License version 2 and
 * only version 2 as published by the Free Software Foundation.
 *
 * This program is distributed in the hope that it will be useful,
 * but WITHOUT ANY WARRANTY; without even the implied warranty of
 * MERCHANTABILITY or FITNESS FOR A PARTICULAR PURPOSE.  See the
 * GNU General Public License for more details.
 */

&soc {
	/* AP Thermistor table */
	sec_thermistor@0 {
		adc_array = <116360 120623 124885 129148 133410 137673 143350 149027 154703 160380
				166057 172182 178306 184431 190555 196680 203875 211070 218266 225461
				232656 241077 249498 257920 266341 274762 284773 294784 304794 314805
				324816 336390 347965 359539 371114 382688 395722 408756 421791 434825
				447859 463067 478274 493482 508689 523897 540947 557997 575048 592098
				609148 627528 645908 664289 682669 701049 721544 742039 762535 783030
				803525 825156 846786 868417 890047 911678 933944 956211 978477 1000744
				1023010 1045478 1067945 1090413 1112880 1135348 1157082 1178817 1200551 1222286
				1244020 1264924 1285828 1306732 1327636 1348540 1366888 1385236 1403583 1421931
				1440279
				1457666 1475054 1492441 1509829 1527216 1541989 1556762 1571535 1586308 1601081
				1613324 1625567 1637809 1650052 1662295 1672241 1682187 1692132 1702078 1712024>;

		temp_array = <900 890 880 870 860 850 840 830 820 810
				800 790 780 770 760 750 740 730 720 710
				700 690 680 670 660 650 640 630 620 610
				600 590 580 570 560 550 540 530 520 510
				500 490 480 470 460 450 440 430 420 410
				400 390 380 370 360 350 340 330 320 310
				300 290 280 270 260 250 240 230 220 210
				200 190 180 170 160 150 140 130 120 110
				100 90 80 70 60 50 40 30 20 10
				0
				(-10) (-20) (-30) (-40) (-50) (-60) (-70) (-80) (-90) (-100)
				(-110)(-120)(-130)(-140)(-150)(-160)(-170)(-180)(-190) (-200)>;
	};

	/* WiFi Thermistor table */
	sec_thermistor@2 {
		adc_array = <122037 126488 130938 135389 139839 144290 149733 155177 160620 166064
				171507 177612 183717 189823 195928 202033 209325 216618 223910 231203
				238495 247039 255584 264128 272673 281217 291273 301329 311386 321442
				331498 343111 354725 366338 377952 389565 402807 416049 429290 442532
				455774 471046 486319 501591 516864 532136 549147 566159 583170 600182
				617193 635755 654317 672878 691440 710002 730426 750850 771273 791697
				812121 833823 855525 877227 898929 920631 942768 964905 987041 1009178
				1031315 1053750 1076185 1098620 1121055 1143490 1165276 1187063 1208849 1230636
				1252422 1273131 1293841 1314550 1335260 1355969 1374550 1393131 1411713 1430294
				1448875
				1465821 1482768 1499714 1516661 1533607 1548224 1562841 1577459 1592076 1606693
				1618715 1630737 1642760 1654782 1666804 1676614 1686423 1696233 1706042 1715852>;

		temp_array = <900 890 880 870 860 850 840 830 820 810
				800 790 780 770 760 750 740 730 720 710
				700 690 680 670 660 650 640 630 620 610
				600 590 580 570 560 550 540 530 520 510
				500 490 480 470 460 450 440 430 420 410
				400 390 380 370 360 350 340 330 320 310
				300 290 280 270 260 250 240 230 220 210
				200 190 180 170 160 150 140 130 120 110
				100 90 80 70 60 50 40 30 20 10
				0
				(-10) (-20) (-30) (-40) (-50) (-60) (-70) (-80) (-90) (-100)
				(-110)(-120)(-130)(-140)(-150)(-160)(-170)(-180)(-190) (-200)>;
	};
};
