/* Copyright (c) 2019, The Linux Foundation. All rights reserved.
 *
 * This program is free software; you can redistribute it and/or modify
 * it under the terms of the GNU General Public License version 2 and
 * only version 2 as published by the Free Software Foundation.
 *
 * This program is distributed in the hope that it will be useful,
 * but WITHOUT ANY WARRANTY; without even the implied warranty of
 * MERCHANTABILITY or FITNESS FOR A PARTICULAR PURPOSE.  See the
 * GNU General Public License for more details.
 */

/dts-v1/;
/plugin/;

#include "../common/kona-sec-common.dtsi"
#include "../common/kona-sec-laa-chn-jpn.dtsi"

#include "kona-sec-x1q-r13.dtsi"

/ {
	model = "Samsung X1Q CHN PROJECT - Rev04 (board-id,13)";
	compatible = "qcom,kona-mtp", "qcom,kona", "qcom,mtp";
	qcom,board-id = <8 13>;
	dtbo-version = <0>;
};

&soc {
	i2c@17 { /* SW I2C */
		status = "ok";
		sx9360-i2c@28 {
			sx9360,proxthresh_reg = <0x18>; /* threshhold : 288 */
		};
	};
};
