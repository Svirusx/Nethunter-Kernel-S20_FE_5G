/* Copyright (c) 2020, The Linux Foundation. All rights reserved.
 *
 * This program is free software; you can redistribute it and/or modify
 * it under the terms of the GNU General Public License version 2 and
 * only version 2 as published by the Free Software Foundation.
 *
 * This program is distributed in the hope that it will be useful,
 * but WITHOUT ANY WARRANTY; without even the implied warranty of
 * MERCHANTABILITY or FITNESS FOR A PARTICULAR PURPOSE.  See the
 * GNU General Public License for more details.
 */

&tlmm {
	wakeup-disabled-gpios = <
		0	/* DEBUG : AP_CTI_IN */
		2	/* DEBUG : AP_CTI_OUT */
		4	/* I2C : PM3003A_SDA_1P8 */
		11	/* OUTPUT : RTC_SYNC */
		23	/* SPI : BTP_SPI_CS_N */
		24	/* SPI : UWB_SPI_MISO */
		27	/* SPI : UWB_SPI_CS_N */
		28	/* I2C : DIRECT_IF_PMIC_SDA_1P8 */
		35	/* NO_WAKEUP : AP_UART_RXD */
		39	/* NC : NC */
		40	/* I2C : AP_MCU_SDA_1P8 */
		43	/* OUTPUT : MST_DATA_A */
		45	/* I2C : NFC_FLICKER_SCL_1P8 */
		47	/* OUTPUT : SBU_SW_SEL */
		51	/* SPI : ESE_SPI_CS_N */
		63	/* I2C : SUB_DISP_PMIC_SCL_1P8 */
		65	/* NO_WAKEUP : CC_DIR */
		92	/* OUTPUT : BTP_RST_N */
		103	/* I2C : VT10M2_TELE_SDA_1P8 */
		104	/* I2C : VT10M2_TELE_SCL_1P8 */
		108	/* I2C : CAM_AF_EEP_SCL_1P8 */
		118	/* NC : NC */
		122	/* NC : NC */
		126	/* I2C : BATT_SCL_1P8 */
		128	/* NC : NC */
		129	/* I2C : MOTOR_SDA_1P8 */
		132	/* NC : (AP_USB_BOOT) */
		134	/* NC : NC */
		136	/* OUTPUT : FLASH_LED_TORCH_PWM */
		138	/* OUTPUT : AMP_I2S_BCLK */
		142	/* SLIMBUS : BT_SLIMBUS_CLK */
		143	/* SLIMBUS : BT_SLIMBUS_DATA */
		150	/* NC : NC */
		160	/* I2C : 6AXIS_I3C_SDA_1P8 */
		162	/* I2C : MAGNETIC_SDA_1P8 */
		164	/* SPI : SUB_MAIN_COPR_MISO */
		166	/* SPI : SUB_MAIN_COPR_SCLK */
		167	/* SPI : MAIN_COPR_SS */
		175	/* NC : NC */
		177	/* I2C : MAIN_PROXY_SCL_1P8 */
		179	/* NC : NC */
	>;
};
